//----------------------------------------------------------------------------------------
// UThreadedCommand.cpp
// Copyright © 1999-2000 by Apple Computer, Inc. All rights reserved. 
//----------------------------------------------------------------------------------------

/*
	Change History:
		05/14/00	Don't call DoCatchMessage. It's not polite to break into the
							debugger for something that isn't really important. 
		02/07/00	Revised for new threads implementation. 
		06/13/99	Initial version. 
*/

#ifndef __UThreadedCommand__
#include "UThreadedCommand.h"
#endif

// MacApp

// ACS

#ifndef __CThreadRunner_AC__
#include "CThreadRunner_AC.h"
#endif

// Toolbox

#ifndef __SOUND__
#include <Sound.h>
#endif


//========================================================================================
// TThreadedCommand
//========================================================================================

//----------------------------------------------------------------------------------------
// TThreadedCommand constructor 
//----------------------------------------------------------------------------------------

TThreadedCommand::TThreadedCommand(CommandNumber itsCommandNumber,
								   TEventHandler* itsContext,
								   bool canUndo,
								   bool causesChange,
								   MDependable_AC* objectToNotify) :
	TCommand(itsCommandNumber, itsContext, canUndo, causesChange, objectToNotify),
	CThread_AC()
{
}

//----------------------------------------------------------------------------------------
// TThreadedCommand destructor
//----------------------------------------------------------------------------------------

TThreadedCommand::~TThreadedCommand()
{
}

//----------------------------------------------------------------------------------------
// TThreadedCommand::Start
//----------------------------------------------------------------------------------------

CThread_AC* TThreadedCommand::Start() // override
{
	return fContext ? fContext->Start() : this;
}

//----------------------------------------------------------------------------------------
// IsAlive
//----------------------------------------------------------------------------------------

bool TThreadedCommand::IsAlive() const // override
{
	return fContext ? fContext->IsAlive() : false;
}

//----------------------------------------------------------------------------------------
// IsCurrent
//----------------------------------------------------------------------------------------

bool TThreadedCommand::IsCurrent() const // override
{
	return fContext ? fContext->IsCurrent() : false;
}

//----------------------------------------------------------------------------------------
// Yield
//----------------------------------------------------------------------------------------

void TThreadedCommand::Yield() // override
{
	if (fContext)
		fContext->Yield();
}

//----------------------------------------------------------------------------------------
// Suspend
//----------------------------------------------------------------------------------------

void TThreadedCommand::Suspend() // override
{
	if (fContext)
		fContext->Suspend();
}

//----------------------------------------------------------------------------------------
// Resume
//----------------------------------------------------------------------------------------

void TThreadedCommand::Resume() // override
{
	if (fContext)
		fContext->Resume();
}

//----------------------------------------------------------------------------------------
// Join
//----------------------------------------------------------------------------------------

void TThreadedCommand::Join() // override
{
	if (fContext)
		fContext->Join();
}

//----------------------------------------------------------------------------------------
// TThreadedCommand::RunCommand
//----------------------------------------------------------------------------------------

void TThreadedCommand::RunCommand()
{
	try
	{
		Run();
	}
	catch (CException_AC& inException)
	{
		PostException(inException.GetError(), inException.GetExceptionMessage());
	}
	catch (...)
	{
#if qThreadDebug
		ProgramBreak_AC("Caught unknown exception in TThreadedCommand::RunCommand");
#endif		
		PostException(minErr, 0);
			// Don't let exceptions propogate beyond the top of the stack.
	}

	fDone = true;
}

//----------------------------------------------------------------------------------------
// TThreadedCommand::IsReadyToExecute: 
//----------------------------------------------------------------------------------------

bool TThreadedCommand::IsReadyToExecute() // override
{
	return fReadyToExecute && fDone;
}

//----------------------------------------------------------------------------------------
// TThreadedCommand::DoIt
//----------------------------------------------------------------------------------------

void TThreadedCommand::DoIt() // override 
{
	// Allow noErr or userCanceledErr to stop the thread, but don't rethrow them
	// to the application. 
	if (fHasException &&
		(fException.GetError() != noErr) &&
		(fException.GetError() != userCanceledErr))
	{
		throw fException;
	}
}


//----------------------------------------------------------------------------------------
// End of UThreadedCommand.cpp