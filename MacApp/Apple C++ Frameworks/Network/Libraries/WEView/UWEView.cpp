//----------------------------------------------------------------------------------------
// UWEView.cpp
// Copyright © 1985-2000 by Apple Computer, Inc.  All rights reserved.
//----------------------------------------------------------------------------------------

/*
	Change History
		11/01/00	[PB] Include MacErrors instead of Errors. 
		10/02/00	Use KeyScript instead of SetKeyScript.  static_cast chTab to
					unsigned char in DoKeyEvent.
		05/23/00	[2279264] Remove false from ProgramReport_AC. 
		05/18/00	Don't hard code fTextStyleRsrcID in ReadFields. 
					Makes it easier for subclasses to override. 
					Don't change the size determiner in SetWrap. There is a problem
					with the crOnly hook not working, but the workaround was worse. 
		04/19/00	Include UPrinting.h instead of UPrintHandler.h.
		01/13/00	Fix unusing of globalMouse in MySetTSMCursor.
		12/10/99	Moved out the last chunk of the ctor and ReadFields into 
					DoPostCreate since the hierarchy must be created first.
		11/19/99	Use WECopy in WriteToDeskScrap so all the WASTE data is exported. 
					GivePasteData no longer has a scrapRef parameter under Carbon. 
					Rename from .cp to .cpp
		11/18/99	Allow the view rect to be set for views that don't accept
					changes so the clip view won't be clipped. 
		11/16/99	Simplified DoBreakFollowing slightly. The MW68K optimizer was 
					getting confused around the call to WEGetLineRange and leaving 
					the SP off by 4 bytes. This caused registers to be restored 
					incorrectly on returning to CalcPageStrips. 
					Also removed some unnecessary casts. 
		11/05/99	Move menu and command numbers for TWEView to WEView.r.h. 
					Add a contextual menu. 
		11/03/99	Remove the dataType parameter from DoMakeEditCommand. 
					DoMenuCommand should not have to know details of how to paste. 
					Change to use new commands for pasting and dropping objects. 
					Support soup in paste and drag data. 
		10/12/99	In DoMakeDragDropCommand, check if text flavor exists before 
					focusing on it. Replaces try/catch block and having an exception
					whenever a picture is dropped in. Add SetNewPicture so we don't 
					have to treat pictures as if they were text. 
		10/19/99	Make changes to support carbon and universal headers 3.3.
		10/10/99	Split off PICT handler from UWEView. 
		09/24/99	StuffTextAndStyles wasn't unlocking the text handle. 
		07/26/99	Update all the places that look at 'TEXT' flavors to also accept 'PICT'
					flavors.
		07/20/99	Update from PICT handler sample code from
					PICT Object Handler for the WASTE Text Engine
					by Michael F. Kamprath, kamprath@kagi.com
					maintenance by John C. Daub, hsoi@eden.com
		07/09/99	Changed kDefaultTextStyleID to Monaco 10.
		03/24/99	Update copyright notice.
		02/12/99	[C] 'qd' is no longer accessible; use accessors.
		02/09/99	[C] Commented out some opaque GrafPtr calls.  Coerced 
					OpaqueWindowPtr* to OpaqueGarfPtr*.
		11/13/98	[2279269] Add false to ProgramBreak_AC call.  [2279270] Add
					recursion guard to SynchView.
		10/29/98	Use sizers. 
		10/27/98	It's okay if we can't focus. 
		10/24/98	Add scale popup to window. 
		10/23/98	Add zoom icons to window. 
		10/08/98	Added targetTracker to DoMakeDragDropCommand.
					Change operator const char* to AsText. 
					Put back lost begin comment in DoPostCreate. 
*/

#ifndef __UWEVIEW__
#include "UWEView.h"
#endif

// DemoWASTE

#ifndef __CWEPicture__
#include "CWEPicture.h"
#endif

#ifndef __UWECOMMANDS__
#include "UWECommands.h"
#endif

#ifndef __WEView_r__
#include "WEView.r.h"
#endif

// MacApp

#ifndef __UADORNERS__
#include "UAdorners.h"
#endif

#ifndef __UCLIPBOARDMGR__
#include "UClipboardMgr.h"
#endif

#ifndef __UContextualMenu__
#include "UContextualMenu.h"
#endif

#ifndef __UDEBUG__
#include "UDebug.h"
#endif

#ifndef __UDISPATCHER__
#include "UDispatcher.h"
#endif

#ifndef __UERRORMGR__
#include "UErrorMgr.h"
#endif

#ifndef __UGEOMETRY__
#include "UGeometry.h"
#endif

#ifndef __UICONBUTTON__
#include "UIconButton.h"
#endif

#ifndef __UPOPUP__
#include "UPopup.h"
#endif

#ifndef __UPRINTING__
#include "UPrinting.h"
#endif

#ifndef __UMACAPPUTILITIES__
#include "UMacAppUtilities.h"
#endif

#ifndef __UMEMORY__
#include "UMemory.h"
#endif

#ifndef __UMENUMGR__
#include "UMenuMgr.h"
#endif

#ifndef __USCROLLER__
#include "UScroller.h"
#endif

#ifndef __USizer__
#include "USizer.h"
#endif

// ACS

#ifndef __CException_AC__
#include "CException_AC.h"
#endif

#ifndef __ImagingStreaming_AC__
#include "ImagingStreaming_AC.h"
#endif

#ifndef __CStream_AC__
#include "CStream_AC.h"
#endif

// WASTE

#include "WETabs.h"

#include "WEExtras.h"

// Toolbox

#ifndef __FIXMATH__
#include <FixMath.h>
#endif

#ifndef __LOWMEM__
#include <LowMem.h>
#endif

#ifndef __MACERRORS__
#include <MacErrors.h>
#endif

#ifndef __QUICKDRAWTEXT__
#include <QuickdrawText.h>
#endif

#ifndef __TOOLUTILS__
#include <ToolUtils.h>
#endif

#ifndef __TEXTSERVICES__
#include <TextServices.h>
#endif

#ifndef __SCRIPT__
#include <Script.h>
#endif

// ANSI

#ifndef __LIMITS__
#include <limits.h>
#endif

#ifndef __STDIO__
#include <stdio.h>
#endif


//========================================================================================
// GLOBAL Variables
//========================================================================================

bool gUWEViewInitialized = false;
bool gHasTextServices = false;					// Set by application initialization
CPoint_AC gGlobalMouseForCursor;

// The following are considered private, but appear in the interface in case you need to
// override a method that uses one of these.

TWEView* TWEView::fgCurrWEView;					// For the benefit of ClickLoopForTWEView only
WEClickLoopUPP TWEView::fgWEClickLoopUPP;		// UPP for our click loop routine

#if qDebug
bool TWEView::fgWEIntenseDebugging;							
#endif

//========================================================================================
// GLOBAL Constants
//========================================================================================

enum { kDefaultTextStyleID = 230 };	// NB change this for a different default, or support


//========================================================================================
// GLOBAL Procedures
//========================================================================================
#undef Inherited

static void FixToRatio(Fixed x, short& numer, short& denom);

//----------------------------------------------------------------------------------------
// MySetTSMCursor
//----------------------------------------------------------------------------------------

void MySetTSMCursor(const CPoint_AC& globalMouse, CursPtr aCursor)
{
	// Give TSM a chance to handle the cursor
#if qCarbon
#pragma unused (globalMouse)
#else
	if (gHasTextServices && SetTSMCursor(globalMouse))
		return;
#endif
	::MacSetCursor(aCursor);
}

//----------------------------------------------------------------------------------------
// FixToRatio
//----------------------------------------------------------------------------------------

void FixToRatio(Fixed x, short& numer, short& denom)
{
	// Shift x until the low word is clear or the denominator gets big
	long n = x;
	long d = 1;
	while (((n & 0x0000FFFFL) != 0) && ((d & 0x00003FFFL) != 0))
	{
		n <<= 1;
		d <<= 1;
	}

	numer = n >> 16;
	denom = d;
}

//========================================================================================
// CLASS TWEView
//========================================================================================
#undef Inherited
#define Inherited TView

MA_DEFINE_CLASS(TWEView);

//----------------------------------------------------------------------------------------
// TWEView::Initialize
//----------------------------------------------------------------------------------------

void TWEView::Initialize()
{
	if (!gUWEViewInitialized)
	{
#if qTemplateViews
		{
			// So we can create TWEView objects from view resources
			REGISTER_SIGNATURE_AC(TWEView, kStdWEView);
		}
		InitUIconButton();
		InitUPopup();
		InitUSizer();
#endif

		if (!TWEView::fgWEClickLoopUPP)
			ThrowIfNULL_AC(TWEView::fgWEClickLoopUPP = NewWEClickLoopProc(TWEView::ClickLoopForTWEView));

		CWEPicture::Install();

		gUWEViewInitialized = true;
	}
}

//----------------------------------------------------------------------------------------
// TWEView constructor
//----------------------------------------------------------------------------------------

TWEView::TWEView(const CViewPoint&		itsLocation,
				 const CViewPoint&		itsSize,
				 SizeDeterminer			itsHDeterminer,
				 SizeDeterminer			itsVDeterminer,
				 const CViewRect&		itsInset,
				 const CTextStyle_AC&	itsTextStyle,
				 short					itsJustification,
				 bool					itsAutoWrap)
	:	TView(itsLocation, itsSize, itsHDeterminer, itsVDeterminer),
		fText(NULL),
		fSavedWEHandle(NULL),
		fInset(itsInset),
		fKeyCommandNumber(cTyping),
		fMaxChars(kWEUnlimited),
		fLastHeight(0),
		fLastWidth(0),
		fTypingCommand(NULL),
		fTextStyle(itsTextStyle),
		fTextStyleRsrcID(kDefaultTextStyleID),	// was kNoResource
		fPreferOutline(kDontPreferOutline),
		fJustification(itsJustification),
		fAcceptsChanges(true),					// Stuff to false if you don’t want to
												// allow Cut, Paste, or Typing
		fAutoWrap(itsAutoWrap),
		fAutoIndent(false),
		fFreeText(false),						// Same as would be set by ViewEdit if this were a TTEView
		fSpecsChanged(false),
		fLastPageBreak(0),
		fLastLine(0),
		fControlChars(macroAsSetElem(chLeft) | macroAsSetElem(chRight) | 
					  macroAsSetElem(chUp) | macroAsSetElem(chDown) | 
					  macroAsSetElem(chBackspace) | macroAsSetElem(chReturn) |
					  macroAsSetElem(chTab)),
		fMinAhead(kMinAhead),
		fSelAnchor(0)
#if qDrag
		,
		fHiliteRgn(NULL),
		fLastCaretTime(0L),
		fLastCaretOffset(0),
		fCaretIsShown(false)
#endif // qDrag
{
#if qDebug
	fgWEIntenseDebugging = false;
#endif

	SetWEReference(NULL);					// Initialize reference
	::BlockSet_AC((Ptr) & fEventRecord, sizeof(EventRecord), 0);

	fWantsToBeTarget = true;
	fCursorID = iBeamCursor;

#if qDebug
	if (!gUWEViewInitialized)
	{
		ProgramBreak_AC("InitUWEView must be called before creating a WE View.");
		ThrowException_AC(noErr, 0);
	}
#endif
}

//----------------------------------------------------------------------------------------
// TWEView copy constructor
//----------------------------------------------------------------------------------------

TWEView::TWEView(const TWEView& inWEView)
	:	fText(NULL),
		fSavedWEHandle(NULL),
		fInset(inWEView.fInset),
		fKeyCommandNumber(inWEView.fKeyCommandNumber),
		fMaxChars(inWEView.fMaxChars),
		fLastHeight(inWEView.fLastHeight),
		fLastWidth(inWEView.fLastWidth),
		fTypingCommand(inWEView.fTypingCommand),
		fTextStyle(inWEView.fTextStyle),
		fTextStyleRsrcID(inWEView.fTextStyleRsrcID),
		fPreferOutline(inWEView.fPreferOutline),
		fJustification(inWEView.fJustification),
		fAcceptsChanges(inWEView.fAcceptsChanges),
		fAutoWrap(inWEView.fAutoWrap),
		fAutoIndent(inWEView.fAutoIndent),
		fFreeText(inWEView.fFreeText),
		fSpecsChanged(inWEView.fSpecsChanged),
		fLastPageBreak(inWEView.fLastPageBreak),
		fLastLine(inWEView.fLastLine),
		fControlChars(inWEView.fControlChars),
		fMinAhead(inWEView.fMinAhead),
		fSelAnchor(inWEView.fSelAnchor)
#if qDrag
		,
		fHiliteRgn(inWEView.fHiliteRgn),
		fLastCaretTime(inWEView.fLastCaretTime),
		fLastCaretOffset(inWEView.fLastCaretOffset),
		fCaretIsShown(inWEView.fCaretIsShown)
#endif // qDrag
{
	// •••  What about TView fields fLocation, fSize, fSizeDeterminer?
	SetWEReference(NULL);					// Initialize reference
	::BlockSet_AC((Ptr) & fEventRecord, sizeof(EventRecord), 0);

	InitializeFrom(inWEView);
}

//----------------------------------------------------------------------------------------
// TWEView::InitializeFrom - used by copy constructor and Clone method
//----------------------------------------------------------------------------------------

void TWEView::InitializeFrom(const TWEView& other)
{
	if (other.fWE)
	{
		GrafPtr oldPort;
		CTextStyle_AC aTextStyle;

		CWhileOutlinePreferred_AC setOP(fPreferOutline);

		GetPort(&oldPort);
#if qCarbon
#pragma warning ("Carbon: TWEView::InitializeFrom find gWorkPort")
		::MacSetPort((OpaqueGrafPtr*)gWorkPort);
#else
		::MacSetPort(gWorkPort);
#endif
		aTextStyle = fTextStyle;
		SetPortTextStyle(aTextStyle);

		// • Create a new WASTE instance
		{
			LongRect weDestRect;
			LongRect weViewRect;
			UInt32 weFlags = weDoUseTempMem + weDoDrawOffscreen;
#if qDrag
			weFlags += weFDragAndDrop;
#endif

			::WEGetDestRect(&weDestRect, other.fWE);
			::WEGetViewRect(&weViewRect, other.fWE);

			WEReference newWE;
			ThrowIfOSErr_AC(::WENew(&weDestRect, &weViewRect, weFlags, &newWE));
			ThrowIfNULL_AC(newWE);
			SetWEReference(newWE);
		}

		SetPort(oldPort);

		// • Copy some fields from the original WASTE instance into the cloned instance

		ThrowIfOSErr_AC(::WESetInfo(weClickLoop, &fgWEClickLoopUPP, fWE));
		SetJustification(other.fJustification, kDontRedraw);

		// • We need to clone the Run information for all the text
//		if (other.fStyleType == kWithStyle)
//		{
			// •••  Something's missing here!
//		}

		// • Save existing text handle
		fSavedWEHandle = ::WEGetText(other.fWE);
		Handle theText = other.fText;
		PermHandToHand((Handle &)theText);

		// • Install new text handle
		ThrowIfOSErr_AC(::WEUseText(theText, fWE));
		fText = theText;			// Make a local copy, too
		theText = NULL;

		// • Copy the insertion point of the old WASTE instance
		SInt32 selStart;
		SInt32 selEnd;
		::WEGetSelection(&selStart, &selEnd, other.fWE);
		SetSelection(selStart, selEnd, kDontRedraw);
	}

	RecalcText();
}

//----------------------------------------------------------------------------------------
// TTextView::DoPostCreate:
//----------------------------------------------------------------------------------------

void TWEView::DoPostCreate(TDocument* itsDocument) // override
{
	TView::DoPostCreate(itsDocument);

	MakeWERecord();

	SInt32 selStart;
	SInt32 selEnd;
	WEGetSelection(&selStart, &selEnd, GetWEReference());
	fSelAnchor = selStart;

	ThrowIfOSErr_AC(::WESetInfo(weClickLoop, (const void*)&fgWEClickLoopUPP, GetWEReference()));

	fText = ::WEGetText(GetWEReference());
	SetIdleFreq(0);							// Idle ASAP
	SInt16 ignore = ::WEFeatureFlag(weFOutlineHilite, weBitSet, GetWEReference());

	AddAdorner(&TAdorner::fgSelectionAdorner, kDrawView, false);	// Wants DoHighlightSelection called

	// • Add a print handler
	//	 N.B. This print handler works but it prints lots of blank pages because our
	//	 view is so wide (cheesey way to simulate not auto-wrapping).
/*
	// •••  Print handler created in TWEDocument::DoMakeViews
	TStdPrintHandler* thePrintHandler = TH_new TStdPrintHandler(fDocument,	// its document
									  					this,			// its view
									  					kFixedSize,		// horizontal page size is fixed
									  					kFixedSize);	// vertical page size is fixed
*/
}

//----------------------------------------------------------------------------------------
// TWEView destructor
//----------------------------------------------------------------------------------------

TWEView::~TWEView() // override
{
	if (fgCurrWEView == this)
		fgCurrWEView = NULL;

	if (fWE)
	{
		if (fSavedWEHandle)
		{
			if (!fFreeText)
			{
				// • If fText is the WASTE text, it is about to be disposed
				// • Make a dummy replacement first
				Handle temp = NewHandle(0);
				ThrowIfOSErr_AC(WEUseText(temp, fWE));
			}
			// • Now put back the handle which WE allocated
			ThrowIfOSErr_AC(::WEUseText(fSavedWEHandle, fWE));
		}
		fText = NULL;

		::WERemoveTabHooks(fWE);
		::WEDispose(fWE);			// Release all memory associated with WASTE, including the text handle
		SetWEReference(NULL);
		fSavedWEHandle = NULL;
	}
}

//----------------------------------------------------------------------------------------
// TWEView::GetStandardSignature:
//----------------------------------------------------------------------------------------

IDType TWEView::GetStandardSignature() const // override
{
	return kStdWEView;
}

//----------------------------------------------------------------------------------------
// TWEView::ReadFields:
//----------------------------------------------------------------------------------------

void TWEView::ReadFields(CStream_AC* aStream) // override
{
#if qDebug
	if (!gUWEViewInitialized)
	{
		ProgramBreak_AC("InitUWEView must be called before creating a WE View.");
		ThrowException_AC(noErr, 0);
	}
#endif

	TView::ReadFields(aStream);

	// • We’re just a TView class as far as ViewEdit is concerned so we have to hardcode this stuff here

	// Don't hard code fields that are already set to good values in the constructor. 
	// Don't hard code fTextStyleRsrcID here. Instead, allow a subclass to set
	// fTextStyleRsrcID to what it wants in its constructor. 

	//	fAutoWrap = true;
	//	fAcceptsChanges = true;
	//	fFreeText = false;									// Same as would be set by ViewEdit if this were a TTEView
	//	fKeyCommandNumber = cTyping;
	//	fMaxChars = kWEUnlimited;
	fInset = CViewRect(4, 4, 0, 4);

	//	fJustification = weFlushDefault;
	//	fTextStyleRsrcID = kDefaultTextStyleID;

	if (fTextStyleRsrcID != kNoResource)
		fTextStyle = MAGetTextStyle(fTextStyleRsrcID);

//	fPreferOutline = kDontPreferOutline;
}

//----------------------------------------------------------------------------------------
// TWEView::WriteFields:
//----------------------------------------------------------------------------------------

void TWEView::WriteFields(CStream_AC* aStream) const // override
{
	TView::WriteFields(aStream);

	// Since we are the same as a TView, we don't write anything out.
}

//----------------------------------------------------------------------------------------
// TWEView::AutoScrolling:
//----------------------------------------------------------------------------------------

void TWEView::AutoScrolling(bool doScrolling)
{
	if (fWE)
		SInt16 ignore = ::WEFeatureFlag(weFAutoScroll, doScrolling ? weBitSet : weBitClear, fWE);
}

//----------------------------------------------------------------------------------------
// TWEView::BecameTarget:
//----------------------------------------------------------------------------------------

void TWEView::BecameTarget() // override
{
	SetActive(true);

	TView::BecameTarget();
}

//----------------------------------------------------------------------------------------
// TWEView::BecameWindowTarget:
//----------------------------------------------------------------------------------------

void TWEView::BecameWindowTarget() // override
{
	DoHighlightSelection(fActiveHL, hlOn);
	fActiveHL = hlOn;

	TView::BecameWindowTarget();
}

//----------------------------------------------------------------------------------------
// TWEView::ClickLoop:
//----------------------------------------------------------------------------------------

bool TWEView::ClickLoop(WEReference we)
{
	CViewPoint	viewPoint;
	CViewPoint	delta;
	CPoint_AC	mousePoint;
	TScroller*	scroller;

	if (we != fWE)
		return false;									// Not my instance!

	if (StillDown())
	{
		scroller = GetScroller(kAnySuperView);
		if (scroller && scroller->Focus())
		{
			GetMouse(mousePoint);
			viewPoint = scroller->QDToView(mousePoint);
			scroller->AutoScroll(viewPoint, delta);		// find how much should scroll
			if (Focus())
			{
				if (delta != gZeroVPt)
				{
					scroller->ScrollBy(delta, kRedraw);
					Update();						// make sure the scrolling was visible
				}
			}
		}

		// • Focus may have changed, which could change lots of things, thus requiring us,
		// • tiresomely, to take some or all of the following restorative precautions
		// • because clickloop expects us to be clipped to the view rect.
		if (Focus())
		{
			LongRect weViewRect;
			CTempRegion_AC rRgn;
			::WEGetViewRect(&weViewRect, we);
			SetRectRgn(rRgn, weViewRect.left, weViewRect.top, weViewRect.right, weViewRect.bottom);
			ClipFurtherTo(rRgn, gZeroPt);
		}
	}
	return true;										// Still consider the mouse to be down
} // TWEView::ClickLoop

//----------------------------------------------------------------------------------------
// TWEView::BeInPort:
//----------------------------------------------------------------------------------------

void TWEView::BeInPort(GrafPtr itsPort) // override
{
	if (fWE)
	{
		if (itsPort != NULL)
			ThrowIfOSErr_AC(::WESetInfo(wePort, &itsPort, fWE));
		else
		{
			ThrowIfOSErr_AC(::WESetInfo(wePort, &gWorkPort, fWE));
			DoneTyping();
			fSpecsChanged = true;
		}
	}

	TView::BeInPort(itsPort);
}

//----------------------------------------------------------------------------------------
// TWEView::BeInScroller:
//----------------------------------------------------------------------------------------

void TWEView::BeInScroller(TScroller* itsScroller) // override
{
	if (fWE && itsScroller)
	{
		// This is a kludge as WASTE lines are not necessarily a uniform height
		SInt32 vertScrollUnit;
		SInt32 lineHeight = ::WEGetHeight(0, 1, fWE);
		if (lineHeight > 0)
			vertScrollUnit = lineHeight;
		else
			vertScrollUnit = GetDefFontSize();			// Ask for system default size
		itsScroller->SetScrollParameters(CViewPoint(kStdScrollUnit, vertScrollUnit), false, true);
	}

	TView::BeInScroller(itsScroller);
}

//----------------------------------------------------------------------------------------
// TWEView::CalcMinFrame:
//----------------------------------------------------------------------------------------

CViewRect TWEView::CalcMinFrame() // override
{
	// Note that we omit the margins here, so that if TView::ComputeFrame rounds up to a
	// page multiple, the margins will get tacked on after.
	CViewPoint minSize(fSize.h - fInset.left - fInset.right, CalcRealHeight());

	if (GetSizeDeterminer(hSel) == sizeVariable && !fAutoWrap)
		minSize.Set(fLastWidth, minSize.v);

	CViewRect minFrame(TView::CalcMinFrame());
	minFrame[botRight] = minFrame[topLeft] + minSize;
	
	return minFrame;
}

//----------------------------------------------------------------------------------------
// TWEView::CalcRealHeight:
// Calculate true height of WASTE instance, including last character if it is a
// carriage return.
//----------------------------------------------------------------------------------------

SInt32 TWEView::CalcRealHeight()
{
	SInt32 theHeight = 0;								// default return value

	CWhileOutlinePreferred_AC setOP(fPreferOutline);

	Handle hText = ::WEGetText(fWE);
	SInt32 textLength = ::WEGetTextLength(fWE);

	bool lastIsCR = (textLength <= 0) || ((*(CharsHandle)(hText))[textLength - 1] == chReturn);
	SInt32 nLines = ::WECountLines(fWE);
	if (nLines > 0)
		theHeight = ::WEGetHeight(0, nLines, fWE);

	if (lastIsCR && (nLines > 0))						// include the final <CR>
	{
		WERunInfo info;
		::WEGetRunInfo(textLength, &info, fWE);
		theHeight += info.runHeight;
	}

#if qDebugMsg
	if (gIntenseDebugging)
		::ProgramReport_AC("TWEView::CalcRealHeight: CalcRealHeight=%1d\n", theHeight);
#endif

	return theHeight;
}

//----------------------------------------------------------------------------------------
// TWEView::CalcRealWidth:
// Calculate true width of WASTE instance. Only supported for NON-styled TE
// Records right now.
//----------------------------------------------------------------------------------------

SInt32 TWEView::CalcRealWidth()
{
	SInt32 aWidth = 0;

	if (Focus())
	{
		SetPortTextStyle(fTextStyle);

		Handle hText = ::WEGetText(fWE);
		if (hText != NULL)
		{
			CTempHandleLock_AC tempHandleLock(hText);

			WEReference we = fWE;
			SInt32 lineStart;
			SInt32 lineEnd;
			for (SInt32 lineNo = 0; lineNo < ::WECountLines(we); ++lineNo)
			{
				::WEGetLineRange(lineNo, &lineStart, &lineEnd, we);// Get start & end offset of each line
				SInt32 fromChar = lineStart;
				SInt32 toChar = lineEnd;
				aWidth = Max_AC(aWidth, (SInt32) TextWidth(*hText, fromChar, (toChar - fromChar) + 1));
			}

			return aWidth;
		}
	}
#if qDebug
	else
	{
		ProgramBreak_AC("IN TWEView::CalcRealWidth: called for a styled instance");
	}
#endif

	return aWidth;
}

//----------------------------------------------------------------------------------------
// TWEView::SetWrap:
//----------------------------------------------------------------------------------------

void TWEView::SetWrap(bool newAutoWrap, bool redraw)
{
	// To switch to non-autowrap we must use the unsupported WASTE Extras.
	
	if (newAutoWrap != fAutoWrap)
	{
		if (newAutoWrap)
			::WERemoveCrOnlyHook(fWE);		
		else
			::WEInstallCrOnlyHook(fWE);		
		
		fAutoWrap = newAutoWrap;
	}
	
#if 0
	// ••• Installing the Tabs hook will override the CrOnly hook. 
	// Changing the view's size determiner is not an acceptable workaround. 
	// It's better to put up with no autowrap than have the view size
	// be wrong. The right fix is to make a better Tabs hook. •••
	if (fAutoWrap)
	{
		SetSizeDeterminer(hSel, sizeSuperView);

		CViewRect newFrame;
		ComputeFrame(newFrame);
		SetFrame(newFrame, redraw);
	}
	else
		SetSizeDeterminer(hSel, sizeVariable);
#endif

	if (redraw)
	{
		AdjustWERects();
		RecalcText();
		SynchView(kDontRedraw);
		ForceRedraw();
	}
}

//----------------------------------------------------------------------------------------
// TWEView::SetTabSize:
//----------------------------------------------------------------------------------------

void TWEView::SetTabSize(SInt16 tabSize, bool redraw)
{
	if (Focus())
	{
		SetPortTextStyle(fTextStyle);
	
		// The tabSize is specfied in the number of spaces a tab should represent.
		// We need to convert that to the number of pixels for ::WESetTabSize().
		SInt16 realTabSize = tabSize * CharWidth(' ');
		
		::WESetTabSize(realTabSize, fWE);
	
		if (redraw)
		{
			AdjustWERects();
			RecalcText();
			SynchView(kDontRedraw);
			ForceRedraw();
		}
	}
}

//----------------------------------------------------------------------------------------
// TWEView::SetAutoIndent:
//----------------------------------------------------------------------------------------

void TWEView::SetAutoIndent(bool newAutoIndent)
{
	fAutoIndent = newAutoIndent;
}

//----------------------------------------------------------------------------------------
// TWEView::ComputeFrame:
//----------------------------------------------------------------------------------------

void TWEView::ComputeFrame(CViewRect& newFrame) // override
{
	TView::ComputeFrame(newFrame);

	for (VHSelect vhs = vSel; vhs <= hSel; ++vhs)
	{
		switch (GetSizeDeterminer(vhs))
		{
			case sizeFixed:
			case sizeRelSuperView:
				break;

			case sizeSuperView:
				if (fSuperView)
					break;
				// else drop through to default
			default:
				newFrame[botRight][vhs] += fInset[topLeft][vhs] + fInset[botRight][vhs];
				break;
		}
	}
	newFrame.bottom = Min_AC(kWEUnlimited, newFrame.bottom);
}

//----------------------------------------------------------------------------------------
// TWEView::CalcSelLoc:
//----------------------------------------------------------------------------------------

void TWEView::CalcSelLoc(CViewRect& selectionRect)
{
	LongPt screenPoint;
	SInt32 startOfSelection;
	SInt32 endOfSelection;
	SInt16 lineHeight;

	::WEGetSelection(&startOfSelection, &endOfSelection, fWE);

	if ((endOfSelection - startOfSelection == 0) && (fIdleFreq == kMaxIdleTime))
		SetIdleFreq(0);									// Idle ASAP

	::WEGetPoint(startOfSelection, hilite, &screenPoint, &lineHeight, fWE);
	selectionRect.left = screenPoint.h;
	selectionRect.top = screenPoint.v;

	::WEGetPoint(endOfSelection, hilite, &screenPoint, &lineHeight, fWE);
	selectionRect.right = screenPoint.h;
	selectionRect.bottom = screenPoint.v + lineHeight;
}

//----------------------------------------------------------------------------------------
// TWEView::ContinuousStyle:
//----------------------------------------------------------------------------------------

bool TWEView::ContinuousStyle(SInt32 firstChar, SInt32 lastChar, WEStyleMode& mode, CTextStyle_AC& aStyle)
{
	SInt32	oldSelStart;
	SInt32	oldSelEnd;
	::WEGetSelection(&oldSelStart, &oldSelEnd, fWE);

	SetWESelect(firstChar, lastChar, fWE);// We can’t really do this behind WASTE’s back
	bool result = ::WEContinuousStyle(&mode, &aStyle, fWE);
	SetWESelect(oldSelStart, oldSelEnd, fWE);// & so fSpecsChanged isn’t touched
	return result;
}

//----------------------------------------------------------------------------------------
// TWEView::ContainsClipType:
//----------------------------------------------------------------------------------------

bool TWEView::ContainsClipType(ResType aType) // override
{
	return aType == kTextType_AC || aType == kPictType_AC;
}

//----------------------------------------------------------------------------------------
// TWEView::DoBreakFollowing: Put in resident segment since this gets called while typing
//----------------------------------------------------------------------------------------

ViewCoordinate TWEView::DoBreakFollowing(VHSelect vhs, 
										 ViewCoordinate previousBreak, 
										 bool& automatic) // override
{
	SInt32 possibleLoc = kWEUnlimited;

	VHSelect orthoVhs = gOrthogonal[vhs];
	automatic = true;

	TPrintHandler* itsPrintHandler = GetPrintHandler();
	if (itsPrintHandler != NULL)
		possibleLoc = Min_AC(kWEUnlimited, previousBreak + itsPrintHandler->GetViewPerPage()[orthoVhs]);

	// We want to get rid of the on-screen margin represented by fMargin when printing, so
	// adjust things so that the portion of the view occupied by the screen margin doesn’t
	// get printed.
	if (previousBreak == 0)
		possibleLoc += fInset[topLeft][orthoVhs];

	if (vhs == hSel)
	{
		SInt32 height;
		SInt32 lineNo;
		if (fLastPageBreak == previousBreak)
		{
			height = fLastPageBreak;
			lineNo = fLastLine;
		}
		else
		{
			height = fInset[topLeft][orthoVhs];
			lineNo = 0;
		}

		SInt32 countLines = ::WECountLines(fWE);
		SInt32 textLength = ::WEGetTextLength(fWE);
		if (textLength > 0)
		{
			// We want to see if the last line is empty (only a return).
			// Can’t just look at the last byte in hText, because it could be
			// a multi-byte character.
			SInt32 lineStart;
			SInt32 lineEnd;
			::WEGetLineRange(::WEOffsetToLine(textLength, fWE), &lineStart, &lineEnd, fWE);
			if (chReturn == ::WEGetChar(lineStart, fWE))
				countLines++;
		}

		while (lineNo < countLines)
		{
			SInt32 lineHeight = ::WEGetHeight(lineNo, lineNo + 1, fWE);
			if (height + lineHeight <= possibleLoc)
				height += lineHeight;
			else
				break;
			++lineNo;
		}
		if (lineNo >= countLines)
			possibleLoc = Max_AC(possibleLoc, height);
		else if (height > previousBreak)
		{
			possibleLoc = height;
			fLastPageBreak = possibleLoc;
			fLastLine = lineNo;
		}
		// else the current line height was bigger than this page--print what we can.
		// next break we'll recalculate from the start again.
		fLastPageBreak = possibleLoc;
		fLastLine = lineNo;
	}

	if ((possibleLoc + fInset[topLeft][orthoVhs]) >= fSize[orthoVhs])
		possibleLoc = fSize[orthoVhs];

	return possibleLoc;
}

//----------------------------------------------------------------------------------------
// TWEView::DoCalcViewPerPage:
//----------------------------------------------------------------------------------------

CViewPoint TWEView::DoCalcViewPerPage() // override
{
	CViewPoint viewPerPage(TView::DoCalcViewPerPage());	// Get max amount allowed given margins

#if qDebugMsg
	if (gDebugPrinting)
		::ProgramReport_AC("TWEView: incoming generic viewPerPage: %s\n", viewPerPage.AsText());
#endif

	// Adjust for integral # of lines per page (unless the view is too small)
	// This is a kludge as WASTE lines are not necessarily a uniform height.
	SInt32 lineHeight = ::WEGetHeight(0, 1, fWE);
	if (fWE && lineHeight > viewPerPage.v)
		viewPerPage.v = lineHeight * (viewPerPage.v / lineHeight);

#if qDebug
	if (gDebugPrinting)
		fprintf(stderr, "TWEView: computed viewPerPage: %s\n", viewPerPage.AsText());
#endif

	return viewPerPage;
}

//----------------------------------------------------------------------------------------
// TWEView::DoIdle:
//----------------------------------------------------------------------------------------

bool TWEView::DoIdle(IdlePhase phase) // override
{
	if (phase == idleContinue)
	{
		SInt32 selStart;
		SInt32 selEnd;
		::WEGetSelection(&selStart, &selEnd, fWE);
		if ((selEnd - selStart == 0) && IsEnabled())
		{
			if (fAcceptsChanges && IsDrawable())
			{
				CWhileOutlinePreferred_AC setOP(fPreferOutline);
				::WEIdle(NULL, fWE);
			}
			SetIdleFreq(Max_AC(GetCaretTime() / 2, 1));// Reset idle frequency in case user changed it
		}
		else
			SetIdleFreq(kMaxIdleTime);			// No need to bother anyone.
	}
	return false;										// Didn’t free myself
}

//----------------------------------------------------------------------------------------
// TWEView::DoKeyEvent: The Tab character has no width in some fonts, and so can cause
// confusing screen feedback. It is filtered out by default. If you want to include it in
// your text union it into fControlChars.
//----------------------------------------------------------------------------------------

void TWEView::DoKeyEvent(TToolboxEvent* event) // override
{
	TWETypingCommand*	aTypingCommand = NULL;
	const SInt32		arrowKeys = macroAsSetElem(chLeft) | macroAsSetElem(chRight) | macroAsSetElem(chUp) | macroAsSetElem(chDown);
	bool				needNewCommand = false;
	bool				handledCharacter = false;
	bool				hasInsertionPoint = false;

	CStr2_AC text(event->GetText());
	unsigned char ch = text[1];

	fEventRecord = event->GetEventRecord();				// Make a copy of the EventRecord

	if (IsEnabled())									// if view is not enabled then we don’t take ANY keystrokes
	{
		if ((text >= chSpace) || macroIn(fControlChars, macroAsSetElem(ch)))// Check that the character should be accepted
		{
			// • Check max size for text, and that we're not running out of memory
			SInt32 selStart;
			SInt32 selEnd;
			::WEGetSelection(&selStart, &selEnd, fWE);

			hasInsertionPoint = (selStart == selEnd) && ::WEIsActive(fWE);
			if (hasInsertionPoint && Focus())
				::WEDeactivate(fWE);

			if (macroIn(arrowKeys, macroAsSetElem(ch)) && Focus())
			{
				DoneTyping(); 
				fSpecsChanged = true;
				::WEActivate(fWE);
				::WEKey(ch, fEventRecord.modifiers, fWE);
				ScrollSelectionIntoView(kRedraw);
				handledCharacter = true;
			}
			else if (fAcceptsChanges && Focus())
			{
				if ((text != chBackspace) && (text != chFwdDelete) && (selStart == selEnd))
					if (((fMaxChars - ::WEGetTextLength(fWE)) < 1) || MemSpaceIsLow())
					{
						StdAlert(phTooManyChars);
						return;
					}

				// • Pass the character to the typing command, creating a new one if necessary
				needNewCommand = fTypingCommand == NULL;
				if (!needNewCommand)
					needNewCommand = fTypingCommand->fCompleted;

				if (needNewCommand)
				{
					aTypingCommand = DoMakeTypingCommand(text);
					fTypingCommand = aTypingCommand;
					PostCommand(aTypingCommand);
				}
				else
				{
					fTypingCommand->AddCharacter(text);
					// Once you're typing (first character already processed) collecting
					// subsequent characters really shouldn’t affect the menus unless
					// you're keeping a character count in them or something that depends
					// on the aggregate of the characters you've typed. The TextStyle for
					// the first character would certainly apply to subsequent characters.
					// So, this is one ideal place to say that the event _DOES NOT_ affect
					// the menus. If the menus are already invalid they will stay so, but
					// if they are valid then there is no need to invalidate them in the
					// character collection process. When the user terminates the addition
					// of characters with another event, the menus will be setup from that
					// event. If you really feel you must, then you can always override,
					// call Inherited and then set event->fAffectMenus back to true.
					// (Rhymes with rue)
					event->SetAffectsMenus(false);

					// Check to see if we need to perform auto-indenting. If so, count the number
					// of tabs on the line that was just ended and add that to the new line.
					if (fAutoIndent && text == chReturn)
					{
						SInt32	lineStart;
						SInt32	lineEnd;
						::WEGetLineRange(::WEOffsetToLine(selStart, fWE), &lineStart, &lineEnd, fWE);
						
						for (SInt32 offset = lineStart; offset < lineEnd; offset++)
						{
							if (chTab == ::WEGetChar(offset, fWE))
								fTypingCommand->AddCharacter(static_cast<unsigned char>(chTab));
						}
					}					
				}
				handledCharacter = true;
			}

			if (hasInsertionPoint && Focus())
				::WEActivate(fWE);
		}
		if (fIdleFreq == kMaxIdleTime)
			SetIdleFreq(0);							// Idle ASAP, since someone may somehow set an
													// insertion point and want it to flash. (the
													// idle time will be reset to match the caret
													// time in DoIdle()).
	}

	if (!handledCharacter)
		TView::DoKeyEvent(event);

	AdjustWERects();								// Set new view/dest rects
}

//----------------------------------------------------------------------------------------
// TWEView::DoMakeEditCommand:
//----------------------------------------------------------------------------------------

TWECommand* TWEView::DoMakeEditCommand(CommandNumber aCommandNumber)
{
	TWECommand *aWECommand = NULL;

	switch (aCommandNumber)
	{
		case cCut:
		case cCopy:
			aWECommand = TH_new TWECutCopyCommand(this, aCommandNumber);
			break;

		case cPaste:
			{
				long nChars;
				ResType dataType = '%%%%';
				nChars = gClipboardMgr->GetDataToPaste(NULL, dataType);
				if (dataType == kTextType_AC)
				{
					aWECommand = TH_new TWEPasteCommand(this);
				}
				else if (dataType == kPictType_AC)
				{
					aWECommand = TH_new TWEPasteObjectCommand(this);
				}
			}
			break;

		case cClear:
			aWECommand = TH_new TWECommand(this, aCommandNumber, true);
			break;
	}

	return aWECommand;
}

//----------------------------------------------------------------------------------------
// TWEView::DoMakeStyleCommand:
//----------------------------------------------------------------------------------------

TWEStyleCommand* TWEView::DoMakeStyleCommand(const CTextStyle_AC& aStyle, CommandNumber itsCommandNumber, short itsMode)
{
	return TH_new TWEStyleCommand(this, aStyle, itsCommandNumber, itsMode);
}

//----------------------------------------------------------------------------------------
// TWEView::DoMakeTypingCommand:
//----------------------------------------------------------------------------------------

TWETypingCommand* TWEView::DoMakeTypingCommand(const CStr2_AC& ch)
{
	return TH_new TWETypingCommand(this, ch);
}

//----------------------------------------------------------------------------------------
// TWEView::DoMenuCommand:
//----------------------------------------------------------------------------------------

void TWEView::DoMenuCommand(CommandNumber aCommandNumber) // override
{
	switch (aCommandNumber)
	{
		case cCut:
		case cCopy:
		case cClear:
		case cPaste:
			PostCommand(DoMakeEditCommand(aCommandNumber));
			break;

		case cSelectAll:
			if (Focus())
			{
				SetSelection(0, ::WEGetTextLength(fWE), kRedraw);
				DoneTyping();
				fSpecsChanged = true;
				ScrollSelectionIntoView(kRedraw);
			}
			break;

		default:
			TView::DoMenuCommand(aCommandNumber);
			break;
	}
}

//----------------------------------------------------------------------------------------
// TWEView::DoMouseCommand:
//----------------------------------------------------------------------------------------

void TWEView::DoMouseCommand(CViewPoint& theMouse, TToolboxEvent* event, CPoint_AC) // override
{
	if (Focus() && IsVisible() && ::WEIsActive(fWE))
	{
		CWhileOutlinePreferred_AC setOP(fPreferOutline);
		fEventRecord = event->GetEventRecord();			// Make a copy of the EventRecord

		fgCurrWEView = this;							// So the global clickLoop routine can forward.
		DoneTyping();									// Mousedown terminates the Typing command
		fSpecsChanged = true;
		CPoint_AC theHitPt(ViewToQD(theMouse));

		::WEActivate(fWE);					// Fix insertion point blinking troubles
		::WEClick(theHitPt, fEventRecord.modifiers, fEventRecord.when, fWE);

		// …force a re-focus because the focusing in ClickLoop clips down to the view rect.
		if (IsFocused())
			InvalidateFocus();

		SInt32 selStart;
		SInt32 selEnd;
		::WEGetSelection(&selStart, &selEnd, fWE);
		fSelAnchor = selStart;							// Remember the new selection anchor

		// •••  WASTE doesn't set the key script so do it here
		SetKeyScriptForSelection(selStart, selEnd);

		if (fIdleFreq == kMaxIdleTime)
			SetIdleFreq(0);						// Idle ASAP
	}
}

//----------------------------------------------------------------------------------------
// TWEView::SetKeyScriptForSelection
//----------------------------------------------------------------------------------------

void TWEView::SetKeyScriptForSelection(SInt32 selStart, SInt32 selEnd)
{
	short fontNumber;
	bool setIt = false;

	if (selEnd == selStart)							// empty selection
	{
		WERunInfo runInfo;
		::WEGetRunInfo(selStart, &runInfo, fWE);
		fontNumber = runInfo.runStyle.tsFont;
		setIt = true;
	}
	else
	{
		WEStyleMode mode = weDoFont;
		CTextStyle_AC aStyle;
		setIt = ::WEContinuousStyle(&mode, &aStyle, fWE);
		if (setIt)
			fontNumber = aStyle.tsFont;
	}

	if (setIt)	// set key script to match the font given by fontNumber
	{
		// which font is it?
		CStr255_AC aName;
		GetFontName(fontNumber, aName);				// Get real font number in case tsFont is 
		GetFNum(aName, &fontNumber);				// …the system or application font.
		short newKeyScript = ::FontToScript(fontNumber); 
		::KeyScript(newKeyScript);
	}
}

//----------------------------------------------------------------------------------------
// TWEView::DoneTyping:
//----------------------------------------------------------------------------------------

void TWEView::DoneTyping()
{
	if (fTypingCommand)
		fTypingCommand->CompleteTyping();
}

//----------------------------------------------------------------------------------------
// TWEView::DoSetPageOffset:
//----------------------------------------------------------------------------------------

void TWEView::DoSetPageOffset(const CViewPoint& coord) // override
{
	TView::DoSetPageOffset(coord);
	for (VHSelect vhs = vSel; vhs <= hSel; ++vhs)
		if (!coord[vhs])
			TPrintHandler::gPageOffset[vhs] += fInset[topLeft][vhs];
}

//----------------------------------------------------------------------------------------
// TWEView::DoSetupMenus:
//----------------------------------------------------------------------------------------

void TWEView::DoSetupMenus() // override
{
	SInt32 selStart;
	SInt32 selEnd;
	bool manyChars;

	TView::DoSetupMenus();

	::WEGetSelection(&selStart, &selEnd, fWE);
	manyChars = selStart < selEnd;
	if (!MemSpaceIsLow())
	{
		if (fAcceptsChanges)							// One way or another, we can paste text or PICTs
		{
			gClipboardMgr->CanPaste(kTextType_AC);		// If styles exist, all the better
			gClipboardMgr->CanPaste(kPictType_AC);			
		}
		Enable(cCopy, manyChars);
	}
	Enable(cSelectAll, ::WEGetTextLength(fWE) > 0);

	// We enable Cut even if space is low, since it's nice to be able to rescue some of
	// the stuff you have to delete even if space is low. Note that it is possible to get
	// into the "can’t do any commands" situation as a result. You should be able to close
	// and save the big document, then save the rescued text elsewhere, however.
	Enable(cCut, manyChars && fAcceptsChanges);
	Enable(cClear, manyChars && fAcceptsChanges);
}

//----------------------------------------------------------------------------------------
// TWEView::Draw:
//----------------------------------------------------------------------------------------

void TWEView::Draw(const CViewRect& area) // override
{
	SInt16 oldHilite;

	CWhileOutlinePreferred_AC setOP(fPreferOutline);

	bool wasActive = ::WEIsActive(fWE);

	// Hide selection if we're printing or drawing to scrap
	// or if we cannot be changed and our selection is an insertion point.
	SInt32 selStart;
	SInt32 selEnd;
	::WEGetSelection(&selStart, &selEnd, fWE);
	bool hideSelection = gPrinting || gDrawingPictScrap
						|| (!fAcceptsChanges && selStart == selEnd);

	if (hideSelection)
	{
		// • We don’t deactivate to draw the selection as an outline
		oldHilite = ::WEFeatureFlag(weFOutlineHilite, weBitClear, fWE);

		// • prevent selection from being drawn.
		CTempRegion_AC tempRgn;

		::GetClip(tempRgn);
		::ClipRect(gZeroRect);
		::WEDeactivate(fWE);
		::SetClip(tempRgn);
	}

	{
		CRect_AC qdArea(ViewToQD(area));
		CTempRegion_AC updateRgn;
		::RectRgn(updateRgn, &qdArea);
		::WEUpdate(updateRgn, fWE);	// normal screen update handled by WASTE directly
	}

	if (hideSelection && wasActive)
	{
		// Reactivate WASTE if we deactivated it
		if (wasActive)
		{
			CTempRegion_AC tempRgn;

			::GetClip(tempRgn);
			::ClipRect(gZeroRect);
			::WEActivate(fWE);
			::SetClip(tempRgn);
		}

		SInt16 ignore = ::WEFeatureFlag(weFOutlineHilite, oldHilite, fWE);
	}

	TView::Draw(area);
}

//----------------------------------------------------------------------------------------
// TWEView::ExtractStyles:
// WASTE doesn’t lend itself to this type of information.
//----------------------------------------------------------------------------------------
//	void TWEView::ExtractStyles(TEStyleHandle& theStyles,
//								STHandle& theElements)
//	{
//		theStyles = TEGetStyleHandle(fHTE);
//		theElements = (**theStyles).styleTab;
//	}

//----------------------------------------------------------------------------------------
// TWEView::ExtractText:
//----------------------------------------------------------------------------------------

Handle TWEView::ExtractText() const
{
	return fText;
}

#if qWantsContextualMenus

//----------------------------------------------------------------------------------------
// TWEView::GetContextualMenu
//----------------------------------------------------------------------------------------

void TWEView::GetContextualMenu(const CViewPoint& theMouse,
								TToolboxEvent* event,
								CContextualMenu& contextualMenu) // override
{
#pragma unused (event)

	long selStart;
	long selEnd;
	WEGetSelection(&selStart, &selEnd, fWE);

	LongPt thePoint;
	thePoint.v = theMouse.v;
	thePoint.h = theMouse.h;
	WEEdge edge;
	long offset = WEGetOffset(&thePoint, &edge, fWE);

	if ((selStart <= offset) && (offset <= selEnd))
	{
		contextualMenu.SetMenu(::MAGetMenu(mFormatContextual));
	}
}

#endif // qWantsContextualMenus

//----------------------------------------------------------------------------------------
// TWEView::GetPrintExtent:
//----------------------------------------------------------------------------------------

CViewRect TWEView::GetPrintExtent() // override
{
	CViewRect printExtent(TView::GetPrintExtent());

	printExtent.Inset(fInset);
	
	return printExtent;
}

//----------------------------------------------------------------------------------------
// TWEView::GetSelectionString:
//----------------------------------------------------------------------------------------

void TWEView::GetSelectionString(CStr255_AC& selection)
{
	selection.Empty();
	if (fText && fWE)
	{
		SInt32 selStart;
		SInt32 selEnd;
		::WEGetSelection(&selStart, &selEnd, fWE);

		SInt32 length = Min_AC(kStr255Len, selEnd - selStart);
		if (length > 0)
			selection.CopyFrom(static_cast_AC(void*, (*fText) + selStart), length);
	}
}

//----------------------------------------------------------------------------------------
// TWEView::GetNumberOfChars:
//----------------------------------------------------------------------------------------

SInt32 TWEView::GetNumberOfChars()
{
	SInt32 numOfChars = 0;

	if (fText)
	{
		WEReference we = fWE;
		SInt32 textLength = ::WEGetTextLength(we);

		for (SInt32 byteIndex = 0; byteIndex < textLength; ++byteIndex)
		{
			SInt16 byteType = ::WECharByte(byteIndex, we);
			if (byteType != smFirstByte)
				++numOfChars;
		}
	}
	return numOfChars;
}

//----------------------------------------------------------------------------------------
// TWEView::GivePasteData:
//----------------------------------------------------------------------------------------

long TWEView::GivePasteData(Handle aDataHandle, ResType dataType) // override
{
	long aSize = 0;
	Handle aHandle = NULL;

	if (dataType == kTextType_AC)
	{
		aSize = GetHandleSize(fText);
		if (aDataHandle)
		{
			SetPermHandleSize(aDataHandle, aSize);	// Don’t forget. This can fail
			BlockMove_AC(*fText, *aDataHandle, aSize);
		}
	}
	else if (dataType == kStyleType_AC)
	{
		Handle hStyles = aDataHandle ? aDataHandle : NewPermHandle(0);
		OSErr err = WECopyRange(0, kWEUnlimited, NULL, reinterpret_cast<StScrpHandle>(hStyles), NULL, fWE);
		aSize = GetHandleSize(hStyles);
		if (hStyles != aDataHandle)
			DisposeHandle(hStyles);
		ThrowIfOSErr_AC(err);
	}
	else if (dataType == 'SOUP')
	{
		Handle hSoup = aDataHandle ? aDataHandle : NewPermHandle(0);
		OSErr err = WECopyRange(0, kWEUnlimited, NULL, NULL, hSoup, fWE);
		aSize = GetHandleSize(hSoup);
		if (hSoup != aDataHandle)
			DisposeHandle(hSoup);
		ThrowIfOSErr_AC(err);
	}
	else if (dataType == kPictType_AC)
	{
		WEObjectReference theObj; 
		WEGetSelectedObject(&theObj, fWE);
		if (theObj)
		{
			Handle theDataHandle = WEGetObjectDataHandle(theObj);
			aSize = GetHandleSize(theDataHandle);
			if (aDataHandle)
			{
				SetPermHandleSize(aDataHandle, aSize);	// Don’t forget. This can fail
				BlockMove_AC(*theDataHandle, *aDataHandle, aSize);
			}
		}
	}
	else
		ThrowException_AC(noTypeErr, 0);

	FailSpaceIsLow();

	return aSize;
}

//----------------------------------------------------------------------------------------
// TWEView::MakeWERecord:
//----------------------------------------------------------------------------------------

void TWEView::MakeWERecord()
{
	GrafPtr oldPort;

	WEReference we = NULL;
	UInt32 weFlags = weDoDrawOffscreen +				// Do drawing offscreen
					 weDoUseTempMem;					// Allocate data structures preferably from temporary memory
#if qDrag
	weFlags += weFDragAndDrop;
#endif

	::GetPort(&oldPort);								// Save current port
	SetPortWindowPort(gWorkPort);
	SetPortTextStyle(fTextStyle);

	CViewRect itsExtent(GetExtent());
	itsExtent.Inset(fInset);

	CRect_AC weDestRect(ViewToQD(itsExtent));

	LongRect destAndViewRect;
	::WERectToLongRect(weDestRect, &destAndViewRect);
	ThrowIfOSErr_AC(::WENew(&destAndViewRect, &destAndViewRect, weFlags, &we));

	::SetPort(oldPort);									// Make sure we restore the port before we
														// might throw an exception
	::WEInstallTabHooks(we);							// Install tab hooks to support tabs.

	ThrowIfNULL_AC(we);
	SetWEReference(we);									// Save reference

	SetJustification(fJustification, kDontRedraw);		// Set justification to requested value
	SetWrap(fAutoWrap, kDontRedraw);					// Install auto wrap (or <CR> only)

	FailNoReserve();									// Got to have some reserve tank

	BeInPort(GetGrafPort());							// Associate with real port
}

//----------------------------------------------------------------------------------------
// TWEView::OffsetToLine:
//----------------------------------------------------------------------------------------

SInt32 TWEView::OffsetToLine(SInt32 offset)
{
	return ::WEOffsetToLine(offset, fWE);
}

//----------------------------------------------------------------------------------------
// TWEView::OffsetToLineStart:
//----------------------------------------------------------------------------------------

SInt32 TWEView::OffsetToLineStart(SInt32 offset)
{
	if (::WECountLines(fWE) <= 1)
		return 0;
	else
	{
		SInt32 lineStart;
		::WEGetLineRange(OffsetToLine(offset), &lineStart, NULL, fWE);
		return lineStart;
	}
}

//----------------------------------------------------------------------------------------
// TWEView::OffsetToLineEnd:
//----------------------------------------------------------------------------------------

SInt32 TWEView::OffsetToLineEnd(SInt32 offset)
{
	if (::WECountLines(fWE) <= 1)
		return ::WEGetTextLength(fWE);
	else
	{
		SInt32 lineEnd;
		::WEGetLineRange(OffsetToLine(offset), NULL, &lineEnd, fWE);
		return lineEnd;
	}
}

//----------------------------------------------------------------------------------------
// TWEView::OffsetToPt:
//----------------------------------------------------------------------------------------

CViewPoint TWEView::OffsetToPt(SInt32 offset)
{
	WERunInfo	runInfo;
	LongPt		theLongPoint;
	CPoint_AC	thePoint;	// has short coordinates

	::WEGetRunInfo(offset, &runInfo, fWE);

	if (::WEGetTextLength(fWE) <= 0)
	{
		thePoint = fInset[topLeft].ToPoint();
		thePoint.v += runInfo.runAscent;
		::WEPointToLongPoint(thePoint, &theLongPoint);	// stuff into theLongPoint
	}
	else
	{
		SInt16 lineHeight;
		::WEGetPoint(offset, hilite, &theLongPoint, &lineHeight, fWE);
		theLongPoint.v += runInfo.runAscent - runInfo.runHeight;
	}

	::WELongPointToPoint(&theLongPoint, thePoint);		// stuff into thePoint (long->short !!!)
	return QDToView(thePoint);
}

//----------------------------------------------------------------------------------------
// TWEView::PtToOffset:
//----------------------------------------------------------------------------------------

SInt32 TWEView::PtToOffset(const CViewPoint& aPoint)
{
	LongPt		theLongPoint;
	WEEdge		theEdge;

	CPoint_AC aQDPoint(ViewToQD(aPoint));
	::WEPointToLongPoint(aQDPoint, &theLongPoint);
	return ::WEGetOffset(&theLongPoint, &theEdge, fWE);
}

//----------------------------------------------------------------------------------------
// TWEView::SuperViewChangedFrame: 
//----------------------------------------------------------------------------------------

void TWEView::SuperViewChangedFrame(const CViewRect& oldFrame, const CViewRect& newFrame, bool invalidate)
{
	TView::SuperViewChangedFrame(oldFrame, newFrame, invalidate);

	if (oldFrame != newFrame)
	{
		AdjustWERects();
		RecalcText();
		SynchView(kDontRedraw);
	}

	if (invalidate)
		ForceRedraw();
} 

//----------------------------------------------------------------------------------------
// TWEView::RecalcText:
//----------------------------------------------------------------------------------------

void TWEView::RecalcText()
{
	LongRect	weViewRect;
	LongRect	savedViewRect;

	// • Save and restore view rect while doing WECalText
	CViewRect visRect = GetDrawableRect();
	::WEGetViewRect(&savedViewRect, fWE);	// save current view rect

	::WESetLongRect(&weViewRect, visRect.left, visRect.top, visRect.right, visRect.bottom);
	::WESetViewRect(&weViewRect, fWE);
	ThrowIfOSErr_AC(::WECalText(fWE));		// This puppy can take a long time for large text

	::WESetViewRect(&savedViewRect, fWE);	// Restore view rect
}

//----------------------------------------------------------------------------------------
// TWEView::ResignedWindowTarget:
//----------------------------------------------------------------------------------------

void TWEView::ResignedWindowTarget() // override
{
	DoHighlightSelection(fActiveHL, hlDim);
	fActiveHL = hlDim;

	TView::ResignedWindowTarget();
}

//----------------------------------------------------------------------------------------
// TWEView::ResignedTarget:
//----------------------------------------------------------------------------------------

void TWEView::ResignedTarget() // override
{
	SetActive(false);

	TView::ResignedTarget();
}

//----------------------------------------------------------------------------------------
// TWEView::InvalidateFrameDifference:
//----------------------------------------------------------------------------------------

void TWEView::InvalidateFrameDifference(const CViewRect& oldFrame, const CViewRect& newFrame)
{
	// Account for the inset

	CViewRect theOldFrame(oldFrame[topLeft] + fInset[topLeft], oldFrame[botRight] - fInset[botRight]);
	CViewRect theNewFrame(newFrame[topLeft] + fInset[topLeft], newFrame[botRight] - fInset[botRight]);

	TView::InvalidateFrameDifference(theOldFrame, theNewFrame);
}

//----------------------------------------------------------------------------------------
// TWEView::AdjustWERects:
// WASTE clips to the view rect when drawing. If the view rect is larger than the frame,
// drawing will spill over, like into the scrollbar areas. Only do this for typable text
// and when not printing. We also correct the destination rect for gLongOffset for large
// views.
//----------------------------------------------------------------------------------------

void TWEView::AdjustWERects()
{
	LongRect	weDestRect;
	TScroller	*scroller;

	// • If we can’t focus, we’ll calculate garbage!
	if (!Focus())
		return;

	// • Adjust view rect
	if (/*fAcceptsChanges &&*/ !gPrinting)
	{
		CViewRect myFrame(GetFrame());
		CViewRect superFrame(fSuperView->GetFrame());
		superFrame.Offset(-superFrame.left, -superFrame.top);	// Offset to (0, 0)

		CViewRect tempRect;
		tempRect = myFrame & superFrame;

		scroller = GetScroller(kAnySuperView);
		if (scroller != NULL)
		{
			if (scroller != fSuperView)
			{
				superFrame = scroller->GetFrame();
				superFrame.Offset(-superFrame.left, -superFrame.top);	// Offset to 0,0
				tempRect = tempRect & superFrame;
			}
			CViewPoint translation(scroller->GetTranslation());
			tempRect.Offset(translation.h - fViewToQDOffset.h, translation.v - fViewToQDOffset.v);
		}
		
		StuffWEViewRect(tempRect);					// Some additional work has to be done for the view rect
	}

	// • Adjust dest rect
	::WESetLongRect(&weDestRect, fInset.left, fInset.top, fSize.h - fInset.right, fSize.v - fInset.bottom);
	::WEOffsetLongRect(&weDestRect, -fViewToQDOffset.h, -fViewToQDOffset.v);
	::WESetDestRect(&weDestRect, fWE);// Tell WASTE about the change

	// • When printing, allow a full view.
	if (gPrinting)
		::WESetViewRect(&weDestRect, fWE);// Tell WASTE about the change
}

//----------------------------------------------------------------------------------------
// TWEView::RedrawBelow:
// Special case: if user types a <CR> and the last character in text is <CR>,
// do a special redraw.
//----------------------------------------------------------------------------------------

void TWEView::RedrawBelow()
{
	SInt32 textLength = ::WEGetTextLength(fWE);
	Handle text = ::WEGetText(fWE);
	bool lastIsCR = (textLength == 0);
	if (textLength != 0)
	{
		Ptr c = Ptr(((unsigned long)(*text)) + (textLength - 1));
		lastIsCR = (char)(*c) == chReturn;
	}

	if (lastIsCR)
	{
		SInt32 selStart;
		SInt32 selEnd;
		::WEGetSelection(&selStart, &selEnd, fWE);
		CViewRect myExtent(GetExtent());
		LongPt screenPoint;
		short height;
		::WEGetPoint(selEnd, hilite, &screenPoint, &height, fWE);
		myExtent.top = screenPoint.v;
		Invalidate(myExtent);
	}
}

//----------------------------------------------------------------------------------------
// TWEView::SetFrame:
// Installs the new size for both the View and WASTE
//----------------------------------------------------------------------------------------

void TWEView::SetFrame(const CViewRect& newFrame, bool invalidate) // override
{
	CViewPoint oldSize(fSize);

	TView::SetFrame(newFrame, invalidate);

	if (fWE && (fSize != oldSize) && Focus())
	{
		CViewRect newViewRect;
		newViewRect.top = fInset.top;
		newViewRect.left = fInset.left;
		newViewRect.right = fSize.h - fInset.right;
		newViewRect.bottom = fSize.v - fInset.bottom;

		LongRect weDestRect;
		::WEGetDestRect(&weDestRect, fWE);
		
		bool needCalText = (fSize.h != oldSize.h) || newViewRect.right != weDestRect.right;

		AdjustWERects();							// Set new view/dest rects

		if (needCalText)
		{
			RecalcText();
			SynchView(kDontRedraw);
			short actualJust = GetActualJustification(fJustification);
			if (invalidate && ((fAutoWrap && (fSize != oldSize)) || ((actualJust == teFlushRight) || (actualJust == teCenter))))
				ForceRedraw();
		}
	}
}

//----------------------------------------------------------------------------------------
// TWEView::ScrollSelectionIntoView:
//----------------------------------------------------------------------------------------

void TWEView::ScrollSelectionIntoView(bool redraw) // override
{
	if ((GetScroller(kAnySuperView) != NULL) && Focus())// Can’t scroll selection if we don’t have a scroller!
	{
		if (fIdleFreq == kMaxIdleTime)
			SetIdleFreq(0);							// Idle ASAP
		CViewRect selectionRect;
		CalcSelLoc(selectionRect);

#if qDebugMsg
		if (gIntenseDebugging)
		{
			ProgramReport_AC("Visible CRect_AC was: %s", GetVisibleRect().AsText());
			ProgramReport_AC("; Sel CRect_AC was: %s\n", selectionRect.AsText());
		}
#endif

		if (!GetVisibleRect().Contains(selectionRect))
		{
			// Scroll the selection into view accounting for the user’s preference for
			// how much to jump at a time with fMinAhead.
			CViewPoint minToSee(Min_AC(fMinAhead, fSize.h - selectionRect.left), selectionRect.GetLength(vSel) + fInset.bottom);
#if qDebug
			if (gIntenseDebugging)
			{
				ProgramReport_AC("RevealRect: r = %s", selectionRect.AsText());
				ProgramReport_AC(", minToSee = %s\n", minToSee.AsText());
			}
#endif

//			OffsetVRect(selectionRect, fViewToQDOffset.h, fViewToQDOffset.v);
//			selectionRect.Offset(fViewToQDOffset.h, fViewToQDOffset.v);
			RevealRect(selectionRect, minToSee, redraw);
			Focus();							// Refocus in newly-scrolled position.
		}
	}
	else if (!fAutoWrap && fWE)
		::WESelView(fWE);
}

//----------------------------------------------------------------------------------------
// TWEView::SetJustification:
//----------------------------------------------------------------------------------------

void TWEView::SetJustification(WEAlignment newJust, bool redraw)
{
	::WESetAlignment(newJust, fWE);
	fJustification = newJust;

	AdjustWERects();								// Set new view/dest rects

	if (redraw)
		ForceRedraw();
}

//----------------------------------------------------------------------------------------
// TWEView::SetOneStyle:
//----------------------------------------------------------------------------------------

void TWEView::SetOneStyle(SInt32 theStart, 
						  SInt32 theEnd, 
						  WEStyleMode theMode, 
						  const CTextStyle_AC& theStyle, 
						  bool redraw)
{
	CWhileOutlinePreferred_AC setOP(fPreferOutline);

	InvalidateFocus();
	Focus();

	SInt32 saveStart;
	SInt32 saveEnd;
	::WEGetSelection(&saveStart, &saveEnd, fWE);
	SetWESelect(theStart, theEnd, fWE);
	ThrowIfOSErr_AC(::WESetStyle(theMode, &theStyle, fWE));
	SetWESelect(saveStart, saveEnd, fWE);

	RecalcText();
	SynchView(redraw);
	fSpecsChanged = true;
}

//----------------------------------------------------------------------------------------
// TWEView::SetSelection:
//----------------------------------------------------------------------------------------

void TWEView::SetSelection(SInt32 newSelStart, SInt32 newSelEnd, bool redraw)
{
	if (redraw && Focus())
	{
		CWhileOutlinePreferred_AC setOP(fPreferOutline);
		::WESetSelection(Max_AC(newSelStart, 0), Min_AC(newSelEnd, ::WEGetTextLength(fWE)), fWE);
// still have problems with redoing typing of Japanese text

#if qDrag
		if (GetDraggable())
			gDispatcher->InvalidateMouseRegions();
#endif
	}
	else
		SetWESelect(newSelStart, newSelEnd, fWE);
//		SetWESelect(Max_AC(newSelStart, 0), Min_AC(newSelEnd, ::WEGetTextLength(fWE)), fWE);

	if (newSelStart == newSelEnd)
		fSelAnchor = newSelStart;

	fSpecsChanged = true;
}

//----------------------------------------------------------------------------------------
// TWEView::SetText:
//----------------------------------------------------------------------------------------

void TWEView::SetText(const CStr255_AC& theText)
{
	if (fWE)							// If we're replacing text, styles are kaput
	{
		CStr255_AC localText(theText);
		OSErr err;

		bool allocationState = TemporaryAllocation(false);
		Handle theTextHandle;
		err = PtrToHand((Ptr)&localText[1], &theTextHandle, theText.Length());
		TemporaryAllocation(allocationState);

		ThrowIfOSErr_AC(err);

		StuffText(theTextHandle);

		// Set the insertion point to the end of the text.
		long textLength = GetHandleSize(theTextHandle);
		SetSelection(textLength, textLength, kDontRedraw);
	}
}

//----------------------------------------------------------------------------------------
// TWEView::ShowReverted:
//----------------------------------------------------------------------------------------

void TWEView::ShowReverted() // override
{
	RecalcText();
	fLastHeight = 0;
	fLastWidth = 0;
	TView::ShowReverted();
}

//----------------------------------------------------------------------------------------
// TWEView::SpaceForStyles:
//----------------------------------------------------------------------------------------

bool TWEView::SpaceForStyles(SInt32 rangeStart, SInt32 rangeEnd)
{
	bool returnVal = false;

	try
	{
		Handle h = NewPermHandle(0);
		OSErr err = ::WECopyRange(rangeStart, rangeEnd, NULL, (StScrpHandle)h, NULL, fWE);// Let WASTE resize the handle
		h = DisposeIfHandle_AC(h);						// Release memory back to the system
		ThrowIfOSErr_AC(err);
		returnVal = true;
	}
	catch (CException_AC& theException)
	{
		DoCatchMessage_AC(theException);
		StdAlert(phStylesTooBig);
		// Don’t resignal in this case
	}

	return returnVal;
}

//----------------------------------------------------------------------------------------
// TWEView::StuffText:
//----------------------------------------------------------------------------------------

void TWEView::StuffText(Handle theText)
{
	if (fWE)
	{
		long newTextLength = GetHandleSize(theText);	// Check size of new text
		if (newTextLength > fMaxChars)
		{
#if qDebug
			ProgramBreak_AC("Text size exceeds maximum for this view");
#endif

			ThrowException_AC(minErr, 0);
		}

		SInt32	oldStart;
		SInt32	oldEnd;
		::WEGetSelection(&oldStart, &oldEnd, fWE);

		// Remember where the selection range was & try to keep it in the same state when
		// the new text is added. Usually, the selection range should be in one of three
		// states: at the beginning of the text, at the end of the text, or covering all
		// of the text (everything selected). This isn’t enforced, though.
		if ((oldStart >= newTextLength) || (oldStart >= ::WEGetTextLength(fWE)))
			oldStart = newTextLength;
		if ((oldEnd >= newTextLength) || (oldEnd >= ::WEGetTextLength(fWE)))
			oldEnd = newTextLength;

		// Set the selection range to cover the entire text, then call WESetStyle to fix
		// up the style table.

		SetWESelect(0, kWEUnlimited, fWE);
		ThrowIfOSErr_AC(::WESetStyle(weDoAll, &fTextStyle, fWE));

		if (fSavedWEHandle != theText && ::WEGetText(fWE) != theText)
		{
			// • WEUseText() disposes of the old text handle so we need to make a copy first.
			Handle original = ::WEGetText(fWE);// Get existing handle
			fSavedWEHandle = DisposeIfHandle_AC(fSavedWEHandle);// …we have no choice but to dispose it
			PermHandToHand(original);					// Copy original handle before WASTE kills it
			fSavedWEHandle = original;					// Make a copy of its location here
			ThrowIfOSErr_AC(::WEUseText(theText, fWE));// Install new handle
		}

		fText = theText;								// Cache a local copy, too

		AdjustWERects();
		RecalcText();
		SynchView(kDontRedraw);
		ForceRedraw();

		SetWESelect(oldStart, oldEnd, fWE);// Restore the old selection
	}
}

//----------------------------------------------------------------------------------------
// TWEView::StyleInsert - copied from TTEView::StyleInsert
//----------------------------------------------------------------------------------------

void TWEView::StyleInsert(const void *text, long length, StScrpHandle hST)
{
	if (hST)
	{
		TemplateTempHandle<StScrpHandle> singleStyle((StScrpHandle)::NewPermHandle(sizeof(short) + sizeof(ScrpSTElement)));
		(*singleStyle)->scrpNStyles = 1;

		short numRuns = (*hST)->scrpNStyles;
		Ptr singleText = static_cast<Ptr>(const_cast<void*>(text));
		for(long i = 0; i < numRuns; ++i)
		{
			(*singleStyle)->scrpStyleTab[0] = (*hST)->scrpStyleTab[i];
			// Here's the real key, setting the KeyScript to match the font in the style run
			::KeyScript(FontToScript((*singleStyle)->scrpStyleTab[0].scrpFont));

			long runLength;
			if (i + 1 < numRuns)
				runLength = (*hST)->scrpStyleTab[i + 1].scrpStartChar - (*singleStyle)->scrpStyleTab[0].scrpStartChar;
			else
				runLength = length - (*singleStyle)->scrpStyleTab[0].scrpStartChar;

			(*singleStyle)->scrpStyleTab[0].scrpStartChar = 0;
			::WEInsert(singleText, runLength, singleStyle, NULL, fWE);
			singleText += runLength;
		}
	}
	else
		::WEInsert(text, length, hST, NULL, fWE);
}

//----------------------------------------------------------------------------------------
// TWEView::StuffWEViewRect - analogous to TTEView::StuffTERects
//----------------------------------------------------------------------------------------

void TWEView::StuffWEViewRect(const CViewRect& newViewRect)
{
	// N.B. Assumes we have the Focus
	// Twiddle the view rect so that characters aren’t cut off on the left or right on tiny views

	CWhileOutlinePreferred_AC setOP(fPreferOutline);

	FontInfo	aFontInfo;
	short		theFontHeight;
	LongRect	weViewRect;

	GetTextStyleFontInfo(fTextStyle, aFontInfo, theFontHeight);

	CViewRect localRect(newViewRect);
	short actualJust = GetActualWEJustification(fJustification);
	if ((GetSizeDeterminer(hSel) == sizeVariable) && (actualJust != weCenter) && !fAutoWrap)
	{
		if ((actualJust == weFlushLeft) || (actualJust == weDirLeftToRight))
			localRect.right += aFontInfo.widMax;
		else
			localRect.left -= aFontInfo.widMax;
	}
	else
		localRect.right = Max_AC(localRect.right, localRect.left + aFontInfo.widMax);

	// • Tell the WASTE engine
	::WESetLongRect(&weViewRect, localRect.left, localRect.top, localRect.right, localRect.bottom);
	::WESetViewRect(&weViewRect, fWE);
}

//----------------------------------------------------------------------------------------
// TWEView::SynchView:
//----------------------------------------------------------------------------------------

void TWEView::SynchView(bool redraw)
{
	static bool		reentered = false;		// Used to prevent inadvertant recursion.
	const short		kInsertionBarWidth = 1;	// insertion bar is one pixel wide

	SInt32 theHeight = CalcRealHeight();
	SInt32 theWidth = fLastWidth;	// •••  ??? Otherwise it's not initialized

	bool doRealWidth = (GetSizeDeterminer(hSel) == sizeVariable) && !fAutoWrap;
	if (doRealWidth)
		theWidth = CalcRealWidth() + kInsertionBarWidth * 2;

	if ((fLastHeight != theHeight) || (doRealWidth && (fLastWidth != theWidth)))
	{
		if (doRealWidth)
			fLastWidth = theWidth;		// Width is expensive to calculate. Cache for CalcMinFrame

		if (!reentered)
		{
			reentered = true;			// Prevent inadvertant recursion.
			AdjustFrame();				// May need to grow view
			reentered = false;
		}
		fLastHeight = theHeight;		// Remember new height value
	}

	// First, make sure selection is visible (this conveniently focuses). Then, repair any
	// extra feedback which WASTE may have mashed.
	if (redraw && Focus())
	{
		ScrollSelectionIntoView(redraw);
		DoHighlightSelection(hlOff, GetCurrentHL());
		if (GetPrintHandler())
			DoDrawPrintFeedback(GetDrawableRect());
	}
}

//----------------------------------------------------------------------------------------
// TWEView::UpdateCoordinates:
//----------------------------------------------------------------------------------------

void TWEView::UpdateCoordinates() const
{
	CPoint_AC		oldQDOrigin(fQDOrigin);
	CViewPoint		oldViewToQDOffset(fViewToQDOffset);

	TView::UpdateCoordinates();

	if (fQDOrigin != oldQDOrigin || fViewToQDOffset != oldViewToQDOffset)
		if (fWE)
		{
			TWEView* nonConstThis = const_cast<TWEView*>(this);
			nonConstThis->AdjustWERects();				// Set new view/dest rects
		}
}

//----------------------------------------------------------------------------------------
// TWEView::WriteToDeskScrap:
//----------------------------------------------------------------------------------------

void TWEView::WriteToDeskScrap()
{
	SInt32 saveStart;
	SInt32 saveEnd;
	::WEGetSelection(&saveStart, &saveEnd, fWE);// save current selection
	SetWESelect(0, kWEUnlimited, fWE);	// Select all the text

	OSErr err = WECopy(fWE);

	SetWESelect(saveStart, saveEnd, fWE);// restore previous selection

	ThrowIfOSErr_AC(err);
}

//----------------------------------------------------------------------------------------
// TWEView::StuffStyleScrapHandle
//----------------------------------------------------------------------------------------

void TWEView::StuffStyleScrapHandle(Handle hStyles)
{
	SInt32 saveStart;
	SInt32 saveEnd;
	::WEGetSelection(&saveStart, &saveEnd, fWE);// save current selection
	SetWESelect(0, kWEUnlimited, fWE);			// Select all the text

	OSErr err = ::WEUseStyleScrap((StScrpHandle) hStyles, fWE);

	SetWESelect(saveStart, saveEnd, fWE);		// restore previous selection
	ThrowIfOSErr_AC(err);
}

//----------------------------------------------------------------------------------------
// TWEView::StuffTextAndStyles
//----------------------------------------------------------------------------------------

void TWEView::StuffTextAndStyles(Handle docText, Handle hStyles, Handle hSoup)
{
	SetWESelect(0, kWEUnlimited, fWE);			// Select all the text
	long textSize = ::GetHandleSize(docText);
	CTempHLock_AC docTextLock(docText);
	OSErr err = ::WEInsert(*docText, textSize, (StScrpHandle)hStyles, hSoup, fWE);
	ThrowIfOSErr_AC(err);
}

//----------------------------------------------------------------------------------------
// TWEView::SetActive:
//----------------------------------------------------------------------------------------

void TWEView::SetActive(bool state)
{
	CWhileOutlinePreferred_AC setOP(fPreferOutline);

	if (fWE && Focus())						// Try to focus because TEActivate/TEDeactivate may draw
	{
		SInt32 selStart;
		SInt32 selEnd;
		::WEGetSelection(&selStart, &selEnd, fWE);

		if (state)
		{
			bool selectionWasHidden = (!fAcceptsChanges && selStart == selEnd);
			short oldHilite;
			if (selectionWasHidden)
				oldHilite = WEFeatureFlag(weFOutlineHilite, weBitClear, fWE);

			if (fIdleFreq == kMaxIdleTime)
				SetIdleFreq(0);								// Idle ASAP
			::KeyScript(FontToScript(fTextStyle.tsFont));
			::WEActivate(fWE);
			fgCurrWEView = this;							// So the global clickLoop routine can forward

			if (selectionWasHidden)
				WEFeatureFlag(weFOutlineHilite, oldHilite, fWE);
		}
		else
		{
			bool hideSelection = (!fAcceptsChanges && selStart == selEnd);
			short oldHilite;
			if (hideSelection)
				oldHilite = WEFeatureFlag(weFOutlineHilite, weBitClear, fWE);
			::WEDeactivate(fWE);
			DoneTyping();
			if (hideSelection)
				WEFeatureFlag(weFOutlineHilite, oldHilite, fWE);
			fSpecsChanged = true;
		}
	}
} 

//----------------------------------------------------------------------------------------
// TWEView::SetEnable:
//----------------------------------------------------------------------------------------

void TWEView::SetEnable(bool state)
{
	if (state && (fIdleFreq == kMaxIdleTime))
		SetIdleFreq(0);							// Get correct idle set ASAP

	TView::SetEnable(state);
}

//----------------------------------------------------------------------------------------
// TWEView::WordBounds:
//----------------------------------------------------------------------------------------

bool TWEView::WordBounds(SInt32 charPos, SInt32& wordStart, SInt32& wordEnd)
{
	bool returnVal = false;

	wordStart = charPos;
	wordEnd = charPos;

	if (!((charPos < 0) || (charPos > WEGetTextLength(fWE) - 1)))
	{
		short i;
		do
		{
			i = ::WECharByte(charPos++, fWE);
		} while ((i == smFirstByte) || (i == smMiddleByte));

		OffsetTable offs;
		FindWordBreaks((*fText), ::WEGetTextLength(fWE), --charPos, true, NULL, offs, smRoman);
		wordStart = Min_AC(offs[0].offFirst, offs[0].offSecond - 1);
		wordEnd = Max_AC(offs[0].offFirst, offs[0].offSecond - 1);
		returnVal = ((wordStart < wordEnd) || (::CharacterType((*fText), wordStart, smRoman) % 8 != smCharPunct));
	}

	return returnVal;
}

//----------------------------------------------------------------------------------------
// TWEView::SetReadOnly
//----------------------------------------------------------------------------------------

void TWEView::SetReadOnly(bool readOnly)
{
	if (fAcceptsChanges == readOnly)
	{
		::WEFeatureFlag(weFReadOnly, weBitToggle, fWE);
		fAcceptsChanges = !readOnly;
	}
}

//----------------------------------------------------------------------------------------
// TWEView::GetZoom
//----------------------------------------------------------------------------------------

Fixed TWEView::GetZoom() const
{
	Fixed zoom = fixed1;

	if (fWE)
	{
		CPoint_AC numer;
		CPoint_AC denom;
		::WEGetScale(&numer, &denom, fWE);
		zoom = FixRatio(numer.v, denom.v);
	}

	return zoom;
}

//----------------------------------------------------------------------------------------
// TWEView::SetZoom
//----------------------------------------------------------------------------------------

void TWEView::SetZoom(Fixed zoom)
{
	if (fWE && Focus())
	{
		CPoint_AC numer;
		CPoint_AC denom;
		FixToRatio(zoom, numer.v, denom.v);
		numer.h = numer.v;
		denom.h = denom.v;
		ThrowIfOSErr_AC(::WESetScale(numer, denom, fWE));
		AdjustFrame();
	}
}

//----------------------------------------------------------------------------------------
// WriteChar:
//----------------------------------------------------------------------------------------

#if qDebug

const SInt32 kMaxIndex = 2047;
typedef char x[kMaxIndex];
typedef x* XPtr;
typedef XPtr* XHandle;

void TWEView::WriteChar(short index, Handle hText)
{
	if (index <= kMaxIndex)
		ProgramReport_AC("[%1d:%1d]", index, *((XHandle)hText)[index]);
}

#endif	// qDebug

//----------------------------------------------------------------------------------------
// DumpWERecord:
//----------------------------------------------------------------------------------------

#if qDebug

void TWEView::DumpWERecord(WEReference we)
{
	CViewRect		aVRect;
	WERunInfo		runInfo;
	LongRect		lr;
	SInt32			size;
	GrafPtr			itsPort = NULL;
	const SInt32	kMaxCharsToPrint = 100;

	// • Dest/View rects
	::WEGetDestRect(&lr, we);
	aVRect.Set(lr.left, lr.top, lr.right, lr.bottom);
	ProgramReport_AC("WE -- Destination Rectangle: %s\n", aVRect.AsText());
	::WEGetViewRect(&lr, we);
	aVRect.Set(lr.left, lr.top, lr.right, lr.bottom);
	ProgramReport_AC("             View Rectangle: %s\n", aVRect.AsText());

	// • Text info
	size = ::WEGetTextLength(we);
	::WEGetRunInfo(0, &runInfo, we);
	ProgramReport_AC("Line ht: %1d", runInfo.runHeight);
	ProgramReport_AC("; text Length: %1d", size);
	ProgramReport_AC("; hText length: %1d", GetHandleSize(::WEGetText(we)));
	ProgramReport_AC("; lines: %1d", ::WECountLines(we));
	ProgramReport_AC("\n");

	if (gIntenseDebugging)
	{
		Handle hText = ::WEGetText(we);

		ProgramReport_AC("Chars: ");
		SInt32 minSize = Min_AC(kMaxIndex, size - 1);
		for (short i = 0; i <= Min_AC(kMaxCharsToPrint, minSize); ++i)
		{
			WriteChar(i, hText);
			if (i % 10 == 9)
				ProgramReport_AC("\n");
		}
		ProgramReport_AC("\n");

#if !qCarbon
		// • GrafPort information
		OSErr err = ::WEGetInfo(wePort, &itsPort, we);
		if (err == noErr)
		{
			ProgramReport_AC("InPort vis bbox: %s", ((CRect_AC &)(**(itsPort->visRgn)).rgnBBox).AsText());
			ProgramReport_AC("; clip bbox: %s\n", ((CRect_AC &)(**(itsPort->clipRgn)).rgnBBox).AsText());
		}

		if (itsPort != qd.thePort)
		{
			ProgramReport_AC("thePort vis bbox: %s", ((CRect_AC &)(**(qd.thePort->visRgn)).rgnBBox).AsText());
			ProgramReport_AC("; clip bbox: %s\n", ((CRect_AC &)(**(qd.thePort->clipRgn)).rgnBBox).AsText());
		}
#endif
	}
} // DumpWERecord
#endif	// qDebug

//----------------------------------------------------------------------------------------
// GetActualWEJustification:
//----------------------------------------------------------------------------------------

short TWEView::GetActualWEJustification(short justification)
// Convert justification to appropriate WASTE justification value.
{
	if (justification == weFlushDefault)
		return ::GetSysDirection();	// returns 0 for left-to-right, -1 for right-to-left
	else
		return justification;
}

//----------------------------------------------------------------------------------------
// SetWESelect:
//----------------------------------------------------------------------------------------

void TWEView::SetWESelect(SInt32 theStart, SInt32 theEnd, WEReference we)
// SetWESelect: Usually, TWEView::SetSelection should be used instead. This
// procedure is used by MacApp to set the selection 'behind the scenes' (that is,
// in instances where an O.S. routine operates on the current selection, but we
// want to change a piece of the text without changing the selection).
//
// N.B. We can’t set the selection behind the back of the WASTE engine.
{
	theStart = Max_AC(theStart, 0);
	theEnd = MinMax_AC(theStart, theEnd, WEGetTextLength(we));
	if (theStart > theEnd)
		theStart = theEnd;
	::WESetSelection(theStart, theEnd, we);
}

//----------------------------------------------------------------------------------------
// ClickLoopForTWEView:
//----------------------------------------------------------------------------------------

pascal Boolean TWEView::ClickLoopForTWEView(WEReference we)
{
	return fgCurrWEView ? fgCurrWEView->ClickLoop(we) : true;
} 

//----------------------------------------------------------------------------------------
// TWEView::DoSetCursor - call SetTSMCursor before SetCursor
//----------------------------------------------------------------------------------------

void TWEView::DoSetCursor(const CViewPoint& localPoint, RgnHandle cursorRegion)
{
#if qDebug
	AssumeFocused();
#endif

#if qDrag
	RgnHandle dragCursorRegion = NULL;
	if (HasDragManager_AC())
	{
		if (!DoSetDragCursor(localPoint, cursorRegion, dragCursorRegion))
#endif

			{
				ResNumber theCursorID = GetCursorID();
				if (theCursorID != kNoResource)
				{
					CPoint_AC localQDPoint(ViewToQD(localPoint));
					if (PtInRgn(localQDPoint, cursorRegion))
					{
						CursHandle aCursor = GetCursor(theCursorID);
						::ThrowIfNULLResource_AC((Handle)aCursor);
						MySetTSMCursor(gGlobalMouseForCursor, *aCursor);	// SetCursor(*aCursor);
					}
					else
#if qCarbon
						SetCursorToArrow_AC();
#else
						MySetTSMCursor(gGlobalMouseForCursor, &(qd.arrow));	// SetCursor(&(qd.arrow));
#endif
				}
				else
#if qCarbon
					SetCursorToArrow_AC();
#else
					MySetTSMCursor(gGlobalMouseForCursor, &(qd.arrow));	// SetCursor(&(qd.arrow));
#endif

#if qDrag
				// remove the drag region from the cursor region so the cursor
				// will be updated if it moves into or out of the drag region
				if (dragCursorRegion)
					DiffRgn(cursorRegion, dragCursorRegion, cursorRegion);
#endif

			}
#if qDrag
	}
	DisposeIfRgnHandle(dragCursorRegion);
#endif

	// If you claim the cursor don't forget to _PROPERLY_ calculate the cursorRegion or
	// WaitNextEvent might give you a lovely mouse-moved event shower. (Lather up!)

	// P.S. In debug this is checked for in our original caller: TApplication.TrackMouse.

	// If you need to do any direct drawing or other good stuff put it in an override
	
	fgSetCursorView = this; // It's us, we claimed it
}

//========================================================================================
//	Drag and Drop support
//========================================================================================
#if qDrag

//----------------------------------------------------------------------------------------
// TWEView::DoMakeDragDropCommand:
//----------------------------------------------------------------------------------------

TCommand* TWEView::DoMakeDragDropCommand(CommandNumber itsCommandNumber,
										 CDragItemIterator& dragItemIterator,
										 TDragTracker* targetTracker)
{
	TCommand* returnCommand = NULL;

	switch (itsCommandNumber)
	{
		case cDrag:
			returnCommand = TH_new TWECommand(this, itsCommandNumber, true);
			break;

		case cDrop:
			{
				TDragItem* firstItem = dragItemIterator.First();
				if (firstItem->FlavorExists(kTextType_AC))
					returnCommand = TH_new TWEDragDropCommand(this, itsCommandNumber, firstItem, fLastCaretOffset);
				else if (firstItem->FlavorExists(kPictType_AC))
					returnCommand = TH_new TWEDropObjectCommand(this, kPictType_AC, firstItem, fLastCaretOffset);
				else
					ThrowError_AC(badDragFlavorErr);
			}
			break;

		case cDragMove:
			if (fLastCaretOffset != -1)		// can't drop into selection
				returnCommand = TH_new TWEDragMoveCommand(this, itsCommandNumber, fLastCaretOffset);
			break;

		default:
			break;
	}

	if (!returnCommand)
		returnCommand = TView::DoMakeDragDropCommand(itsCommandNumber, dragItemIterator, 
													 targetTracker);

	return returnCommand;
}

//----------------------------------------------------------------------------------------
// TWEView::DoMakeDragCursorRegion:
//----------------------------------------------------------------------------------------

RgnHandle TWEView::DoMakeDragCursorRegion()
{
	RgnHandle dragCursorRegion = NULL;

	if (HasDragManager_AC())
	{
		CWhileOutlinePreferred_AC setOP(fPreferOutline);
		SInt32 rangeStart, rangeEnd;
		::WEGetSelection(&rangeStart, &rangeEnd, fWE);
		dragCursorRegion = ::WEGetHiliteRgn(rangeStart, rangeEnd, fWE);
	}

	return dragCursorRegion;
}

//----------------------------------------------------------------------------------------
// TWEView::DoDragEnter:
//----------------------------------------------------------------------------------------

void TWEView::DoDragEnter()
{
	fLastCaretOffset = 0;
	fLastCaretTime = 0L;
	fCaretIsShown = false;

	if (TDragDropSession::fgDragDropSession->GetCurrentDragSource() == this)
	{
		CWhileOutlinePreferred_AC setOP(fPreferOutline);
		SInt32 rangeStart, rangeEnd;
		::WEGetSelection(&rangeStart, &rangeEnd, fWE);
		fHiliteRgn = ::WEGetHiliteRgn(rangeStart, rangeEnd, fWE);
		::ThrowIfNULL_AC(fHiliteRgn);
	}
}

//----------------------------------------------------------------------------------------
// TWEView::DoDragLeave:
//----------------------------------------------------------------------------------------

void TWEView::DoDragLeave()
{
	if (fCaretIsShown)
		DrawCaret(fLastCaretOffset);

	if (fHiliteRgn)
		fHiliteRgn = DisposeIfRgnHandle(fHiliteRgn);
}

//----------------------------------------------------------------------------------------
// TWEView::DoDragWithin:
//----------------------------------------------------------------------------------------

void TWEView::DoDragWithin(const CViewPoint& localMouse)
{
	unsigned long currentTime = TickCount();
	SInt32 offset = -1;
	bool caretMoved = true;

	// if this view is the source and the target of the drag, don't allow dropping
	// into the selection
	if (fHiliteRgn && PtInRgn(ViewToQD(localMouse), fHiliteRgn))
	{
		if (fLastCaretOffset != -1)
		{
			offset = -1;
			caretMoved = true;					// force redraw
		}
	}
	else
	{
		offset = PtToOffset(localMouse);
		caretMoved = (fLastCaretOffset != offset);
	}

	if (caretMoved && fCaretIsShown)
		DrawCaret(fLastCaretOffset);

	if (caretMoved || (currentTime - fLastCaretTime) > GetCaretTime())
	{
		if (offset != -1)
			DrawCaret(offset);
		fLastCaretOffset = offset;
		fLastCaretTime = currentTime;
	}
}

//----------------------------------------------------------------------------------------
// TWEView::DoAddDragContent:
//----------------------------------------------------------------------------------------

void TWEView::DoAddDragContent()
{
	TDragItem* dragItem = TDragDropSession::fgDragDropSession->AddDragItem(1);
	CFlavorFlags flags;

	WEObjectReference selectedObject = NULL;
	
	SInt32 selStart;
	SInt32 selEnd;
	::WEGetSelection(&selStart, &selEnd, fWE);
	WEGetSelectedObject(&selectedObject, fWE);

	if ((selEnd - selStart == 1) && selectedObject)
	{
		// We have only an object selected. Promise only the object data. 
		FlavorType objectType = WEGetObjectType(selectedObject);
		if (objectType == kPictType_AC)
			dragItem->PromiseFlavor(kPictType_AC, flags);
	}
	else
	{
		// Promise text
		dragItem->PromiseFlavor(kTextType_AC, flags);

		// Promise style if there is style information
		Handle styleHandle = (Handle) WEGetStyleScrapHandle(fWE);
		if (styleHandle)
		{
			dragItem->PromiseFlavor(kStyleType_AC, flags);
			::DisposeIfHandle_AC(styleHandle);
		}

		// Promise soup if there is at least one object in the selection
		long objectStart = WEFindNextObject(selStart, &selectedObject, fWE);
		if (selectedObject && (objectStart >= selStart) && (objectStart < selEnd))
			dragItem->PromiseFlavor('SOUP', flags);
	}
}

//----------------------------------------------------------------------------------------
// TWEView::DoFulfillPromise:
//----------------------------------------------------------------------------------------

void TWEView::DoFulfillPromise(TDragItem* promisedItem)
{
	SInt32 selStart;
	SInt32 selEnd;
	::WEGetSelection(&selStart, &selEnd, fWE);

	switch (promisedItem->GetFlavorType())
	{
		case kTextType_AC:
			{
				try
				{
					long byteCount = selEnd - selStart;
					CTempHandleLock_AC tempHandleLock(fText);
					char* textPtr = *fText + selStart;
					promisedItem->SetData(textPtr, byteCount);
				}
				catch (CException_AC& theException)
				{
					DoCatchMessage_AC(theException);
					theException.SetError(cantGetFlavorErr);
					throw;
				}
				
			}
			break;

		case kStyleType_AC:
			{
				try
				{
					CTempHandle_AC tempHandle = (Handle) WEGetStyleScrapHandle(fWE);
					::ThrowIfNULL_AC(tempHandle);

					promisedItem->SetDataFromHandle(tempHandle);
				}
				catch (CException_AC& theException)
				{
					DoCatchMessage_AC(theException);
					theException.SetError(cantGetFlavorErr);
					throw;
				}
				
			}
			break;

		case 'SOUP':
			{
				try
				{
					TemplateTempHandle<WESoupHandle> hSoup = reinterpret_cast<WESoupHandle>(NewHandle(0));
					::ThrowIfNULL_AC(hSoup);
					ThrowIfOSErr_AC(WECopyRange(selStart, selEnd, NULL, NULL, hSoup, fWE));
					promisedItem->SetDataFromHandle(hSoup);
				}
				catch (CException_AC& theException)
				{
					DoCatchMessage_AC(theException);
					theException.SetError(cantGetFlavorErr);
					throw;
				}
			}
			break;

		case kPictType_AC:
			{
				WEObjectReference selectedObject; 
				WEGetSelectedObject(&selectedObject, fWE);
				if (selectedObject)
				{
					Handle theDataHandle = WEGetObjectDataHandle(selectedObject);
					promisedItem->SetDataFromHandle(theDataHandle);
				}
			}
			break;

		default:
			TView::DoFulfillPromise(promisedItem);
			break;
	}
}

//----------------------------------------------------------------------------------------
// TWEView::DrawCaret:
//----------------------------------------------------------------------------------------

void TWEView::DrawCaret(SInt32 offset)
{
	//	Get the coordinates and the line of the offset to draw the caret.
	SInt16 direction = hilite;					// SysDirection
	LongPt thePoint;
	SInt16 lineHeight;
	::WEGetPoint(offset, direction, &thePoint, &lineHeight, fWE);
	// thePoint is "the top left corner of the rectangle enclosing the character glyph"
	CPoint_AC theLoc;
	::WELongPointToPoint(&thePoint, theLoc);

	::PenNormal();
	// The caret is supposed to be nice and dark (which the white pattern will accomplish)
	CPattern_AC::SetPenPatToWhite();

	::PenMode(notPatXor);							// set invert mode

	::MoveToPt(theLoc);							// Draw the caret image
	::Line(0, lineHeight);

	::PenNormal();								// reset the pen

	fCaretIsShown = !fCaretIsShown;
}

//----------------------------------------------------------------------------------------
// TWEView::WillAcceptDrop:
//----------------------------------------------------------------------------------------

bool TWEView::WillAcceptDrop(CDragItemIterator& dragItemIterator) // override
{
	bool returnVal = false;

	if (TDragDropSession::fgDragDropSession->GetItemCount() == 1)
	{
		TDragItem * firstItem = dragItemIterator.First();
		returnVal = firstItem->FlavorExists(kTextType_AC) ||
					firstItem->FlavorExists(kPictType_AC);
	}
	
	return returnVal;
}

#endif	// qDrag

//----------------------------------------------------------------------------------------
// End of UWEView.cpp
