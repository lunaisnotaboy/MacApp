//----------------------------------------------------------------------------------------
// CHTTPServerThread.cpp
// Copyright © 2000 by Apple Computer, Inc. All rights reserved.
//----------------------------------------------------------------------------------------

/*
	Change History:
		05/24/00	Finish separating char I/O from endpoints. 
							Isolate clients from look errors. 
		05/16/00	Remove debug printf statements that somehow caused the buffer
							to become empty. 
		05/15/00	CW Pro 6: namespacing. 
							Work around compiler can deal with [] as reference. 
		05/12/00	Carbon: replace C2PStr. 
		04/11/00	Use the endpoint object. 
		04/08/00	Initial version. 
*/

#ifndef __CHTTPServerThread__
#include "CHTTPServerThread.h"
#endif

// Network

#ifndef __CTCPEndpoint__
#include "CTCPEndpoint.h"
#endif

// MacApp

// ACS

#ifndef __CFile_AC__
#include "CFile_AC.h"
#endif

// Toolbox

#ifndef __FILES__
#include <Files.h>
#endif

// ANSI

#ifndef _STDIO_H
#include <stdio.h>
#endif

using std::printf;
using std::sscanf;
using std::sprintf;

//========================================================================================
// Constants
//========================================================================================

enum
{
	errNoFileName = -22001			// Cannot find a file name in the request
};

// The worker thread reads characters one at a time from the endpoint
// and uses the following state machine to determine when the request is
// finished.  For HTTP/1.0 requests, the request is terminated by
// two consecutive CR LF pairs.  Each time we read one of the appropriate
// characters we increment the state until we get to kDone, at which
// point we go off to process the request.

enum
{
	kWorkerWaitingForCR1,
	kWorkerWaitingForLF1,
	kWorkerWaitingForCR2,
	kWorkerWaitingForLF2,
	kWorkerDone
};

// This is the size of the transfer buffer that each worker thread
// allocates to read file system data and write network data.

enum
{
	kTransferBufferSize = 4096
};

// The two buffers hold standard HTTP responses.  The first is the 
// default text we spit out when we get an error.  The second is
// the header that we use when we successfully field a request.
// Again note that this sample is not about HTTP, so these responses
// are probably not particularly compliant to the HTTP protocol.

char gDefaultOutputText[] = "HTTP/1.0 200 OK\15\12Content-Type: text/html\15\12\15\12<H1>Say what!</H1><P>\15\12Error Number (%d), Error Text (%s)";
char gHTTPHeader[] = "HTTP/1.0 200 OK\15\12Content-Type: %s\15\12\15\12";

//========================================================================================
// Global Functions
//========================================================================================

//----------------------------------------------------------------------------------------
// StringHasSuffix
//----------------------------------------------------------------------------------------

static bool StringHasSuffix(const char *str, const char *suffix)
	// Returns true if the end of str is suffix.
{
	bool result = false;

	OTByteCount strLen = OTStrLength(str);
	OTByteCount suffixLen = OTStrLength(suffix);

	if ( strLen >= suffixLen )
	{
		result = OTStrEqual(str + strLen - suffixLen, suffix);
	}
	
	return result;
}

//----------------------------------------------------------------------------------------
// ExtractRequestedFileName
//----------------------------------------------------------------------------------------

static void ExtractRequestedFileName(const char *buffer, char *fileName)
	// Assuming that buffer is a C string contain an HTTP request,
	// extract the name of the file that's being requested.
{
	// Default the result to empty.
	fileName[0] = 0;
	
	// Scan the request looking for the fileName.  Obviously this is not
	// a very good validation of the request, but this is an OT sample,
	// not an HTTP one.  Also note that we require HTTP/1.0, but some
	// ancient clients might just generate "GET %s<cr><lf>"
	
	sscanf(buffer, "GET %s HTTP/1.0", fileName);
	
	// If the file name is still blank, scanf must have failed.
	// Note that I don't rely on the result from scanf because in a
	// previous life I learnt to mistrust it.
	
	if (fileName[0] == 0)
	{
		ThrowError_AC(errNoFileName);
	}
	else
	{
		// So the request is cool.  Normalise the file name.
		// Requests for the root return "index.html".
		
		if ( OTStrEqual(fileName, "/") )
		{
			OTStrCopy(fileName, "index.html");
		}
		
		// Remove the prefix slash.  Note that we don't deal with
		// "slashes" embedded in the fileName, so we don't handle
		// any directories other than the root.  This would be
		// easy to do, but again this is not an HTTP sample.
		
		if ( fileName[0] == '/' )
		{
			BlockMoveData(&fileName[1], &fileName[0], OTStrLength(fileName));
		}
	}
	
	#if qDebug
		printf("ExtractRequestedFileName: Returning Ò%sÓ\n", fileName);
	#endif
}

//----------------------------------------------------------------------------------------
// GetFileMimeType
//----------------------------------------------------------------------------------------

static void GetFileMimeType(const char *fileName, char *mimeType)
	// Check to see if the file has one of the common suffixes,
	// and set mimeType appropriately.
	//
	// Obviously this routine should use Internet Config to
	// map the file type/creator/extension to a MIME type,
	// but I don't want to complicate the sample with that code.
{
	// Default the result to empty.
	mimeType[0] = 0;
	
	// Set mimeType based on the file's suffix.
	
	if ( StringHasSuffix(fileName, ".html") )
	{
		OTStrCopy(mimeType, "text/html");
	}
	else if ( StringHasSuffix(fileName, ".gif") )
	{
		OTStrCopy(mimeType, "image/gif");
	}
	else if ( StringHasSuffix(fileName, ".jpg") )
	{
		OTStrCopy(mimeType, "image/jpeg");
	}
	else
	{
		OTStrCopy(mimeType, "text/plain");
	}
	
	#if qDebug
		printf("GetFileMimeType: Returning Ò%sÓ\n", mimeType);
	#endif
}

//----------------------------------------------------------------------------------------
// CopyFileToEndpoint
//----------------------------------------------------------------------------------------

static void CopyFileToEndpoint(const FSSpec& fileSpec, char* buffer, CTCPEndpoint* worker)
	// Copy the file denoted by fileSpec to the endpoint.  buffer is a
	// temporary buffer of size kTransferBufferSize.  Initially buffer
	// contains a C string that is the HTTP header to output.  After that,
	// the routine uses buffer as temporary storage.  We do this because
	// we want any errors opening the file to be noticed before we send
	// the header saying that the request went through successfully.
{
	CFile_AC file;
	file.Specify(fileSpec);
	ThrowIfOSErr_AC(file.OpenDataFork());

	long bytesToSend = 0;
	ThrowIfOSErr_AC(file.GetDataLength(bytesToSend));
	
	// Write the HTTP header out to the endpoint.
	
	worker->Send(buffer, OTStrLength(buffer));
	
	// Copy the file in kTransferBufferSize chunks to the endpoint.
	
	while (bytesToSend > 0)
	{
		long bytesThisTime = Min_AC(bytesToSend, kTransferBufferSize);

		ThrowIfOSErr_AC(file.ReadData(buffer, bytesThisTime));
		worker->Send(buffer, bytesThisTime);

		bytesToSend -= bytesThisTime;
	}

	// File will close itself
}


//========================================================================================
// CHTTPServerThread
//========================================================================================

//----------------------------------------------------------------------------------------
// Construction and Destruction
//----------------------------------------------------------------------------------------

//----------------------------------------------------------------------------------------
// Constructor
//----------------------------------------------------------------------------------------

CHTTPServerThread::CHTTPServerThread(short itsVRefNum, long itsDirID)
	:	CServerThread(),
		fVRefNum(itsVRefNum),
		fDirID(itsDirID)
{
}

//----------------------------------------------------------------------------------------
// Copy constructor
//----------------------------------------------------------------------------------------

CHTTPServerThread::CHTTPServerThread(const CHTTPServerThread& from)
	:	CServerThread(from)
{
}

//----------------------------------------------------------------------------------------
// Destructor
//----------------------------------------------------------------------------------------

CHTTPServerThread::~CHTTPServerThread()
{
}

//----------------------------------------------------------------------------------------
// HTTP
//----------------------------------------------------------------------------------------

//----------------------------------------------------------------------------------------
// ReceiveRequest
//----------------------------------------------------------------------------------------

bool CHTTPServerThread::ReceiveRequest()
{
	// Allocate the transfer buffer in the heap.
	fBuffer.reallocate(kTransferBufferSize);

	Assertion_AC(fEndpoint != nil, "ReadHTTPRequest: What endpoint?");
	Assertion_AC(fBuffer != nil, "ReadHTTPRequest: What buffer?");
	
	long bufferIndex = 0;
	int state = kWorkerWaitingForCR1;
	do
	{	
		char ch;
		long result = fEndpoint->Receive(&ch, sizeof(char));
		if (result != sizeof(char))
		{
			Warning_AC(result == sizeof(char), "ReadHTTPRequest: Didn't read the expected number of bytes");
			break;
		}
		
		// Put the character into the buffer.
		
		fBuffer.operator[](bufferIndex) = ch;
		bufferIndex += 1;
		
		// Check that we still have space to include our null terminator.
		
		if (bufferIndex >= kTransferBufferSize)
		{
			// ¥¥¥ fix to reallocate
			ThrowIfOSStatus(-1);
		}
		
		// Do the magic state machine.  Note the use of
		// hardwired numbers for CR and LF.  This is correct
		// because the Internet standards say that these
		// numbers can't change.  I don't use \n and \r
		// because these values change between various C
		// compilers on the Mac.
		
		switch (ch)
		{
			case 13:
				switch (state)
				{
					case kWorkerWaitingForCR1:
						state = kWorkerWaitingForLF1;
						break;
					case kWorkerWaitingForCR2:
						state = kWorkerWaitingForLF2;
						break;
					default:
						state = kWorkerWaitingForCR1;
						break;
				}
				break;

			case 10:
				switch (state)
				{
					case kWorkerWaitingForLF1:
						state = kWorkerWaitingForCR2;
						break;
					case kWorkerWaitingForLF2:
						state = kWorkerDone;
						break;
					default:
						state = kWorkerWaitingForCR1;
						break;
				}
				break;

			default:
				state = kWorkerWaitingForCR1;
				break;
		}
	}
	while (state != kWorkerDone);

	// Append the null terminator that turns the HTTP request into a C string.
	fBuffer.operator[](bufferIndex) = 0;

	// We have a request. 
	return true;
}

//----------------------------------------------------------------------------------------
// SendResponse
//----------------------------------------------------------------------------------------

bool CHTTPServerThread::SendResponse()
{
	try
	{
		// Get the requested file name (and its mimeType) from the
		// HTTP request in the transfer buffer.
		
		char fileName[256];
		ExtractRequestedFileName(fBuffer, fileName);

		char mimeType[256];
		GetFileMimeType(fileName, mimeType);

		// Create the appropriate HTTP response in the buffer.
		
		sprintf(fBuffer, gHTTPHeader, mimeType);

		// Copy the file (with preceding HTTP header) to the endpoint.
		
		FSSpec fileSpec;
		FSMakeFSSpec(fVRefNum, fDirID, CStr255_AC(fileName), &fileSpec);
		CopyFileToEndpoint(fileSpec, fBuffer, fEndpoint);
	}
	catch (CException_AC& fi)
	{
		// Handle any errors by sending back an appropriate error header.
		OSStatus err = fi.GetError();
		if (err != noErr)
		{
#if qDebug
			printf("Sending error response %d\n", err);
#endif
			try
			{
				char *errStr;
				switch (err)
				{
					case fnfErr:
						errStr = "File Not Found";
						break;
					case errNoFileName:
						errStr = "Cannot find a file name in the request";
						break;
					default:
						errStr = "Unknown Error";
						break;
				}
				sprintf(fBuffer, gDefaultOutputText, err, errStr);
				fEndpoint->Send(fBuffer, OTStrLength(fBuffer));
			}
			catch (...)
			{
			}
		}
	}

	// Always return false because there is only one HTTP request per connection. 
	return false;
}


//----------------------------------------------------------------------------------------
// End of CHTTPServerThread.cpp
