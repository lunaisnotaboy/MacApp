//----------------------------------------------------------------------------------------
// UIconEdit.cpp
// Copyright © 1988-2001 by Apple Computer, Inc. All rights reserved.
//----------------------------------------------------------------------------------------

/*
	Change History
		07/20/01	Use the MacApp clipboard manager. 
					Fix TIconEditView so fIconDocument always gets set. 
					Don't assume dynamic cast will succeed. 
		04/26/01	Use gClipboardMgr accessor methods. 
					PutDeskScrapData returns void. 
		01/18/01	DoNeedDiskSpace is now const.  Cosmetic.
		01/02/01	Update copyright.
		11/17/00	Blockify cases in DoMenuCommand.
		01/14/00	Removed MA_DEFINE_CLASSes.  Do not declare offset for Carbon in
					MakeViewForAlienClipboard.
		12/08/99	Remove MA_DEFINE_CLASS.
		10/27/99	Update to Carbon.
		08/17/99	Change obsoleted macros to ACS versions.
		03/24/99	Update copyright notice.
		03/18/99	Removed '&' on parms to a variety of Toolbox calls.
		02/12/99	[C] 'qd' is no longer accessible; use accessors.
		01/15/99	CAEDesc_AC is now in ACS.
*/

#ifndef __UICONEDIT__
#include "UIconEdit.h"
#endif

#ifndef __ImagingStreaming_AC__
#include "ImagingStreaming_AC.h"
#endif

// MacApp

#ifndef __TOOLBOX__
#include "Toolbox.h"
#endif

#ifndef __UCLIPBOARDMGR__
#include "UClipboardMgr.h"
#endif

#ifndef __UFILESTREAM__
#include "UFileStream.h"
#endif

#ifndef __UMACAPPGLOBALS__
#include "UMacAppGlobals.h"
#endif

#ifndef __UMACAPPUTILITIES__
#include "UMacAppUtilities.h"
#endif

#ifndef __UMEMORY__
#include "UMemory.h"
#endif

#ifndef __UMENUMGR__
#include "UMenuMgr.h"
#endif

#ifndef __UPRINTING__
#include "UPrinting.h"
#endif

#ifndef __USCRIPTING__
#include "UScripting.h"
#endif

#ifndef __USTREAM__
#include "UStream.h"
#endif

#ifndef __UVIEWSERVER__
#include "UViewServer.h"
#endif

#ifndef __UWINDOW__
#include "UWindow.h"
#endif

// Toolbox

#ifndef __AEREGISTRY__
#include <AERegistry.h>
#endif

#ifndef __ICONS__
#include <Icons.h>
#endif

#ifndef __COLORPICKER__
#include <ColorPicker.h>
#endif

#ifndef __TOOLUTILS__
#include <ToolUtils.h>
#endif

// ANSI

#ifndef __STDIO__
#include <stdio.h>
#endif

#ifndef __STDLIB__
#include <stdlib.h>
#endif

//----------------------------------------------------------------------------------------
// Constants

const short kIconHBits = 32;					// Number of horizontal bits in a bitmap.
const short kIconVBits = 32;					// Number of vertical bits in a bitmap.

const short kIconSizeInBytes = 128;				// Number of bytes in an bitmap.
const short kIconSizeInLongs = 32;				// Number of long words in a bitmap.

// Resource identifiers

const short kSeedIconId = 1000;					// Id of the seed icon resource.
const short kIconWindowId = 1000;				// Id of the icon window 'view' resource.
const short kIconEditViewId = 1001;				// Id of the TIconEditView resource.
const short kPencilCursorId = 1000;				// Id of the pencil cursor resource.

// Constants for TIconEditView

const short kBorder = 5;						// Border in which to inset drawing.
const ResType kIconClipType = 'ICON';			// Our private clipboard data type.

// Command Numbers

const CommandNumber cZoomIn = 1000;				// Zoom In menu command.
const CommandNumber cZoomOut = 1001;			// Zoom Out menu command.
const CommandNumber cInvert = 1002;				// Invert menu command.
const CommandNumber cDrawCommand = 1003;		// For drawing in the icon edit view.
const CommandNumber cDrawPointsCommand = 1004;	// set point apple event
const CommandNumber cSetColor = 1005;			// set a new document color

//========================================================================================
// CLASS TIconEditApplication
//========================================================================================
#undef Inherited
#define Inherited TApplication

//----------------------------------------------------------------------------------------
// TIconEditApplication::TIconEditApplication:
//----------------------------------------------------------------------------------------

TIconEditApplication::TIconEditApplication() :
	TApplication(kFileType, kSignature)
{
	REGISTER_CLASS_AC(TIconEditView);
}

//----------------------------------------------------------------------------------------
// TIconEditApplication destructor
//----------------------------------------------------------------------------------------

TIconEditApplication::~TIconEditApplication()
{
}

//----------------------------------------------------------------------------------------
// TIconEditApplication::DoMakeDocument:
//----------------------------------------------------------------------------------------

TDocument* TIconEditApplication::DoMakeDocument(CommandNumber/*itsCommandNumber*/ ,
												TFile* itsFile)
{
	return TH_new TIconDocument(itsFile);
}

//----------------------------------------------------------------------------------------
// TIconEditApplication::MakeViewForAlienClipboard:
//----------------------------------------------------------------------------------------

TView* TIconEditApplication::MakeViewForAlienClipboard()
{
	TView* returnVal = NULL;

	// Does the scrap contain my type?
	if (gClipboardMgr)
	{
		if (gClipboardMgr->GetFlavorSize(kIconClipType) > 0)
		{
			// Need a document to represent the data to be put on the clipboard.
			CAutoPtr_AC<TIconDocument> clipDocument(TH_new TIconDocument);
			clipDocument->ReturnBitMap()->LoadFromScrap();// Get 'ICON' data from scrap.

			CAutoPtr_AC<TIconEditView> clipView(TH_new TIconEditView(gZeroVPt, 1));
			clipView->HandlePostCreate(clipDocument);

			clipDocument.release();
			returnVal = clipView.release();						// Return view for Clipboard.
		}
	}
	if (!returnVal)
		returnVal = Inherited::MakeViewForAlienClipboard();

	return returnVal;
}

//========================================================================================
// CLASS TIconDocument
//========================================================================================
#undef Inherited
#define Inherited TFileBasedDocument

//----------------------------------------------------------------------------------------
// TIconDocument constructor
//----------------------------------------------------------------------------------------

TIconDocument::TIconDocument(TFile* itsFile) :
	TFileBasedDocument(itsFile,			// This document's file
							 kSignature),		// This document's scrap type

	fIconView(NULL),
	// Set this to NULL so that if TIconDocument fails, ~TIconDocument works okay.

	fColor(gRGBBlack),							// init drawing color to black
	fIconBitMap(TH_new TIconBitMap)// Allocate a new icon bitmap.
{
}

//----------------------------------------------------------------------------------------
// TIconDocument::Free:
//----------------------------------------------------------------------------------------

TIconDocument::~TIconDocument()
{
}

//----------------------------------------------------------------------------------------
// TIconDocument::DoInitialState: This method is called to set the document's data to the
// "new" state, as when the user chooses to open a new document instead of an existing
// one. We set the value of the document's icon bit map to that of a "seed" icon in our
// resource file. That way we can the document's initial state simply by changing the
// "seed" icon resource.
//----------------------------------------------------------------------------------------

void TIconDocument::DoInitialState()
{
	Handle seedIcon = GetIcon(kSeedIconId);			// Get the seed icon resource
	if (seedIcon)						// If we got the seed icon resource
		fIconBitMap->SetIconBitMap(seedIcon);
#if qDebug
	else
		ProgramBreak_AC("Unable to get the seed icon resource.");
#endif

}

//----------------------------------------------------------------------------------------
// TIconDocument::DoMakeViews:
//----------------------------------------------------------------------------------------

void TIconDocument::DoMakeViews(bool forPrinting)
{
	if (forPrinting)							// If for printing, only need the view.
	{
		fIconView = dynamic_cast_AC(TIconEditView*,gViewServer->DoCreateViews(this, NULL, kIconEditViewId, gZeroVPt));//new
	}
	else
	{											// Otherwise need view and window.
		TWindow * aWindow = gViewServer->NewTemplateWindow(kIconWindowId, this);
		::ThrowIfNULL_AC(aWindow);
		fIconView = dynamic_cast_AC(TIconEditView*,(aWindow->FindSubView('ICON')));// Get reference to the view.
	}

	TStdPrintHandler * aPrintHandler = TH_new TStdPrintHandler(this,		// The document.
									fIconView);	// The view to be printed.
}

//----------------------------------------------------------------------------------------
// TIconDocument::DoMenuCommand:
//----------------------------------------------------------------------------------------

void TIconDocument::DoMenuCommand(CommandNumber aCommandNumber)
{
	switch (aCommandNumber)
	{
		case cInvert:
			{
				TInvertCommand * anInvertCommand = TH_new TInvertCommand(this);
				anInvertCommand->SetUseAppleEvent(true);
				PostCommand(anInvertCommand);
			}
			break;

		case cZoomIn:
			{
				TZoomInCommand * theZoomInCommand = TH_new TZoomInCommand(this);
				theZoomInCommand->SetUseAppleEvent(true);
				PostCommand(theZoomInCommand);
			}
			break;

		case cZoomOut:
			{
				TZoomOutCommand * theZoomOutCommand = TH_new TZoomOutCommand(this);
				theZoomOutCommand->SetUseAppleEvent(true);
				PostCommand(theZoomOutCommand);
			}
			break;

		case cSetColor:
			{
				CRGBColor_AC newColor;
				CStr255_AC thePrompt("Pick a TH_new color");
				if (GetColor(kBestSystemLocation, thePrompt, fColor, newColor))
				{
					if (TOSADispatcher::fgDispatcher->GetDefaultTarget()->IsRecordingOn())
					{
#if 0
						TSetPropertyEvent * appleEvent = TH_new TSetPropertyEvent(gServerAddress, kAENoReply, this, pColor);
						CTempDesc_AC theNewColor;
						theNewColor.PutRGBColor(newColor);
						appleEvent->WriteParameter(keyAEData, theNewColor);
						appleEvent->Send();
#else
						TSetPropertyEvent appleEvent(gServerAddress, kAENoReply, this, pColor);
						CTempDesc_AC theNewColor;
						theNewColor.PutRGBColor(newColor);
						appleEvent.WriteParameter(keyAEData, theNewColor);
						CAutoPtr_AC<TAppleEvent> theReply(appleEvent.Send());
#endif
					}
					else
						PostCommand(TH_new TSetColorCommand(this, newColor));
				}
			}
			break;

		default:
			Inherited::DoMenuCommand(aCommandNumber);
			break;
	}
}

//----------------------------------------------------------------------------------------
// TIconDocument::DoScriptCommand	(OVERRIDE)
//----------------------------------------------------------------------------------------

void TIconDocument::DoScriptCommand(CommandNumber aCommand,
									TAppleEvent* message,
									TAppleEvent* reply)
{
	switch (aCommand)
	{
		case cInvert:
			PostCommand(TH_new TInvertCommand(this));
			break;

		case cZoomIn:
			PostCommand(TH_new TZoomInCommand(this));
			break;

		case cZoomOut:
			PostCommand(TH_new TZoomOutCommand(this));
			break;

		case cDrawPointsCommand:
			PostCommand(TH_new TDrawPointsCommand(this, message));
			break;

		default:
			Inherited::DoScriptCommand(aCommand, message, reply);
			break;
	}
}

//----------------------------------------------------------------------------------------
// TIconDocument::DoNeedDiskSpace:
//----------------------------------------------------------------------------------------

void TIconDocument::DoNeedDiskSpace(TFile* itsFile,
									long& dataForkBytes,
									long& rsrcForkBytes) const
{
	Inherited::DoNeedDiskSpace(itsFile, dataForkBytes,// In case parent class saves data.
							   rsrcForkBytes);

	dataForkBytes = dataForkBytes +				// Add the size of the icon in bytes and
				   kIconSizeInBytes +			// the space taken up by the color information
				   sizeof(CRGBColor_AC);			// Éthe number of bytes in the data fork.
}

//----------------------------------------------------------------------------------------
// TIconDocument::DoRead:
//----------------------------------------------------------------------------------------

void TIconDocument::DoRead(TFile* itsFile,
						   bool forPrinting)
{
	Inherited::DoRead(itsFile, forPrinting);	// In case parent class reads data.

	TFileStream theFileStream(itsFile);
	fIconBitMap->ReadFrom(&theFileStream);		// Read Data from the file system into
	// Éthe icon and handle any errors.

	theFileStream >> fColor;
}

//----------------------------------------------------------------------------------------
// TIconDocument::DoSetupMenus:
//----------------------------------------------------------------------------------------

void TIconDocument::DoSetupMenus()
{
	Inherited::DoSetupMenus();					// Set up inherited menus.
	Enable(cInvert, true);						// The icon can always be inverted.
	Enable(cSetColor, true);					// The color can always be set
}

//----------------------------------------------------------------------------------------
// TIconDocument::DoWrite:
//----------------------------------------------------------------------------------------

void TIconDocument::DoWrite(TFile* itsFile,
							bool makingCopy)
{
	Inherited::DoWrite(itsFile, makingCopy);	// In case parent class writes data.

	TFileStream theFileStream(itsFile);
	fIconBitMap->WriteTo(&theFileStream);		// Write data the icon to the file
	// Éand handle any errors.

	theFileStream << fColor;
}

//----------------------------------------------------------------------------------------
// TIconDocument::InvertIcon:
//----------------------------------------------------------------------------------------

void TIconDocument::InvertIcon()
{
	fIconBitMap->Invert();						// Invert the bits of the icon.
	RedrawViews();						// Make sure all views get redrawn.
}

//----------------------------------------------------------------------------------------
// TIconDocument::ClearIcon:
//----------------------------------------------------------------------------------------

void TIconDocument::ClearIcon()
{
	fIconBitMap->Clear();						// Clear the icon bits.
	RedrawViews();						// Make sure all views get redrawn.
}

//----------------------------------------------------------------------------------------
// TIconDocument::SetIcon:
//----------------------------------------------------------------------------------------

void TIconDocument::SetIcon(TIconBitMap* newIcon)
{
	if (fIconBitMap != newIcon)
		fIconBitMap = newIcon;			// Note this doesn't copy the icon.

	RedrawViews();						// Make sure all views get redrawn.
}

//----------------------------------------------------------------------------------------
// TIconDocument::RedrawViews:
//----------------------------------------------------------------------------------------

void TIconDocument::RedrawViews()
{
	fIconView->ForceRedraw();
}

//----------------------------------------------------------------------------------------
// TIconDocument::GetSetPropertyInfo: 	{OVERRIDE}
//----------------------------------------------------------------------------------------

void TIconDocument::GetSetPropertyInfo(DescType whichProperty,
									   CommandNumber& cmdNum,
									   bool& canUndo,
									   bool& causesChange,
									   TCommandHandler*& theContext)
{
	switch (whichProperty)
	{
		case pColor:
			cmdNum = cSetColor;
			canUndo = true;
			causesChange = true;
			theContext = this;
			break;

		default:
			Inherited::GetSetPropertyInfo(whichProperty, cmdNum, canUndo, causesChange, theContext);
			break;
	}
}

//----------------------------------------------------------------------------------------
// TIconDocument::GetObjectProperty: 	{OVERRIDE}
//----------------------------------------------------------------------------------------

bool TIconDocument::GetObjectProperty(CAEDesc_AC& thePropertyValue,
										 DescType whichProperty,
										 const CAEDesc_AC& desiredType)
{
	bool hasProperty = TRUE;

	switch (whichProperty)
	{
		case pColor:
			thePropertyValue.PutRGBColor(fColor);
			break;

		default:
			hasProperty = Inherited::GetObjectProperty(thePropertyValue, whichProperty, desiredType);
			break;

	}

	return hasProperty;
}

//----------------------------------------------------------------------------------------
// TIconDocument::SetObjectProperty: 	{OVERRIDE}
//----------------------------------------------------------------------------------------

void TIconDocument::SetObjectProperty(const CAEDesc_AC& thePropertyValue,
									  DescType whichProperty)
{
	switch (whichProperty)
	{
		case pColor:
			fColor = thePropertyValue.GetRGBColor();
			RedrawViews();
			break;

		default:
			Inherited::SetObjectProperty(thePropertyValue, whichProperty);
			break;
	}
}

//----------------------------------------------------------------------------------------
// TIconDocument::SetIconColor: Set the color of the icon bitmap.
//----------------------------------------------------------------------------------------

void TIconDocument::SetIconColor(CRGBColor_AC& newColor)
{
	fColor = newColor;
	RedrawViews();
}

//========================================================================================
// CLASS TIconEditView
//========================================================================================
#undef Inherited
#define Inherited TView

MA_DEFINE_CLASS(TIconEditView);

//----------------------------------------------------------------------------------------
// TIconEditView constructor
//----------------------------------------------------------------------------------------

TIconEditView::TIconEditView(const CViewPoint& itsLocation,
								  short itsMagnification)
	:	TView(itsLocation, gZeroVPt, sizeVariable, sizeVariable),
		fMagnification(itsMagnification),
		fIconDocument(dynamic_cast_AC(TIconDocument*,fDocument))
{
}

//----------------------------------------------------------------------------------------
// TIconEditView destructor
//----------------------------------------------------------------------------------------

TIconEditView::~TIconEditView()
{
}

//----------------------------------------------------------------------------------------
// TIconEditView::BeInDocument:
//----------------------------------------------------------------------------------------

void TIconEditView::BeInDocument(TDocument* itsDocument)
{
	Inherited::BeInDocument(itsDocument);
	fIconDocument = dynamic_cast_AC(TIconDocument*,itsDocument);
}

//----------------------------------------------------------------------------------------
// TIconEditView::CalcMinFrame:
//----------------------------------------------------------------------------------------

CViewRect TIconEditView::CalcMinFrame()
{
	CViewRect minFrame(Inherited::CalcMinFrame());

	minFrame[botRight] = minFrame[topLeft] + CViewPoint(kIconHBits * fMagnification + kBorder + kBorder, kIconVBits * fMagnification + kBorder + kBorder);

	return minFrame;
}

//----------------------------------------------------------------------------------------
// TIconEditView::ContainsClipType:
//----------------------------------------------------------------------------------------

bool TIconEditView::ContainsClipType(ResType aType)
{
	return aType == kIconClipType;
}

//----------------------------------------------------------------------------------------
// TIconEditView::DoMenuCommand:
//----------------------------------------------------------------------------------------

void TIconEditView::DoMenuCommand(CommandNumber aCommandNumber)
{
	switch (aCommandNumber)						// Decide if this command is oursÉ
	{
		case cCut:
		case cCopy:
		case cClear:
			PostCommand(TH_new TIconEditCommand(aCommandNumber, this, fIconDocument));
			break;

		case cPaste:
			PostCommand(TH_new TIconPasteCommand(this, fIconDocument));
			break;

		default:								// Otherwise, let someone else handle it.
			Inherited::DoMenuCommand(aCommandNumber);
		break;
	}
}

//----------------------------------------------------------------------------------------
// TIconEditView::DoKeyEvent:
//----------------------------------------------------------------------------------------

void TIconEditView::DoKeyEvent(TToolboxEvent* info)
{
	if (info->GetText() == chBackspace)
		PostCommand(TH_new TIconEditCommand(cClear, this, fIconDocument));// Same as Clear menu command.
	else
		Inherited::DoKeyEvent(info);			// In case someone else wants it.
}

//----------------------------------------------------------------------------------------
// TIconEditView::DoMouseCommand:
//----------------------------------------------------------------------------------------

void TIconEditView::DoMouseCommand(CViewPoint& theMouse,
								   TToolboxEvent*/*event*/  ,
								   CPoint_AC		/*hysteresis*/)
{
	CViewPoint iconBit;
	if (PointToBit(theMouse, iconBit))	// If CPoint_AC is within the icon
		PostCommand(TH_new TIconDrawCommand(this, fIconDocument, theMouse));	// and Post it.
}

//----------------------------------------------------------------------------------------
// TIconEditView::DoSetCursor:
//----------------------------------------------------------------------------------------

void TIconEditView::DoSetCursor(const CViewPoint& localPoint,
								RgnHandle cursorRegion)//new
{

	CTempRegion_AC outerRegion;
	CTempRegion_AC innerRegion;

	GetExtentRegion(outerRegion);
	CopyRgn(outerRegion, innerRegion);
	InsetRgn(innerRegion, kBorder, kBorder);

	CViewPoint iconBit;
	if (PointToBit(localPoint, iconBit))	// If the cursor is not in the bordersÉ
	{
		CursHandle pencilCursor = GetCursor(GetCursorID());// Attempt to get the pencil cursor.
		::ThrowIfNULLResource_AC((Handle)pencilCursor);
		SetCursor(*pencilCursor);				// Set the cursor on the screen.
		CopyRgn(innerRegion, cursorRegion);
	}
	else
	{
#if qCarbon
		Cursor		myQDArrow;
		::GetQDGlobalsArrow(&myQDArrow);
		SetCursor(&myQDArrow);
#else
		SetCursor(&(qd.arrow));
#endif
		DiffRgn(outerRegion, innerRegion, cursorRegion);
	}
}

//----------------------------------------------------------------------------------------
// TIconEditView::DoSetupMenus:
//----------------------------------------------------------------------------------------

void TIconEditView::DoSetupMenus()
{
	Inherited::DoSetupMenus();					// Set up inherited menus.

	Enable(cZoomIn, true);						// Can always zoom in.
	Enable(cZoomOut, fMagnification > 1);		// Can zoom out if not at smallest size.
	Enable(cSetColor, true);					// can always set the color
	Enable(cCut, true);							// Always enable the Cut command.
	Enable(cCopy, true);						// Always enable the Copy command.
	Enable(cClear, true);						// Always enable the Clear command.
	gClipboardMgr->CanPaste(kIconClipType);		// This view can paste 'ICON' data.
}

//----------------------------------------------------------------------------------------
// TIconEditView::Draw:
//----------------------------------------------------------------------------------------

void TIconEditView::Draw(const CViewRect&			/*area*/ )//new
{
	CRect_AC drawingRect(ViewToQD(CViewRect(kBorder, kBorder, kBorder + (kIconHBits * fMagnification), kBorder + (kIconVBits * fMagnification))));

	fIconDocument->ReturnBitMap()->Draw(drawingRect, fIconDocument->GetIconColor());
}

//----------------------------------------------------------------------------------------
// TIconEditView::DrawBit:
//----------------------------------------------------------------------------------------

void TIconEditView::DrawBit(CViewPoint theBit,
							bool turnBitOn,
							CRGBColor_AC& drawingColor)
{
	CRect_AC theRect(CViewRect(kBorder + theBit.h * fMagnification, kBorder + theBit.v * fMagnification, kBorder + (theBit.h + 1) * fMagnification, kBorder + (theBit.v + 1) * fMagnification).ToRect());

	// Setup the bit's CRect_AC the in edit view.

	if (turnBitOn)
	{
		CRGBColor_AC oldColor(GetIfColor());
		SetIfColor(drawingColor);

		PenNormal();
		PaintRect(theRect);
		SetIfColor(oldColor);
	}
	else
	{
		FillRect(theRect, &CPattern_AC::White());
	}
}

//----------------------------------------------------------------------------------------
// TIconEditView::PointToBit:  Converts the given mouse CPoint_AC to an icon bit.
//----------------------------------------------------------------------------------------

bool TIconEditView::PointToBit(const CViewPoint& thePoint,
								  CViewPoint& iconBit)
{
	bool returnVal = false;

	CViewPoint aPoint(thePoint);
	aPoint.Offset(-kBorder, -kBorder);
	// Account for border in the edit view.

	// If the mouse is within the edit view's iconÉ
	if ((aPoint.h >= 0) && (aPoint.h < kIconHBits * fMagnification) && (aPoint.v >= 0) && (aPoint.v < kIconVBits * fMagnification))
	{
		iconBit.h = aPoint.h / fMagnification;	// Convert from edit view CPoint_AC
		iconBit.v = aPoint.v / fMagnification;	// Éto icon bit.
		returnVal = true;
	}

	return returnVal;
}

//----------------------------------------------------------------------------------------
// TIconEditView::SetMagnification:
//----------------------------------------------------------------------------------------

void TIconEditView::SetMagnification(short magnification)
{
	fMagnification = Max_AC(static_cast<short>(1), magnification);// Set the new magnification.
	AdjustFrame();						// Magnification affects the view's size.
	ForceRedraw();						// Force the view to be entirely redrawn.
}

//----------------------------------------------------------------------------------------
// TIconEditView::WriteToDeskScrap:
//----------------------------------------------------------------------------------------

void TIconEditView::WriteToDeskScrap()
{
	fIconDocument->ReturnBitMap()->WriteToScrap();// Write the icon data to the clipboard.
	Inherited::WriteToDeskScrap();				// Write 'PICT' data to the desk scrap.
}

//========================================================================================
// CLASS TDrawLineAppleEvent
//========================================================================================
#undef Inherited
#define Inherited TAppleEvent

//----------------------------------------------------------------------------------------
// TDrawPointsAppleEvent::TDrawPointsAppleEvent
//----------------------------------------------------------------------------------------

TDrawPointsAppleEvent::TDrawPointsAppleEvent(MScriptableObject* itsDirectObject,
												  TIconBitMap* iconBitMapModel,
												  bool turnBitsOn) :
TAppleEvent(kAEIconEditClass, kAEDrawPoints, gServerAddress, kAENoReply + kAEDontExecute)
{
	CTempDesc_AC directObjectDesc;
	itsDirectObject->MakeObjectSpecifier(directObjectDesc, formUniqueID);
	WriteParameter(keyDirectObject, directObjectDesc);

	CDynamicArray_AC pointArray(1, sizeof(CPoint_AC));// create an array to store a list of points

	// add the points set in the model to the dynamic array
	for (short vCoord = 0; vCoord < kIconVBits; ++vCoord)
	{
		CViewPoint iconBit;
		iconBit.v = vCoord;
		for (short hCoord = 0; hCoord < kIconHBits; ++hCoord)
		{
			iconBit.h = hCoord;
			if (iconBitMapModel->GetBit(iconBit))
				pointArray.InsertElementsBefore(pointArray.GetSize() + 1, iconBit.ToPoint(), 1);
		}
	}

	// write the point list to the apple event parameter list
	WritePtrList(keyPointList, typeQDPoint, &pointArray);

	// if turning the points off, add an optional parameter
	if (!turnBitsOn)
		WriteBoolean(keyErasePoints, TRUE);
}

//----------------------------------------------------------------------------------------
// TDrawPointsAppleEvent destructor
//----------------------------------------------------------------------------------------

TDrawPointsAppleEvent::~TDrawPointsAppleEvent()
{
}

//========================================================================================
// CLASS TInvertCommand
//========================================================================================
#undef Inherited
#define Inherited TCommand

//----------------------------------------------------------------------------------------
// TInvertCommand constructor
//----------------------------------------------------------------------------------------

TInvertCommand::TInvertCommand(TIconDocument* itsIconDocument) :
	TCommand(cInvert,						// Initialize the inherited dataÉ
				   itsIconDocument, kCanUndo, kCausesChange, itsIconDocument),// Éno view or scroller to track.
	fIconDocument(itsIconDocument)
{
}

//----------------------------------------------------------------------------------------
// TInvertCommand destructor
//----------------------------------------------------------------------------------------

TInvertCommand::~TInvertCommand()
{
}

//----------------------------------------------------------------------------------------
// TInvertCommand::MakeAppleEvent
//----------------------------------------------------------------------------------------
TAppleEvent* TInvertCommand::MakeAppleEvent()
{
	CAutoPtr_AC<TAppleEvent> theInvertEvent(TH_new TAppleEvent(kAEIconEditClass, kAEInvertID, gServerAddress, kAENoReply));

	CTempDesc_AC directObjectDesc;
	fIconDocument->MakeObjectSpecifier(directObjectDesc, fIconDocument->GetSpecifierForm());// create a descriptor
	theInvertEvent->WriteParameter(keyDirectObject, directObjectDesc);

	return theInvertEvent.release();
}

//----------------------------------------------------------------------------------------
// TInvertCommand::DoIt:
//----------------------------------------------------------------------------------------

void TInvertCommand::DoIt()
{
	fIconDocument->InvertIcon();				// Invert the document's icon bitmap.
}

//----------------------------------------------------------------------------------------
// TInvertCommand::UndoIt:
//----------------------------------------------------------------------------------------

void TInvertCommand::UndoIt()
{
	fIconDocument->InvertIcon();				// Uninvert the document's icon bitmap.
}

//----------------------------------------------------------------------------------------
// TInvertCommand::RedoIt:
//----------------------------------------------------------------------------------------

void TInvertCommand::RedoIt()
{
	fIconDocument->InvertIcon();				// Reinvert the document's icon bitmap.
}

//========================================================================================
// CLASS TDrawPointsCommand
//========================================================================================
#undef Inherited
#define Inherited TCommand

//----------------------------------------------------------------------------------------
// TSetPointsCommand constructor
//----------------------------------------------------------------------------------------

TDrawPointsCommand::TDrawPointsCommand(TIconDocument* itsIconDocument,
											TAppleEvent* theAppleEvent) :
	TCommand(cDrawPointsCommand,			// Initialize the inherited dataÉ
				   itsIconDocument, kCanUndo, kCausesChange, itsIconDocument),

	fPointList(TH_new CDynamicArray_AC(1, sizeof(CPoint_AC))),
	fSavedBitMap(NULL),
	fIconDocument(itsIconDocument),
	fErasePoints(false)							// by default, turn bits on
{
	// read the required pointlist parameter

	theAppleEvent->ReadPtrList(keyPointList, typeQDPoint, fPointList);

	// read the optional erasePoints parameter
	if (theAppleEvent->HasParameter(keyErasePoints))
		fErasePoints = theAppleEvent->ReadBoolean(keyErasePoints);
}

//----------------------------------------------------------------------------------------
// TDrawLineCommand::Free
//----------------------------------------------------------------------------------------

TDrawPointsCommand::~TDrawPointsCommand()
{
	if (fCommandDone)
		delete fSavedBitMap;
}

//----------------------------------------------------------------------------------------
// TDrawPointsCommand::DoIt
//----------------------------------------------------------------------------------------

void TDrawPointsCommand::DoIt()
{
	TIconBitMap * targetBitMap = fIconDocument->ReturnBitMap();
	fSavedBitMap = targetBitMap->Copy();		// save the current bitmap

	// draw the points listed in the pointlist
	for (TemplateArrayIterator_AC<CPoint_AC>iter(fPointList); iter; ++iter)
		targetBitMap->SetBit(CViewPoint(*iter), !fErasePoints);// set the bit in the bitmap

	fIconDocument->SetIcon(targetBitMap);		// this will cause a redraw

	// free the point listÉit won't be used again
	fPointList.reset();
}

//----------------------------------------------------------------------------------------
// TDrawPointsCommand::UndoIt
//----------------------------------------------------------------------------------------

void TDrawPointsCommand::UndoIt()
{
	TIconBitMap * tempBitMap = fIconDocument->ReturnBitMap()->Copy();// save a local copy
	fIconDocument->SetIcon(fSavedBitMap);
	fSavedBitMap = tempBitMap;
	//fIconDocument->SetIcon(fOriginalBitMap);
}

//----------------------------------------------------------------------------------------
// TDrawPointsCommand::RedoIt
//----------------------------------------------------------------------------------------

void TDrawPointsCommand::RedoIt()
{
	TIconBitMap * tempBitMap = fIconDocument->ReturnBitMap()->Copy();// save a local copy
	fIconDocument->SetIcon(fSavedBitMap);
	fSavedBitMap = tempBitMap;
}

//========================================================================================
// CLASS TSetColorCommand
//========================================================================================
#undef Inherited
#define Inherited TCommand

//----------------------------------------------------------------------------------------
// TSetColorCommand::TSetColorCommand
//----------------------------------------------------------------------------------------

TSetColorCommand::TSetColorCommand(TIconDocument* itsDocument,
										const CRGBColor_AC& newColor) :
	TCommand(cSetColor,					// Initialize the commandÉ
				   itsDocument,					// Associate it with a document.
				   kCanUndo, kCausesChange, itsDocument),
	fOldColor(itsDocument ? itsDocument->GetIconColor() : newColor),
	fNewColor(newColor)
{
}

//----------------------------------------------------------------------------------------
// TSetColorCommand destructor
//----------------------------------------------------------------------------------------

TSetColorCommand::~TSetColorCommand()
{
}

//----------------------------------------------------------------------------------------
// TSetColorCommand::DoIt
//----------------------------------------------------------------------------------------

void TSetColorCommand::DoIt()
{
	dynamic_cast_AC(TIconDocument*,fContext)->SetIconColor(fNewColor);
}

//----------------------------------------------------------------------------------------
// TSetColorCommand::UndoIt
//----------------------------------------------------------------------------------------

void TSetColorCommand::UndoIt()
{
	dynamic_cast_AC(TIconDocument*,fContext)->SetIconColor(fOldColor);
}

//----------------------------------------------------------------------------------------
// TSetColorCommand::RedoIt
//----------------------------------------------------------------------------------------

void TSetColorCommand::RedoIt()
{
	dynamic_cast_AC(TIconDocument*,fContext)->SetIconColor(fNewColor);
}

//========================================================================================
// CLASS TIconDrawCommand
//========================================================================================
#undef Inherited
#define Inherited TTracker

//----------------------------------------------------------------------------------------
// TIconDrawCommand constructor
//----------------------------------------------------------------------------------------

TIconDrawCommand::TIconDrawCommand(TIconEditView* itsIconEditView,
										TIconDocument* itsIconDocument,
										const CViewPoint& theMouse) :
	TTracker(cDrawCommand,				// Initialize the commandÉ
				   itsIconDocument,				// Its context
				   kCanUndo, kCausesChange, itsIconDocument,// Associate it with a notifying object.
				   itsIconEditView,				// Associate it with a view.
				   itsIconEditView->GetScroller(true),// Associate it with a scroller
				   theMouse),

	fColor(itsIconDocument ? itsIconDocument->GetIconColor() : gRGBWhite),		// store the drawing color
	fIconBitMap(itsIconDocument ? itsIconDocument->ReturnBitMap()->Copy() : NULL),
	fIconBitMapModel(TH_new TIconBitMap),			// create a model for the bits being set
	fIconDocument(itsIconDocument),
	fIconEditView(itsIconEditView),
	fTurnBitsOn(true)
{
	fConstrainsMouse = true;					// Want TrackConstrain called.

	fIconBitMapModel->Clear();
}

//----------------------------------------------------------------------------------------
// TIconDrawCommand::~TIconDrawCommand:
//----------------------------------------------------------------------------------------

TIconDrawCommand::~TIconDrawCommand()
{
}

//----------------------------------------------------------------------------------------
// TIconDrawCommand::TrackConstrain:
//----------------------------------------------------------------------------------------

void TIconDrawCommand::TrackConstrain(TrackPhase/*aTrackPhase*/ ,
									  const CViewPoint&/*anchorPoint*/  ,
									  const CViewPoint&/*previousPoint*/  ,
									  CViewPoint& nextPoint,
									  bool	/*mouseDidMove*/)
{
	ViewCoordinate h = MinMax_AC(static_cast<long>(kBorder), nextPoint.h, fIconEditView->GetSize().h - kBorder - 1);
	ViewCoordinate v = MinMax_AC(static_cast<long>(kBorder), nextPoint.v, fIconEditView->GetSize().v - kBorder - 1);

	nextPoint.Set(h, v);
}

//----------------------------------------------------------------------------------------
// TIconDrawCommand::TrackFeedback:
//----------------------------------------------------------------------------------------

void TIconDrawCommand::TrackFeedback(TrackPhase	/*aTrackPhase*/,
									 const CViewPoint&/*anchorPoint*/  ,
									 const CViewPoint&/*previousPoint*/  ,
									 const CViewPoint&/*nextPoint*/  ,
									 bool	/*mouseDidMove*/,
									 bool	/*turnItOn*/)
{
	// Overridden to avoid standard feedback.
}

//----------------------------------------------------------------------------------------
// TIconDrawCommand::TrackMouse:
//----------------------------------------------------------------------------------------

TTracker* TIconDrawCommand::TrackMouse(TrackPhase aTrackPhase,
									   CViewPoint&	/*anchorPoint*/ ,
									   CViewPoint& previousPoint,
									   CViewPoint& nextPoint,
									   bool mouseDidMove)
{
	CViewPoint fromBit;
	CViewPoint toBit;
	CViewPoint iconBit;
	short lineLength;
	float deltaH;
	float deltaV;
	float h;
	float v;

	// Convert nextPoint and previousPoint to bit locations in the iconÉ
	fIconEditView->PointToBit(fIconEditView->ViewToQD(nextPoint), toBit);
	fIconEditView->PointToBit(fIconEditView->ViewToQD(previousPoint), fromBit);

	if (aTrackPhase == trackBegin)				// first time through
	{
		fTurnBitsOn = !fIconBitMap->GetBit(toBit);// Turn bits on or off?
		fOriginalIcon = fIconBitMap->Copy();	// Make a copy of the original for undo
	}

	if (mouseDidMove)							// If mouse moved since last timeÉ
	{
		// The following sets bits in the icon from the bit at previousPoint to the bit
		// at nextPoint.  It is based on a simple line-drawing algorithm.

		lineLength = static_cast<short>(Max_AC(1, Max_AC(labs(toBit.h - fromBit.h), labs(toBit.v - fromBit.v))));

		deltaH = (toBit.h - fromBit.h) / lineLength;
		deltaV = (toBit.v - fromBit.v) / lineLength;

		h = fromBit.h + 0.5;
		v = fromBit.v + 0.5;

		for (short i = 0; i < lineLength; ++i)
		{
			iconBit.h = h;
			iconBit.v = v;

			fIconBitMap->SetBit(iconBit, fTurnBitsOn);// Set the bit in the icon
			fIconEditView->DrawBit(iconBit, fTurnBitsOn, fColor);// Éand draw it in the edit view.

			// set the bit in the bitMapView model.  this model will be used to generate
			// a setpoints apple event for recordability.
			fIconBitMapModel->SetBit(iconBit, TRUE);

			h = h + deltaH;
			v = v + deltaV;
		}
	}

	if (aTrackPhase == trackEnd)				// when tracking is done, post a
	{
		// recordable apple event
#if 0
		TDrawPointsAppleEvent * aDrawEvent = TH_new TDrawPointsAppleEvent(fIconDocument, fIconBitMapModel, fTurnBitsOn);
		aDrawEvent->Send();
#else
		TDrawPointsAppleEvent aDrawEvent(fIconDocument, fIconBitMapModel, fTurnBitsOn);
		CAutoPtr_AC<TAppleEvent> theReply(aDrawEvent.Send());
#endif
	}

	return this;								// Return same command object.
}

//----------------------------------------------------------------------------------------
// TIconDrawCommand::DoIt:
//----------------------------------------------------------------------------------------

void TIconDrawCommand::DoIt()
{
	// Set to a copy of the icon since we retain ownership.
	fIconDocument->SetIcon(fIconBitMap->Copy());

	// SetIcon invalidates all views of the document, including the one we just drew in.
	// To avoid flashing, validate the edit view here so it doesn't get redrawn.
	fIconEditView->Validate(fIconEditView->GetExtent());
}

//----------------------------------------------------------------------------------------
// TIconDrawCommand::UndoIt:
//----------------------------------------------------------------------------------------

void TIconDrawCommand::UndoIt()
{
	// Set to a copy of the icon since we retain ownership.
	fIconDocument->SetIcon(fOriginalIcon->Copy());		// Restore icon to original state.
}

//----------------------------------------------------------------------------------------
// TIconDrawCommand::RedoIt:
//----------------------------------------------------------------------------------------

void TIconDrawCommand::RedoIt()
{
	// Set to a copy of the icon since we retain ownership.
	fIconDocument->SetIcon(fIconBitMap->Copy());		// Set the icon back to the new one.
}

//========================================================================================
// CLASS TIconEditCommand
//========================================================================================
#undef Inherited
#define Inherited TCommand

//----------------------------------------------------------------------------------------
// TIconEditCommand::Initialize:
//----------------------------------------------------------------------------------------

TIconEditCommand::TIconEditCommand(CommandNumber itsCommandNumber,
										TIconEditView* itsIconEditView,
										TIconDocument* itsIconDocument)
	:	TCommand(itsCommandNumber,			// Initialize the commandÉ
				 itsIconDocument,			// Associate it with a document.
				 kCanUndo, kCausesChange, itsIconDocument),

	fSavedBitMap(itsIconDocument->ReturnBitMap()->Copy()),// Save a copy of the current bitmap.

	fIconDocument(itsIconDocument),
	fIconEditView(itsIconEditView)
{
	fChangesClipboard = (itsCommandNumber != cClear);// Cut or Copy changes the clipboard.
	fCausesChange = (itsCommandNumber != cCopy);// Cut or Clear changes the documnt.
}

//----------------------------------------------------------------------------------------
// TIconEditCommand::~TIconEditCommand:
//----------------------------------------------------------------------------------------

TIconEditCommand::~TIconEditCommand()
{
}

//----------------------------------------------------------------------------------------
// TIconEditCommand::DoIt:
//----------------------------------------------------------------------------------------

void TIconEditCommand::DoIt()
{
	if (fIdentifier != cClear)					// If the command is Cut or CopyÉ
	{
		// Écopy the data to the clipboard.

		// Need a document to represent the data to be put on the clipboard.
		// If IIconDocument fails, it should free itself
		CAutoPtr_AC<TIconDocument> clipDocument(TH_new TIconDocument);

		// If IIconEditView fails it should free itself, but we need to free the document
		TIconEditView * clipView = TH_new TIconEditView(gZeroVPt, fIconEditView->GetMagnification());
		clipView->HandlePostCreate(clipDocument);

		fSavedBitMap->CopyDataTo(clipDocument->ReturnBitMap());// Copy data to document icon.

		// Tell the app we have a new clipboard.
		ClaimClipboard(clipView);
		clipDocument.release();
	}

	if (fIdentifier != cCopy)					// Cut or Clear commands clear the icon.
		fIconDocument->ClearIcon();				// Clear the icon.
}

//----------------------------------------------------------------------------------------
// TIconEditCommand::RedoIt:
//----------------------------------------------------------------------------------------

void TIconEditCommand::RedoIt()
{
	if (fIdentifier != cCopy)					// Cut or Clear commands clear the icon.
		fIconDocument->ClearIcon();
}

//----------------------------------------------------------------------------------------
// TIconEditCommand::UndoIt:
//----------------------------------------------------------------------------------------

void TIconEditCommand::UndoIt()
{
	// If the command was Cut or Clear, the new
	if (fIdentifier != cCopy)					// Éicon was cleared, so restore it.
	{
		fSavedBitMap->CopyDataTo(fIconDocument->ReturnBitMap());
		fIconDocument->RedrawViews();			// Make sure all views get redrawn.
	}
}

//========================================================================================
// CLASS TIconPasteCommand
//========================================================================================
#undef Inherited
#define Inherited TCommand

//----------------------------------------------------------------------------------------
// TIconPasteCommand constructor
//----------------------------------------------------------------------------------------

TIconPasteCommand::TIconPasteCommand(TIconEditView* itsIconEditView,
										  TIconDocument* itsIconDocument)
	:	TCommand(cPaste,						// Initialize the commandÉ
				 itsIconDocument,				// Associate it with a document.
				 kCanUndo, kCausesChange, itsIconDocument),

	fSavedIcon(NULL),
	fIconDocument(itsIconDocument),
	fIconEditView(itsIconEditView)
{
	TIconDocument* iconClipDocument = dynamic_cast_AC(TIconDocument*,gClipboardMgr->GetClipboardDocument());
	if (iconClipDocument)
		fSavedIcon = iconClipDocument->ReturnBitMap()->Copy();
}

//----------------------------------------------------------------------------------------
// TIconPasteCommand::~TIconPasteCommand:
//----------------------------------------------------------------------------------------

TIconPasteCommand::~TIconPasteCommand()
{
}

//----------------------------------------------------------------------------------------
// TIconPasteCommand::DoIt:
//----------------------------------------------------------------------------------------

void TIconPasteCommand::DoIt()
{
	TIconBitMap * tempIcon = fIconDocument->ReturnBitMap()->Copy();
	fIconDocument->SetIcon(fSavedIcon.release());
	fSavedIcon = tempIcon;
}

//----------------------------------------------------------------------------------------
// TIconPasteCommand::UndoIt:
//----------------------------------------------------------------------------------------

void TIconPasteCommand::UndoIt()
{
	DoIt();
}

//========================================================================================
// CLASS TIconBitMap
//========================================================================================
#undef Inherited

//----------------------------------------------------------------------------------------
// TIconBitMap constructor
//----------------------------------------------------------------------------------------

TIconBitMap::TIconBitMap()
	:	fDataHandle(NewPermHandle(kIconSizeInBytes))// Allocate a handle for the
{
}

//----------------------------------------------------------------------------------------
// TIconBitMap::Free:
//----------------------------------------------------------------------------------------

TIconBitMap::~TIconBitMap()
{
}

//----------------------------------------------------------------------------------------
// TIconBitMap::SetIconBitMap:
//----------------------------------------------------------------------------------------

void TIconBitMap::SetIconBitMap(Handle theBitMap)
{
	BlockMove_AC(*theBitMap, *fDataHandle,		// Éthen copy it into the document's
				kIconSizeInBytes);				// Éicon bitmap.
}

//----------------------------------------------------------------------------------------
// TIconBitMap::ReadFrom:
//----------------------------------------------------------------------------------------

void TIconBitMap::ReadFrom(CStream_AC* aStream)
{
	long numberOfBytes;

	numberOfBytes = kIconSizeInBytes;
	aStream->ReadBytes(*fDataHandle, numberOfBytes);
}

//----------------------------------------------------------------------------------------
// TIconBitMap::WriteTo:
//----------------------------------------------------------------------------------------

void TIconBitMap::WriteTo(CStream_AC* aStream) const
{
	long numberOfBytes;

	numberOfBytes = kIconSizeInBytes;
	aStream->WriteBytes(*fDataHandle, numberOfBytes);
}

//----------------------------------------------------------------------------------------
// TIconBitMap::LoadFromScrap:
//----------------------------------------------------------------------------------------

void TIconBitMap::LoadFromScrap()
{
	gClipboardMgr->GetScrap(fDataHandle, kIconClipType);	// Load the icon's data from the
															// the clip board and handle errors.
}

//----------------------------------------------------------------------------------------
// TIconBitMap::WriteToScrap:
//----------------------------------------------------------------------------------------

void TIconBitMap::WriteToScrap()
{
	// Write the handle to the desk scrap, failing if an error occurs.
	gClipboardMgr->PutDeskScrapData(kIconClipType, fDataHandle);
}

//----------------------------------------------------------------------------------------
// TIconBitMap::Copy:
//----------------------------------------------------------------------------------------

TIconBitMap* TIconBitMap::Copy()
{
	CAutoPtr_AC<TIconBitMap> copyOfIcon(TH_new TIconBitMap);	// Create a TIconBitMap object.

	copyOfIcon->SetIconBitMap(fDataHandle);					// Copy the data.

	return copyOfIcon.release();							// Return a reference to the new handle.
}

//----------------------------------------------------------------------------------------
// TIconBitMap::CopyDataTo:
//----------------------------------------------------------------------------------------

void TIconBitMap::CopyDataTo(TIconBitMap* anIcon)
{
	anIcon->SetIconBitMap(fDataHandle);			// Copy data to the new icon.
}

//----------------------------------------------------------------------------------------
// TIconBitMap::Clear:
//----------------------------------------------------------------------------------------

void TIconBitMap::Clear()
{
	long* longPtr = reinterpret_cast<long*>(*fDataHandle);
	for (short i = 0; i < kIconSizeInLongs; ++i)
		*longPtr++ = 0;
}

//----------------------------------------------------------------------------------------
// TIconBitMap::Invert:
//----------------------------------------------------------------------------------------

void TIconBitMap::Invert()
{
	long* longPtr = reinterpret_cast<long*>(*fDataHandle);
	for (short i = 0; i < kIconSizeInLongs; ++i)
	{
		*longPtr = ~*longPtr;
		longPtr++;
	}
}

//----------------------------------------------------------------------------------------
// TIconBitMap::Draw:
//----------------------------------------------------------------------------------------

void TIconBitMap::Draw(const CRect_AC& area,
					   const CRGBColor_AC& drawingColor)
{
	CRGBColor_AC saveColor(GetIfColor());
	SetIfColor(drawingColor);

	PenNormal();
	PlotIcon(area, fDataHandle);

	SetIfColor(saveColor);
}

//----------------------------------------------------------------------------------------
// TIconBitMap::GetBit:
//----------------------------------------------------------------------------------------

bool TIconBitMap::GetBit(CViewPoint iconBit)
//  Returns the state of the given bit in the icon being drawn.
{
	short byte;
	short bitInByte;

	IconBitToByteBit(iconBit, byte, bitInByte);

	return (*(*fDataHandle + byte) >> bitInByte) & 1;
}

//----------------------------------------------------------------------------------------
// TIconBitMap::SetBit:  Set the state of the given bit in the icon being drawn.
//----------------------------------------------------------------------------------------

void TIconBitMap::SetBit(CViewPoint iconBit,
						 bool turnBitOn)
{
	short byte;
	short bitInByte;
	char theMask;

	IconBitToByteBit(iconBit, byte, bitInByte);

	theMask = (1 << bitInByte);

	if (turnBitOn)
		*(*fDataHandle + byte) |= theMask;
	else
		*(*fDataHandle + byte) &= ~theMask;		// AND the complement of the mask.
}

//----------------------------------------------------------------------------------------
// TIconBitMap::IconBitToByteBit: This converts the given icon bit to a byte and bit in an
// array of long words.
//----------------------------------------------------------------------------------------

void TIconBitMap::IconBitToByteBit(CViewPoint iconBit,
								   short& byte,
								   short& bit)
{
	long bitNumber = iconBit.v * kIconVBits + iconBit.h;
	byte = static_cast<short>(bitNumber) / 8;
	bit = static_cast<short>(7 - (bitNumber % 8));
}

//========================================================================================
// CLASS TZoomOutCommand
//========================================================================================
#undef Inherited
#define Inherited TCommand

//----------------------------------------------------------------------------------------
// TZoomOutCommand constructor
//----------------------------------------------------------------------------------------

TZoomOutCommand::TZoomOutCommand(TIconDocument* itsIconDocument) :
	TCommand(cZoomOut,					// Initialize the inherited dataÉ
				   itsIconDocument, kCanUndo, kCausesChange, itsIconDocument),// Éno view or scroller to track.

	fIconDocument(itsIconDocument)
{
}

//----------------------------------------------------------------------------------------
// TZoomOutCommand destructor
//----------------------------------------------------------------------------------------

TZoomOutCommand::~TZoomOutCommand()
{
}

//----------------------------------------------------------------------------------------
// TZoomOutCommand::MakeAppleEvent()
//----------------------------------------------------------------------------------------
TAppleEvent* TZoomOutCommand::MakeAppleEvent()
{
	CAutoPtr_AC<TAppleEvent> theEvent(TH_new TAppleEvent(kAEIconEditClass, kAEZoomOutID, gServerAddress, kAENoReply));

	CTempDesc_AC directObjectDesc;
	fIconDocument->MakeObjectSpecifier(directObjectDesc, fIconDocument->GetSpecifierForm());
	theEvent->WriteParameter(keyDirectObject, directObjectDesc);

	return theEvent.release();
}

//----------------------------------------------------------------------------------------
// TZoomOutCommand::DoIt:
//----------------------------------------------------------------------------------------

void TZoomOutCommand::DoIt()
{
	short currentMagnification = fIconDocument->GetIconView()->GetMagnification();
	fIconDocument->GetIconView()->SetMagnification(currentMagnification - 2);
}

//----------------------------------------------------------------------------------------
// TZoomOutCommand::UndoIt:
//----------------------------------------------------------------------------------------

void TZoomOutCommand::UndoIt()
{
	short currentMagnification = fIconDocument->GetIconView()->GetMagnification();
	fIconDocument->GetIconView()->SetMagnification(currentMagnification + 2);
}

//========================================================================================
// CLASS TZoomInCommand
//========================================================================================
#undef Inherited
#define Inherited TCommand

//----------------------------------------------------------------------------------------
// TZoomInCommand constructor
//----------------------------------------------------------------------------------------

TZoomInCommand::TZoomInCommand(TIconDocument* itsIconDocument) :
	TCommand(cZoomIn,						// Initialize the inherited dataÉ
				   itsIconDocument, kCanUndo, kCausesChange, itsIconDocument),// Éno view or scroller to track.

	fIconDocument(itsIconDocument)
{
}

//----------------------------------------------------------------------------------------
// TZoomInCommand destructor
//----------------------------------------------------------------------------------------

TZoomInCommand::~TZoomInCommand()
{
}

//----------------------------------------------------------------------------------------
// TZoomInCommand::MakeAppleEvent()
//----------------------------------------------------------------------------------------
TAppleEvent* TZoomInCommand::MakeAppleEvent()
{
	CAutoPtr_AC<TAppleEvent> theEvent(TH_new TAppleEvent(kAEIconEditClass, kAEZoomInID, gServerAddress, kAENoReply));

	CTempDesc_AC directObjectDesc;
	fIconDocument->MakeObjectSpecifier(directObjectDesc, fIconDocument->GetSpecifierForm());
	theEvent->WriteParameter(keyDirectObject, directObjectDesc);

	return theEvent.release();
}

//----------------------------------------------------------------------------------------
// TZoomInCommand::DoIt:
//----------------------------------------------------------------------------------------

void TZoomInCommand::DoIt()
{
	short currentMagnification = fIconDocument->GetIconView()->GetMagnification();
	fIconDocument->GetIconView()->SetMagnification(currentMagnification + 2);
}

//----------------------------------------------------------------------------------------
// TZoomInCommand::UndoIt:
//----------------------------------------------------------------------------------------

void TZoomInCommand::UndoIt()
{
	short currentMagnification = fIconDocument->GetIconView()->GetMagnification();
	fIconDocument->GetIconView()->SetMagnification(currentMagnification - 2);
}

//----------------------------------------------------------------------------------------
// End of UIconEdit.cp

/*
	Historical Change Record:
		----- R11 -----
		06/26/96	Install release marker.  Scope many globals.  Change TRUE/FALSE/NULL.
		06/26/96	==/!=NULL to implicit tests, except in the case of assignment to or passing/returning as bool/bool.
		06/20/96	Fix compile bug in use of iterator with TDrawPointsCommand::DoIt
		06/19/96	SCpp and MrCpp can't handle declarations in the expression portion of while loops
							so we just changed them all to for loops
		05/20/96	[1348844] Added "break" statements to TIconEditView::DoMenuCommand,
							They were return statements in 3.3.x, but they were removed to be
							single exit code. Without these, you will crash.
		05/02/96	Call FreeIfObject, don't call Free directly since it will eventually be removed.
		04/30/96	Make all constructors use initialization lists if they weren't already
							doing do. Switch several more empty constructors to inlines.
		04/29/96	Create and use functions that return their data as results for:
							TStream::ReadCharacter/CViewPoint/Rect/CViewRect/RGBColor/String. Create compatible inlines
							so users don't have to change their code.
		04/26/96	Made C/CViewPoint/Rect default constructors set the point/rect to a cleared value. Made
		 					clearing very fast/compact. Eliminated the now unnecessary hand clearing of C/CViewPoint/Rects.
		04/26/96	Fix some compile bugs
		04/25/96	More use of CTempxxx classes instead of Failure handling where poss.
		04/24/96	Use PRE-Increment/Decrement operators whenever possible for eff.
		04/24/96	Fix compile errors
		04/23/96	Use CTempObject/Handle/Region/Ptr, etc.
		04/18/96	Use post-increment with iterators in while loops
		04/16/96	Use more "while" style iteration
		04/11/96 	srf		Fix problem introduced in TrackConstraing when converting the expression to
							use MinMax.
		----- R10 -----
		03/31/96 	gjc		Restore correct magnification.
		03/30/96	Restore TIconEditView's constructor which was accidentally deleted
		03/28/96	CalcMinFrame now returns a CViewRect
		03/25/96	Made several accessors non-virtual inline.
							Reformatted code to reflect my own prejudices
		03/21/96	The "SquareDots" parameter of IStdPrintHandler is obsolete
		03/18/96	Made better use of TView calls that return CRect_AC/CViewPoint/CViewRect
		02/08/96	[1286605,1286594] Update Copyright, call RedrawViews
							in SetIconColor.
		01/10/96	Use ctor initializers.
		----- 3.3 -----
		10/24/95	Replace calls to GetBestType with GetSpecifierForm.
		10/21/95	Use GetBestType() in calls to MakeObjectSpecifier.
		----- 3.3b1 -----
		07/28/95	Add configuration functions to use instead of gConfiguration.
	    06/30/95    GJC     Updated Scripting/Recording for Zoom In/Out and Invert
		06/29/95	Remove references to TApplication::GetMyAddress.
		06/29/95	Reorder DoScriptCommand params.
		06/26/95	Fix one more crasher in TPasteCommand.
		06/13/95	Fix to compile with new script dispatcher.
		06/01/95	GetIcon moved from ToolUtils.h to Icons.h.
		  					Use IsRecording instead of hasAppleEventMgr.
		04/11/95	Include UMacAppGlobals and UStream.
		04/10/95	Fix double dispose of original icon when undoing a paste command.
		 					Remove TPasteCommand::RedoIt.
		04/01/95	Include AERegistry.
		03/17/95	MAVolatile.
		02/22/95	[1222850] MacApp should use BlockMove_AC and BlockMoveOverlap_AC
							everywhere
		02/22/95	[1185932] add kBestSystemLocation for -1,-1 window locations
		02/20/95	GetObjectProperty now returns a bool.
		02/03/95	Add desiredType to GetObjectProperty.
		09/22/94	Added scriptability and recordability.
*/