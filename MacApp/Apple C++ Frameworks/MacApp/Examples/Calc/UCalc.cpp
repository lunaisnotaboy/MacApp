//----------------------------------------------------------------------------------------
// UCalc.cpp
// Copyright © 1985-2001 by Apple Computer, Inc. All rights reserved. 
//----------------------------------------------------------------------------------------

/*
	Change History
		05/04/01	DoPostCreate wasn't calling inherited. 
		05/02/01	Use gEmptyString without casting. 
		04/26/01	Use gClipboardMgr accessor methods. 
					PutDeskScrapData returns void. Change WriteToDeskScrap to use 
					temp handles in case PutDeskScrapData throws. 
		03/14/01	[PB] Pass empty string to SetToString.
		03/04/01	Clean up string casting. 
		01/15/01	DoNeedDiskSpace is now const and uses CConstCalcCellIterator.
		01/02/01	Update copyright.
		11/17/00	[PB] DonÕt cast gEmptyString.
		11/04/00	Use CPattern_AC instead of AGAImaging. 
		11/01/00	[PB] Include MacErrors instead of Errors. 
		07/13/00	Removed MA_DEFINE_CLASS of TCalcDocument.
		05/23/00	[2279264] Remove false from ProgramReport_AC. 
					Change ProgramReport_AC(true, to ProgramBreak_AC. 
		05/04/00	Use PenPatBlack() instead of separate Carbon/Classic code.
		04/19/00	CalcViewPerPage is now const.
		12/08/99	Actually use theException in MakeViewForAlienClipboard and .
					DoRead.  Took out MA_DEFINE_CLASS of TCalcDocument.  Removed 
					several compiler specialization.  Removed unnecessary
					ProgramBreak_AC in WriteCalcScrap.
		11/05/99	Carbon:Change GivePasteData to get its own scrapref.
		10/27/99	Add more intialization support for TCalcDocument.
		09/30/99	SetCursor now MacSetCursor.  GetCursor now MacGetCursor.
					SetPort now MacSetPort. FrameRgn now MacFrameRgn.
		09/20/99	Remove asterisk typo from TCellsView constructor. 
		07/23/99	[C] New scrap manager changes.  Cosmetics.
		03/24/99	Update copyright notice.
		03/18/99	Removed '&' on parms to a variety of Toolbox calls.
		02/12/99	[C] 'qd' is no longer accessible; use accessors.
		02/09/99	Replaced a number of dynamic_cast_AC with dynamic_cast_or_throw_AC.
					[C] Changed initialization of TFileBasedDocument.  Defined ÔInheritedÕ
					for TCalcDocument to ease Carbonization and used it.  Rearranged some
					Carbon code.
		01/23/99	Removed ALOE code.  [C] Removed edition related code.
		10/08/98	Change operator const char* to AsText. 
*/

// Calc

#ifndef __UCALC__
#include "UCalc.h"
#endif

// ACS

#if qGrayscaleAppearance
#	ifndef __AGAImaging_AC__
#	include "AGAImaging_AC.h"
#	endif
#endif

// MacApp

#ifndef __UDEBUG__
#include "UDebug.h"
#endif

#if !qCarbon
	#ifndef __USECTIONMGR__
	#include "USectionMgr.h"
	#endif
#endif

#ifndef __UVIEWSERVER__
#include "UViewServer.h"
#endif

#ifndef __UWINDOWMENUBEHAVIOR__
#include "UWindowMenuBehavior.h"
#endif

// Toolbox

#ifndef __MACERRORS__
#include <MacErrors.h>
#endif

#ifndef __QUICKDRAW__
#include <Quickdraw.h>
#endif

#ifndef __RESOURCES__
#include <Resources.h>
#endif

// ANSI


#ifndef __STDLIB__
#include <stdlib.h>
#endif

//----------------------------------------------------------------------------------------
// Global variable definitions.
//----------------------------------------------------------------------------------------
ValueFormat		gGeneralFormat;				// SANE conversion formats 
ValueFormat		gDecimalFormat;
ValueFormat		gNoDecimalFormat;
ValueFormat		gScientificFormat;
ValueFormat		gNoFormat;
FormatRecord	gDefaultFormat;				// default cell format 

Pattern			gColumnSeparatorPattern;	// patterns for separator lines 
Pattern			gRowSeparatorPattern;


//----------------------------------------------------------------------------------------
// ReadCellCoordinate: 
//----------------------------------------------------------------------------------------

GridCell ReadCellCoordinate(TFile* aFile)
{
	// Reads a cell coordinate from a file
	GridCell cellCoordinate;
	long count = sizeof(GridCell);
	::ThrowIfOSErr_AC(aFile->ReadData(&cellCoordinate, count));
	
	return cellCoordinate;
}

//========================================================================================
// CLASS TCalcApplication
//========================================================================================

//----------------------------------------------------------------------------------------
// TCalcApplication constructor 
//----------------------------------------------------------------------------------------

TCalcApplication::TCalcApplication()
	:	TApplication(kFileType, kSignature)
{
	gGeneralFormat.style = FLOATDECIMAL;
	gGeneralFormat.digits = kValuePrecision;

	gDecimalFormat.style = FIXEDDECIMAL;
	gDecimalFormat.digits = 2;

	gNoDecimalFormat.style = FIXEDDECIMAL;
	gNoDecimalFormat.digits = 0;

	gScientificFormat.style = FLOATDECIMAL;
	gScientificFormat.digits = 2;

	gNoFormat.style = FIXEDDECIMAL;
	gNoFormat.digits = -1;

	gDefaultFormat.fJustification = kDefaultJustification;
	gDefaultFormat.fStyle = kGeneral;
	gDefaultFormat.fDigits = 0;
	gDefaultFormat.fFontNumber = kCellFont;
	gDefaultFormat.fFontSize = kCellFontSize;
	gDefaultFormat.fFontStyle = 0;

#if qCarbon
	::GetQDGlobalsGray(&gColumnSeparatorPattern);
	::GetQDGlobalsGray(&gRowSeparatorPattern);
#else
	gColumnSeparatorPattern = qd.gray;
	gRowSeparatorPattern = qd.gray; 
#endif

	// Suppress Linker dead-stripping of these classes 
	REGISTER_CLASS_AC(TCalcWindow);
	REGISTER_CLASS_AC(TCellsView);
	REGISTER_CLASS_AC(TRowsView);
	REGISTER_CLASS_AC(TColumnsView);
	REGISTER_CLASS_AC(TEntryView);
	REGISTER_CLASS_AC(TCoordView);
	REGISTER_CLASS_AC(TPrimaryScroller);
	REGISTER_CLASS_AC(TGridViewDesignator);
	REGISTER_CLASS_AC(TSecondaryScroller);

	AddBehavior(TH_new TWindowMenuBehavior(kNoIdentifier, mWindowMenu, mInvalidateWindowMenu, false, false, false));
}

//----------------------------------------------------------------------------------------
// TCalcApplication destructor
//----------------------------------------------------------------------------------------

TCalcApplication::~TCalcApplication()
{
}

//----------------------------------------------------------------------------------------
// TCalcApplication::AboutToLoseControl: Remove Edit menu buzzwords for incoming Desk
// Accessory
//----------------------------------------------------------------------------------------

void TCalcApplication::AboutToLoseControl(bool convertClipboard) 
{
	SetEditCommandName(cCut, cStandardCut);
	SetEditCommandName(cCopy, cStandardCopy);
	SetEditCommandName(cClear, cStandardClear);

	TApplication::AboutToLoseControl(convertClipboard);
}

//----------------------------------------------------------------------------------------
// TCalcApplication::DoMakeDocument: 
//----------------------------------------------------------------------------------------

TDocument* TCalcApplication::DoMakeDocument(CommandNumber itsCommandNumber, TFile* itsFile)
{
	#pragma unused (itsCommandNumber)
	return TH_new TCalcDocument(itsFile, CRect_AC(1, 1, kMaxColumns, kMaxRows));
}

//----------------------------------------------------------------------------------------
// TCalcApplication::MakeViewForAlienClipboard: Launch a view to represent the data found
// in the Clipboard at application start-up time, or when returning from an excursion to
// MultiFinder, or when returning from a Desk Accessory. This creates a clipboard for
// 'CALC' scrap.
//----------------------------------------------------------------------------------------

TView* TCalcApplication::MakeViewForAlienClipboard() 
{
	TView* returnVal 				= NULL;
	long scrapOffset 				= 0;
	TCalcDocument * clipDocument 	= NULL;
	TCellsView * clipView			= NULL;
	ScrapInfoRecord scrapInfo;
	GridCoordinate r;
	GridCoordinate c;
	short i;
	GridCoordinate cellsRead;
	GridCell cellCoord;
#if !qCarbon
	long offset;
	bool perm;
#endif
	TRow * aRow						= NULL;
	TColumn * aColumn				= NULL;
	TCell * aCell					= NULL;

	// Before doing anything else, make sure the scrap contains my type 
	//GJP 6/14/99
#if qCarbon
	ScrapRef scrapRef;
	ScrapFlavorFlags flavorFlags;
	Size byteCount					= 0;
	GetCurrentScrap( &scrapRef);
	OSStatus err;

	BlockSet_AC(&scrapInfo,sizeof(ScrapInfoRecord),0);

	if (GetScrapFlavorFlags(scrapRef, kCalcScrapType, &flavorFlags))
#else
	if (GetScrap(NULL, kCalcScrapType, &offset) > 0)
#endif
	{
		clipDocument = NULL;					// so failure handler knows to free it 

		try
		{
#if qCarbon				
				err = GetScrapFlavorSize(scrapRef, kCalcScrapType, &byteCount); 	//this is a blocking call !
				
				CTempHandle_AC calcScrap(NewPermHandle(byteCount));
				::ThrowIfMemError_AC();
				
				if (err == noErr && byteCount)
				{
					if (GetScrapFlavorData(scrapRef, kCalcScrapType, &byteCount,*calcScrap)) //this is a blocking call !
					{
						ReadScrap(calcScrap, scrapOffset, reinterpret_cast<unsigned char*>(&scrapInfo), sizeof(scrapInfo));
					}
				}	
#else
			CTempHandle_AC calcScrap(NewPermHandle(0));
			perm = PermAllocation(true);
			scrapOffset = GetScrap(calcScrap, kCalcScrapType, &offset);
			perm = PermAllocation(perm);

			// Only a negative result indicates an error--::ThrowIfOSErr_AC considers any non-zero result an error. 
			if (scrapOffset < 0)
				::ThrowIfOSErr_AC(static_cast<short>(scrapOffset));
				scrapOffset = 0;
			ReadScrap(calcScrap, scrapOffset, reinterpret_cast<unsigned char*>(&scrapInfo), sizeof(scrapInfo));
			::ThrowIfMemError_AC();
#endif
			clipDocument = TH_new TCalcDocument(NULL, scrapInfo.selection);
			clipDocument->DoInitialState();

			// update the user selection to represent the actual selection in the scrap
			TGridViewDesignator* userSelection = dynamic_cast_AC(TGridViewDesignator*, clipDocument->GetUserSelection());
			if (userSelection)
				userSelection->Set(scrapInfo.selection);

			clipView = NULL;
			clipView = TH_new TCellsView(true);
			clipView->HandlePostCreate(clipDocument);
			clipDocument->fCellsView = clipView;

			for (r = 1; r <= (clipDocument->fNoOfRows); ++r)
			{
				aRow = TH_new TRow(r);
				aRow->ReadFromScrap(calcScrap, scrapOffset);
				clipDocument->AddRow(aRow);
			}

			for (c = 1; c <= (clipDocument->fNoOfColumns); ++c)
			{
				aColumn = TH_new TColumn(c);
				aColumn->ReadFromScrap(calcScrap, scrapOffset);
				clipDocument->AddColumn(aColumn);
			}

			cellsRead = 0;
			for (i = 1; i <= (scrapInfo.noOfCells); ++i)
			{
				ReadScrap(calcScrap, scrapOffset, &cellCoord, sizeof(GridCell));
				aCell = clipDocument->GetCell(cellCoord);
				aCell->ReadFromScrap(calcScrap, scrapOffset);
				cellsRead = cellsRead + 1;
			}

#if qDebug
			if (gIntenseDebugging)
			{
				ProgramBreak_AC("MakeViewForAlienClipboard: cellsRead=%d scrapInfo.noOfCells=%d\n", cellsRead, scrapInfo.noOfCells);
				if (cellsRead != scrapInfo.noOfCells)
					ProgramBreak_AC("MakeViewForAlienClipboard: Wrong number of cells");
			}
#endif

			clipView->UpdateFromDocument();		// update view's number of rows, columns, etc
			returnVal = clipView;
		}
		catch(CException_AC& theException)
		{										// We Failed somewhere along the line
			DoCatchMessage_AC(theException);
			delete clipDocument;

			throw;
		}
	}
	else
		returnVal = TApplication::MakeViewForAlienClipboard();
	
	return returnVal;
}

//========================================================================================
// CLASS TCalcDocument
//========================================================================================

#ifdef Inherited
	#undef Inherited
#endif

#if qCarbon
	#define Inherited TFileBasedDocument
#else
	#define Inherited TEditionDocument
#endif	

//----------------------------------------------------------------------------------------
// TCalcDocument::TCalcDocument: 
//----------------------------------------------------------------------------------------

TCalcDocument::TCalcDocument(TFile* itsFile, const GridRect& dimensions) :
#if qCarbon
	TFileBasedDocument(itsFile, kCalcScrapType),
#else
	TEditionDocument(itsFile, kCalcScrapType, kSignature),
#endif	
	fCellsView(NULL),
	fRowsView(NULL),
	fColumnsView(NULL),
	fEntryView(NULL),
	fCoordView(NULL),
	fOffset(0, 0),
	fAllocatedCells(0),				// the number of allocated cells
	fAllocatedRows(0),				// the number of allocated rows
	fAllocatedColumns(0),			// the number of allocated columns 
	fNoOfRows(0),					// maximum number of rows 
	fNoOfColumns(0),				// maximum number of columns

	fEditLocation(1, 1),
	fEditCell(NULL)
{
	fSavePrintInfo = true;						// the 'print info' record of the
												// fDocPrintHandler will be written out to
												// the data fork

	fDimensions = dimensions;

	fOffset = dimensions[topLeft] - GridCell(1, 1);

	if (!(dimensions.bottom == 0 && dimensions.top == 0))	// No rows or columns, if no scrap
	{
		fNoOfRows = dimensions.bottom - dimensions.top + 1;
		fNoOfColumns = dimensions.right - dimensions.left + 1;
	}
	fCalcMode = kCalcMode;
	fSelectionType = kNoSelection;

	fInUseBounds.Set(1, 1, 1, 1);

	// create the user selection 
	TCalcDocument::SetUserSelection(TH_new TGridViewDesignator(GridRect(1, 1, 2, 2))); // won't call right function (without help) til constructor is thru
}

//----------------------------------------------------------------------------------------
// TCalcDocument::DoInitialState: 
//----------------------------------------------------------------------------------------

void TCalcDocument::DoInitialState() 
{
	fAllocatedCells = 0;
	fAllocatedRows = 0;
	fAllocatedColumns = 0;
}

//----------------------------------------------------------------------------------------
// TCalcDocument::DoMakeViews: 
//----------------------------------------------------------------------------------------

void TCalcDocument::DoMakeViews(bool forPrinting)
{
	TCalcWindow * aCalcWindow;
	TEntryView * aTEntryView;
	TCellsView * aCellsView;
	TColumnsView * aColumnsView;
	TRowsView * aRowsView;
	TCoordView * aCoordView;
	TSecondaryScroller * aRowScroller;
	TSecondaryScroller * aColumnScroller;
	TPrimaryScroller * aCalcScroller;

	CViewPoint aVPt;

	aCalcWindow = dynamic_cast_or_throw_AC(TCalcWindow*, TViewServer::fgViewServer->NewTemplateWindow(kCalcWindowType, this));

	aCellsView = dynamic_cast_or_throw_AC(TCellsView*, aCalcWindow->FindSubView('CELL'));
	aRowsView = dynamic_cast_or_throw_AC(TRowsView*, aCalcWindow->FindSubView('ROWS'));
	aColumnsView = dynamic_cast_or_throw_AC(TColumnsView*, aCalcWindow->FindSubView('COLS'));
	aTEntryView = dynamic_cast_or_throw_AC(TEntryView*, aCalcWindow->FindSubView('ENTV'));
	aCoordView = dynamic_cast_or_throw_AC(TCoordView*, aCalcWindow->FindSubView('CORD'));


	fCellsView = aCellsView;
	fRowsView = aRowsView;
	fColumnsView = aColumnsView;
	fEntryView = aTEntryView;
	fCoordView = aCoordView;

	// The TSectionBehavior is now added to the TCellsView in the 'View' resource (see Calc.r).
	// DoAddSectionBehavior(fCellsView);		// add support for Ed Mgr shortcuts

	if (!forPrinting)
	{
		aTEntryView->fText = NULL;
		aTEntryView->fText = NewPermHandle(0);
		aTEntryView->StuffText(aTEntryView->fText);// Stuff the initial text in 
	}

	// The entry view is the target. Its next handler is the cells view
	// TEntryView.DoPostCreate sets the fControlChars field so that Return, Enter etc. 
	// are passed on to the cells view

	aCalcWindow->SetWindowTarget(aTEntryView);
	aTEntryView->SetNextHandler(aCellsView);

	// set up the cells view scroller to scroll the rows and columns too 
	aCalcScroller = dynamic_cast_or_throw_AC(TPrimaryScroller*,aCellsView->GetScroller(true));
	aVPt.Set(kCellWidth, kCellHeight);
	aCalcScroller->SetScrollParameters(aVPt, true, true);

	aColumnScroller = dynamic_cast_or_throw_AC(TSecondaryScroller*,aColumnsView->GetScroller(true));
	aVPt.Set(kCellWidth, 0);
	aColumnScroller->SetScrollParameters(aVPt, true, true);

	aRowScroller = dynamic_cast_or_throw_AC(TSecondaryScroller*,aRowsView->GetScroller(true));
	aVPt.Set(0, kCellHeight);
	aRowScroller->SetScrollParameters(aVPt, true, true);

	aCalcScroller->AddSecondaryScroller(aRowScroller, kNotHDependent, kVDependent);
	aCalcScroller->AddSecondaryScroller(aColumnScroller, kHDependent, kNotVDependent);

	TCalcPrintHandler* aPrintHandler = TH_new TCalcPrintHandler(this,			// its document 
									aCellsView,		// its view 
									!kFixedSize,	// horizontal page size is variable 
									kFixedSize);	// vertical page size is fixed 
	aPrintHandler->fMinimalMargins = false;

	// get existing document's column widths 
	for (CCalcColumnIterator iter(this); iter.Current(); ++iter)
		if (iter->fWidth != kCellWidth)
		{
			fCellsView->SetColWidth(iter->fNumber, 1, iter->fWidth);
			fColumnsView->SetColWidth(iter->fNumber, 1, iter->fWidth);
		}

	if (forPrinting)							// Finder printing 
		aPrintHandler->RedoPageBreaks();
	else
	{
		ShowReverted();					// display the views 

		fEditLocation = GridCell(1, 1);				// default cell to edit is A1 
		SetEntry(fEditLocation);
		fSelectionType = kCellSelection;
	}
}

//----------------------------------------------------------------------------------------
// TCalcDocument::Free: 
//----------------------------------------------------------------------------------------

TCalcDocument::~TCalcDocument()
{
	FreeData();
}

#if !qCarbon

//----------------------------------------------------------------------------------------
// TCalcDocument::DoToPublisher: 
//----------------------------------------------------------------------------------------

void TCalcDocument::DoToPublisher(TCell* theCell,
								  TPublisher* aPublisher)
{
	if (static_cast<TGridViewDesignator*>(aPublisher->GetDesignator())->Contains(theCell->fLocation))
		theCell->AddDependent(aPublisher);
}

#endif

//----------------------------------------------------------------------------------------
// TCalcDocument::FreeData: 
//----------------------------------------------------------------------------------------

void TCalcDocument::FreeData()
{
	fCells.FreeAll();
	fRows.FreeAll();
	fColumns.FreeAll();
}

//----------------------------------------------------------------------------------------
// TCalcDocument::DoNeedDiskSpace: 
//----------------------------------------------------------------------------------------

void TCalcDocument::DoNeedDiskSpace(TFile* itsFile,
									long& dataForkBytes,
									long& rsrcForkBytes) const
{
	// get Print record requirements 
	Inherited::DoNeedDiskSpace(itsFile, dataForkBytes, rsrcForkBytes);

	dataForkBytes += sizeof(CalcDocDiskInfo) + sizeof(RowDiskInfo) * fAllocatedRows + sizeof(ColumnDiskInfo) * fAllocatedColumns;

	for (CConstCalcCellIterator iter(this); iter.Current(); ++iter)
#if defined(__SC__) || defined(__MRC__)
		dataForkBytes += (*iter).GetDiskSize(false);
#else
		dataForkBytes += iter->GetDiskSize(false);
#endif
}

//----------------------------------------------------------------------------------------
// TCalcDocument::DoRead: 
//----------------------------------------------------------------------------------------

void TCalcDocument::DoRead(TFile* aFile, bool forPrinting) 
{
	GridCoordinate	noOfCells;
	GridCoordinate	noOfRows;
	GridCoordinate	noOfColumns;
	TCell*			aCell;
	TRow*			aRow;
	TColumn*		aColumn;
	long			count;

	short			i = 0;
	GridCoordinate	r = 0;
	GridCoordinate	c = 0;

	try
	{
		Inherited::DoRead(aFile, forPrinting);

		// Get info about the document
		{
			CalcDocDiskInfo theDocInfo;


			count = sizeof(CalcDocDiskInfo);
			::ThrowIfOSErr_AC(aFile->ReadData(&theDocInfo, count));

			fDimensions = theDocInfo.dimensions;
			fCalcMode = theDocInfo.calcMode;
			noOfRows = theDocInfo.allocatedRows;
			noOfColumns = theDocInfo.allocatedColumns;
			fAllocatedCells = theDocInfo.allocatedCells;
			fSelectionType = kNoSelection;
			fEditLocation.v = theDocInfo.editRow;
			fEditLocation.h = theDocInfo.editColumn;

			fNoOfRows = fDimensions.bottom - fDimensions.top + 1;
			fNoOfColumns = fDimensions.right - fDimensions.left + 1;

			// Save the number of cells to be read, then set fAllocatedCells to
			// zero.  As each cell is read fAllocatedCells is incremented.
			// When we've finished, noOfCells must equal fAllocatedCells. 
			noOfCells = fAllocatedCells;
			DoInitialState();				// clear allocation counts 
		}

		for (i = 1; i <= noOfRows; ++i)			// Get info about each row 
		{
			count = sizeof(r);
			::ThrowIfOSErr_AC(aFile->ReadData(&r, count));
			aRow = GetRow(r);
			aRow->ReadFromDisk(aFile);
		}

		for (i = 1; i <= noOfColumns; ++i)		// Get info about each column 
		{
			count = sizeof(c);
			::ThrowIfOSErr_AC(aFile->ReadData(&c, count));
			aColumn = GetColumn(c);
			aColumn->ReadFromDisk(aFile);
		}

		for (i = 1; i <= noOfCells; ++i)		// Read in the cells 
		{
			GridCell coord = ReadCellCoordinate(aFile);
			r = coord.v;
			c = coord.h;
			aCell = GetCell(coord);
			aCell->ReadFromDisk(aFile);
		}

#if qDebug
		if (gIntenseDebugging)
		{
			ProgramBreak_AC("TCalcDocument.DoRead: noOfCells=%d", noOfCells);
			if (noOfCells != fAllocatedCells)
			{
				ProgramBreak_AC("TCalcDocument.DoRead: Wrong number of cells.  noOfCells=%d, fAllocatedCells=%d", noOfCells, fAllocatedCells);
				ProgramBreak_AC("");
			}
		}
#endif
	}
	catch(CException_AC& theException)
	{
		// Oh Boy are we in trouble 
		// Need to set back rows and columns to reflect the number read in so
		// the freedata routine (which will eventually be called by other
		// failure handlers on the stack) won't try to free unallocated objects

		DoCatchMessage_AC(theException);
		if (!c)
		{
			// We died while reading the rows in
			fNoOfRows = r - 1;
			fNoOfColumns = 0;
		}
		else if (!i)
		{
			// Died in the columns 
			fNoOfColumns = c - 1;
		}

		throw;							// tell everyone else we died too.
	}
}

//----------------------------------------------------------------------------------------
// TCalcDocument::DoWrite: 
//----------------------------------------------------------------------------------------

void TCalcDocument::DoWrite(TFile* aFile, bool makingCopy)
{
	Inherited::DoWrite(aFile, makingCopy);

	if (aFile)
	{
		// Write info about the document 
		{
			CalcDocDiskInfo theDocInfo;
			long count;

			theDocInfo.dimensions = fDimensions;
			theDocInfo.calcMode = fCalcMode;
			theDocInfo.allocatedRows = fAllocatedRows;
			theDocInfo.allocatedColumns = fAllocatedColumns;
			theDocInfo.allocatedCells = fAllocatedCells;
			theDocInfo.selectionType = kNoSelection;
			theDocInfo.editRow = fEditLocation.v;
			theDocInfo.editColumn = fEditLocation.h;
			count = sizeof(CalcDocDiskInfo);
			::ThrowIfOSErr_AC(aFile->WriteData(&theDocInfo, count));
		}

		{
			// Write info about each row 
			for (CCalcRowIterator iter(this); iter.Current(); ++iter)
				iter->WriteToDisk(aFile);		// EachExistingRowDo(WriteRow);
		}

		{
			// Write info about each column 
			for (CCalcColumnIterator iter(this); iter.Current(); ++iter)
			// aColumn->fWidth = fColumnsView->GetColWidth(aCell.h); 
				iter->WriteToDisk(aFile);
			// this was "EachExistingColumnDo(WriteColumn);	"
		}

		GridCoordinate cellsWritten = 0;
		{
			// Write out the cells
			for (CExistingCalcCellIterator iter(this); iter.Current(); ++iter)
			{
				iter->WriteToDisk(aFile);
				++cellsWritten;
			}
			// EachExistingCellDo(WriteCell);			 
		}

#if qDebug
		if (cellsWritten != fAllocatedCells)
			ProgramBreak_AC("DoWrite: Incorrect number of cells written");
#endif
	}
}

//----------------------------------------------------------------------------------------
// TCalcDocument::DoSetupMenus: 
//----------------------------------------------------------------------------------------

void TCalcDocument::DoSetupMenus() 

{
	Inherited::DoSetupMenus();

	Enable(cRecalculate, true);
	EnableCheck(cAutoCalc, true, IsAutoCalc());
	EnableCheck(cManualCalc, true, fCalcMode == kManual);

	if (fColumnIsSelected)
	{
		FormatRecord columnFormat = ColumnExists(fEditLocation.h) ?
									GetColumn(fEditLocation.h)->fFormat : gDefaultFormat;

		short justification = columnFormat.fJustification;
		EnableCheck(cSystemJustify, true, justification == teFlushDefault);
		EnableCheck(cForceLeftJustify, true, justification == teFlushLeft);
		EnableCheck(cRightJustify, true, justification == teFlushRight);
		EnableCheck(cCenter, true, justification == teCenter);

		TypeOfStyle theStyle = columnFormat.fStyle;
		EnableCheck(cGeneral, true, theStyle == kGeneral);
		EnableCheck(cDecimal, true, theStyle == kDecimalStyle);
		EnableCheck(cNoDecimal, true, theStyle == kNoDecimal);
		EnableCheck(cScientific, true, theStyle == kScientific);
	}
	else
	{
		Enable(cSystemJustify, false);
		Enable(cForceLeftJustify, false);
		Enable(cRightJustify, false);
		Enable(cCenter, false);

		Enable(cGeneral, false);
		Enable(cDecimal, false);
		Enable(cNoDecimal, false);
		Enable(cScientific, false);
	}

}

//----------------------------------------------------------------------------------------
// TCalcDocument::DoMenuCommand: 
//----------------------------------------------------------------------------------------

void TCalcDocument::DoMenuCommand(CommandNumber aCommandNumber)
{
	switch (aCommandNumber)
	{
		case cRecalculate:
			{
				DoRecalculate(kForceAutomatic, kUpdateDependencies);
				break;
			}
		case cAutoCalc:
			{
				fCalcMode = kAutomatic;
				DoRecalculate(kForceAutomatic, kUpdateDependencies);
				break;
			}
		case cManualCalc:
			{
				fCalcMode = kManual;
				break;
			}

		case cGeneral:
		case cNoDecimal:
		case cDecimal:
		case cScientific:
		case cSystemJustify:
		case cForceLeftJustify:
		case cRightJustify:
		case cCenter:
			{
				PostCommand(TH_new TColumnFormatter(this, aCommandNumber));
				break;
			}

		default:
			{
				Inherited::DoMenuCommand(aCommandNumber);
				break;
			}
	}
}

//----------------------------------------------------------------------------------------
// TCalcDocument::AddCell: 
//----------------------------------------------------------------------------------------

void TCalcDocument::AddCell(TCell* theCell,
							GridCell itsLoc)
{
	theCell->fCalcDocument = this;
	theCell->fLocation = itsLoc;

	fCells.Insert(theCell);
	++fAllocatedCells;

	fInUseBounds |= GridRect(itsLoc, itsLoc);

#if !qCarbon
	for (CSectionIterator iter(this); iter.Current(); ++iter)
		if (iter->GetSectionType() == stPublisher)
			DoToPublisher(theCell, dynamic_cast_AC(TPublisher*,iter.Current()));
#endif
}

//----------------------------------------------------------------------------------------
// TCalcDocument::CellExists: 
//----------------------------------------------------------------------------------------

bool TCalcDocument::CellExists(GridCell itsLoc)
{
	TCell * aCell = fCells.GetCell(itsLoc);

	return aCell && !aCell->IsDeleted();
}

//----------------------------------------------------------------------------------------
// TCalcDocument::DeleteCell: 
//----------------------------------------------------------------------------------------

void TCalcDocument::DeleteCell(GridCell itsLoc)
{
	TCell* theCell = GetExistingCell(itsLoc);
	if (theCell && !theCell->IsDeleted())
	{
		theCell->SetDeleteState(true);
		fAllocatedCells = fAllocatedCells - 1;
		if (theCell == fEditCell)
			fEntryView->SetToString(gEmptyString);
	}
}

//----------------------------------------------------------------------------------------
// TCalcDocument::IsExistingCell: 
//----------------------------------------------------------------------------------------

bool TCalcDocument::IsExistingCell(TCell* aCell)
{
	// returns true if it's an ALLOCATED cell 
	return !aCell->IsDeleted();
}

//----------------------------------------------------------------------------------------
// TCalcDocument::EditCell: Change the formula of the cell being edited to the CPascalStr_AC in
// the entry view
//----------------------------------------------------------------------------------------

void TCalcDocument::EditCell()
{
	CStr255_AC theString(fEntryView->GetAsString());

#if qRangeCheck && qDebugMsg
	// Do a sanity check on fEditLocation
	if ((fEditLocation.h < 1) || (fEditLocation.v < 1))
	{
		ProgramBreak_AC("fEditLocation = (&1d, %1d)\n", fEditLocation.h, fEditLocation.v);
		::ProgramBreak_AC("EditCell - fEditLocation is invalid");
	}
#endif

 	if (!fEditCell)
		fEditCell = GetCell(fEditLocation);

	// Cell could have been deleted by a cut or clear command
	UndeleteCell(fEditLocation);

	fEditCell->SetToString(theString);
}

//----------------------------------------------------------------------------------------
// TCalcDocument::FreeCell: 
//----------------------------------------------------------------------------------------

void TCalcDocument::FreeCell(TCell* theCell)
{
#if qDebug
	if (fCells.GetCell(theCell->fLocation) != theCell)
		ProgramBreak_AC("TCalcDocument.FreeCell: Cell table inconsistent");
#endif

	fCells.Delete(theCell);

	delete theCell;
}

//----------------------------------------------------------------------------------------
// TCalcDocument::FreeDeletedCells: 
//----------------------------------------------------------------------------------------

void TCalcDocument::FreeDeletedCells()
{
	for (CCalcCellIterator iter(this); iter.Current(); ++iter)
		if (iter->fDeleted)
			FreeCell(iter);
}

//----------------------------------------------------------------------------------------
// TCalcDocument::GetCell: Return the cell object for the given coordinates. If a cell
// object doesn't already exist, create one.
//----------------------------------------------------------------------------------------

TCell* TCalcDocument::GetCell(GridCell cellLocation)
{
	TCell * theCell = fCells.GetCell(cellLocation);
	if (!theCell)
	{
		theCell = TH_new TCell(this, cellLocation);
		AddCell(theCell, cellLocation);
	}

	return theCell;
}

//----------------------------------------------------------------------------------------
// TCalcDocument::GetExistingCell: 
//----------------------------------------------------------------------------------------

TCell* TCalcDocument::GetExistingCell(GridCell itsLoc)
{
	return fCells.GetCell(itsLoc);
}

//----------------------------------------------------------------------------------------
// TCalcDocument::IsAutoCalc: 
//----------------------------------------------------------------------------------------

bool TCalcDocument::IsAutoCalc()
{
	return fCalcMode == kAutomatic;
}

//----------------------------------------------------------------------------------------
// TCalcDocument::SetEntry:  Set the CPascalStr_AC in TEntryView to the formula in the cell 
//----------------------------------------------------------------------------------------

void TCalcDocument::SetEntry(GridCell itsLoc)
{
	TCell * theCell = GetExistingCell(itsLoc);

	if (theCell && !theCell->IsDeleted())
		fEntryView->SetToString(theCell->GetAsString());
	else
		fEntryView->SetToString(gEmptyString);
}

//----------------------------------------------------------------------------------------
// TCalcDocument::UndeleteCell: 
//----------------------------------------------------------------------------------------

void TCalcDocument::UndeleteCell(GridCell itsLoc)
{
	TCell* theCell = GetExistingCell(itsLoc);
	if (theCell && theCell->IsDeleted())
	{
		theCell->SetDeleteState(false);
		++fAllocatedCells;
	}
}

//----------------------------------------------------------------------------------------
// TCalcDocument::AddRow: 
//----------------------------------------------------------------------------------------

void TCalcDocument::AddRow(TRow* theRow)
{
	fRows.Insert(theRow);
	++fAllocatedRows;

	fInUseBounds.top = Min_AC(fInUseBounds.top, theRow->fNumber);
	fInUseBounds.bottom = Max_AC(fInUseBounds.bottom, theRow->fNumber);
}

//----------------------------------------------------------------------------------------
// TCalcDocument::GetRow: 
//----------------------------------------------------------------------------------------

TRow* TCalcDocument::GetRow(GridCoordinate r)
{
	TRow * theRow = fRows.GetRow(r);
	if (!theRow)
	{
		theRow = TH_new TRow(r);
		AddRow(theRow);
	}

	return theRow;
}

//----------------------------------------------------------------------------------------
// TCalcDocument::RowExists: 
//----------------------------------------------------------------------------------------

bool TCalcDocument::RowExists(GridCoordinate r)
{
	return fRows.GetRow(r) != NULL;
}

//----------------------------------------------------------------------------------------
// TCalcDocument::AddColumn: 
//----------------------------------------------------------------------------------------

void TCalcDocument::AddColumn(TColumn* theColumn)
{
	fColumns.Insert(theColumn);
	fAllocatedColumns = fAllocatedColumns + 1;

	fInUseBounds.left = Min_AC(fInUseBounds.left, theColumn->fNumber);
	fInUseBounds.right = Max_AC(fInUseBounds.right, theColumn->fNumber);
}

//----------------------------------------------------------------------------------------
// TCalcDocument::ColumnExists: 
//----------------------------------------------------------------------------------------

bool TCalcDocument::ColumnExists(GridCoordinate c)
{
	return fColumns.GetColumn(c) != NULL;
}

//----------------------------------------------------------------------------------------
// TCalcDocument::GetColumn: 
//----------------------------------------------------------------------------------------

TColumn* TCalcDocument::GetColumn(GridCoordinate c)
{
	TColumn * theColumn = fColumns.GetColumn(c);

	if (!theColumn)
	{
		theColumn = TH_new TColumn(c);
		AddColumn(theColumn);
	}

	return theColumn;
}

//----------------------------------------------------------------------------------------
// TCalcDocument::CellInRange: 
//----------------------------------------------------------------------------------------

bool TCalcDocument::CellInRange(GridCoordinate r,
								   GridCoordinate c,
								   const GridRect& range)
{
	return r >= range.top && r <= range.bottom && c >= range.left && c <= range.right;
}

//----------------------------------------------------------------------------------------
// TCalcDocument::ConstrainToUsedCells: Given a range of cells, this returns the range of
// cells that fall within the range of used cells. This is used to optimize performance so
// that we don't try to operate on cells that we know have never been used (i.e.
// allocated).
//----------------------------------------------------------------------------------------

void TCalcDocument::ConstrainToUsedCells(GridRect& cellRange)
{
	cellRange.top = Max_AC(cellRange.top, fInUseBounds.top);
	cellRange.left = Max_AC(cellRange.left, fInUseBounds.left);
	cellRange.bottom = Min_AC(cellRange.bottom, fInUseBounds.bottom);
	cellRange.right = Min_AC(cellRange.right, fInUseBounds.right);
}

//----------------------------------------------------------------------------------------
// TCalcDocument::DoRecalculate: 
//----------------------------------------------------------------------------------------

void TCalcDocument::DoRecalculate(bool forceAutomatic,
								  bool setDependents)
{
	if (IsAutoCalc() || forceAutomatic)
	{
		for (CCalcCellIterator iter(this); iter.Current(); ++iter)
			iter->Recalculate(forceAutomatic, setDependents);
	}
	else
	{
		for (CSelectedExistingCalcCellIterator iter(this); iter.Current(); ++iter)
			iter->Recalculate(forceAutomatic, setDependents);
	}
	MarkChanged(); // enable Save - document may have changed 
}

//----------------------------------------------------------------------------------------
// TCalcDocument::SetUserSelection: 
//----------------------------------------------------------------------------------------

void TCalcDocument::SetUserSelection(TDesignator* newSelection)
{
	Inherited::SetUserSelection(newSelection);
	
	if (fCellsView && fCellsView->GetSelections())
	{
		TDesignator* userSelection = GetUserSelection();
		if (userSelection && dynamic_cast_AC(TGridViewDesignator*, userSelection))
			fCellsView->SetSelection(dynamic_cast_or_throw_AC(TGridViewDesignator*,userSelection), kDontExtend, kHighlight, kSelect);
	}
}

//----------------------------------------------------------------------------------------
// TCalcDocument::UserSelectionChanged: 
//----------------------------------------------------------------------------------------

void TCalcDocument::UserSelectionChanged(TView* changedView) 
{
	// let the document's selection designator know that the designation has changed 
	TDesignator * userSelection = GetUserSelection();
	if (userSelection && dynamic_cast_AC(TGridViewDesignator*, userSelection))
		dynamic_cast_or_throw_AC(TGridViewDesignator*,userSelection)->Set(fCellsView->GetSelections());

	Inherited::UserSelectionChanged(changedView);
}

//----------------------------------------------------------------------------------------
// TCalcDocument::DoWriteData: 
//----------------------------------------------------------------------------------------

void TCalcDocument::DoWriteData(const OSType aScrapType,
								TDesignator* aDesignator,
								CStream_AC* aStream) 
{
	if (aScrapType == kTextType_AC)
	{
		Handle textHandle = fCellsView->DesignatorAsTEXT(aDesignator);
		SignedByte savedState = LockHandleHigh(textHandle);

		aStream->WriteBytes((*textHandle), GetHandleSize(textHandle));

		HSetState(textHandle, savedState);
		DisposeHandle(textHandle);
	}
	else if (aScrapType == fScrapType)
		DoWritePrivateTypes(aDesignator, aStream);
}

//----------------------------------------------------------------------------------------
// TCalcDocument::DoWritePrivateTypes: 
//----------------------------------------------------------------------------------------

void TCalcDocument::DoWritePrivateTypes(TDesignator* aDesignator,
										CStream_AC* aStream)
{
	GridRect selection;
	short i;
	RowDiskInfo rowInfo;
	ColumnDiskInfo columnInfo;

	if (dynamic_cast_AC(TGridViewDesignator*, aDesignator))
	{
		// Write out extent. 
		selection = dynamic_cast_or_throw_AC(TGridViewDesignator*,aDesignator)->GetBounds();
		--selection[botRight];	// shrink it by 1 so we don't get an extra cell
		aStream->WriteBytes(&selection, sizeof(selection));

		// Write out row info. 
		for (i = selection.top; i <= selection.bottom; ++i)
		{
			rowInfo.number = GetRow(i)->fNumber;// Need a GetRowDiskInfo(). 
			aStream->WriteBytes(&rowInfo, sizeof(rowInfo));
		}

		// Write out column info. 
		for (i = selection.left; i <= selection.right; ++i)
		{
			TColumn * aColumn;					//temporary variable scoped to the for loop only!!!

			aColumn = GetColumn(i);
			columnInfo.number = aColumn->fNumber;
			columnInfo.format = aColumn->fFormat;
			columnInfo.width = aColumn->fWidth;
			aStream->WriteBytes(&columnInfo, sizeof(columnInfo));
		}

		// Write out cell info. 
		CCellIterator iter(fCellsView, selection[topLeft], selection[botRight], kIterateForward_AC, kIterateForward_AC, CCellIterator::kIterateRowMajor);
		for (GridCell aGridCell = iter.FirstCell(); iter.Current() != gZeroVPt; aGridCell = ++iter)
		{
			TCell * aCell = GetCell(aGridCell);

			CellDiskInfo cellInfo;
			cellInfo.kind = aCell->fKind;
			cellInfo.error = aCell->fError;
			cellInfo.value = aCell->fValue;
			cellInfo.noOfReferences = 0;
			cellInfo.formula = aCell->fFormula;
			aStream->WriteBytes(&cellInfo, sizeof(cellInfo));
		}
	}
	else if (qDebug)
		ProgramBreak_AC("I don't recognize that designatorÉsigh!");
}

//----------------------------------------------------------------------------------------
// TCalcDocument::DoReadData: 
//----------------------------------------------------------------------------------------

void TCalcDocument::DoReadData(const OSType aScrapType,
							   TDesignator* aDesignator,
							   CStream_AC* aStream,
							   long length) 
{
	if (aScrapType == kTextType_AC)
		DoReadTEXT(aDesignator, aStream, length);
	else if (aScrapType == fScrapType)
		DoReadPrivateTypes(aDesignator, aStream);
}

//----------------------------------------------------------------------------------------
// TCalcDocument::DoReadPrivateTypes: 
//----------------------------------------------------------------------------------------

void TCalcDocument::DoReadPrivateTypes(TDesignator* aDesignator,
									   CStream_AC* aStream)

{
	// read in the publisher bounds and figure out the difference 
	GridRect subBounds = dynamic_cast_or_throw_AC(TGridViewDesignator*,aDesignator)->GetBounds();

	GridRect pubBounds;							// bounds of the publisher 
	aStream->ReadBytes(&pubBounds, sizeof(pubBounds));
	GridCell difference(subBounds[topLeft] - pubBounds[topLeft]);

	// Read in row info. 
	RowDiskInfo rowInfo;
	ColumnDiskInfo columnInfo;

	short i;
	for (i = pubBounds.top; i <= pubBounds.bottom; ++i)
		aStream->ReadBytes(&rowInfo, sizeof(rowInfo));

	// Read in the col info and set it. 
	for (i = pubBounds.left; i <= pubBounds.right; ++i)
	{
		aStream->ReadBytes(&columnInfo, sizeof(columnInfo));
		if ((i + difference.h >= subBounds.left) && (i + difference.h <= subBounds.right) && (!ColumnExists(i)))
		{
			TColumn * aColumn;					//local variable to do WITH scoped to this "if" only

			aColumn = GetColumn(i);
			aColumn->fNumber = columnInfo.number;
			aColumn->fFormat = columnInfo.format;
			aColumn->fWidth = columnInfo.width;
		}
	}

	// Read in the cell info.
	CCellIterator iter(fCellsView, pubBounds[topLeft], pubBounds[botRight], kIterateForward_AC, kIterateForward_AC, CCellIterator::kIterateRowMajor);
	for (GridCell aGridCell = iter.FirstCell(); iter.Current() != gZeroVPt; aGridCell = ++iter)
	{
		// map a published cell into subscriber range 
		aGridCell += difference;
		TCell * aCell = GetCell(aGridCell);	// retrieve or create a TCell 

		CellDiskInfo cellInfo;
		aStream->ReadBytes(&cellInfo, sizeof(cellInfo));
		if ((aGridCell.h >= subBounds.left) && (aGridCell.h <= subBounds.right) && (aGridCell.v >= subBounds.top) && (aGridCell.v <= subBounds.bottom))
			if ((aCell->fKind != cellInfo.kind) || (aCell->fError != cellInfo.error) || (aCell->fValue != cellInfo.value) || (aCell->fFormula != cellInfo.formula))
			{
				aCell->fFormula = cellInfo.formula;
				aCell->Recalculate(true, true);
				aCell->invalidate();
			}
	}
}

//----------------------------------------------------------------------------------------
// TCalcDocument::DoReadTEXT: 
//----------------------------------------------------------------------------------------

void TCalcDocument::DoReadTEXT(TDesignator* aDesignator,
							   CStream_AC* aStream,
							   long length)

{
	CTempHandle_AC theText(NewPermHandle(length));
	LockHandleHigh(theText);
	aStream->ReadBytes(*theText, length);

	GridRect subBounds(dynamic_cast_or_throw_AC(TGridViewDesignator*,aDesignator)->GetBounds());

	CCellIterator iter(fCellsView, subBounds[topLeft], subBounds[botRight], kIterateForward_AC, kIterateForward_AC, CCellIterator::kIterateRowMajor);
	CParseSubscribedText theParser(length, subBounds);
	for (GridCell aGridCell = iter.FirstCell(); iter.Current() != gZeroVPt; aGridCell = ++iter)
	{
		TCell * aCell = GetCell(aGridCell);// retrieve or create a TCell 
		aCell->SetToString(theParser.ParseSubscribedText(theText, aGridCell));
	}
}


#if !qCarbon

//----------------------------------------------------------------------------------------
// TCalcDocument::AddPublisherDependency: 
//----------------------------------------------------------------------------------------

void TCalcDocument::AddPublisherDependency(TSection* aSection)
{
	if (fCellsView && (aSection->GetSectionType() == stPublisher))
	{
		// make each publisher a dependent of each cell in the designation 
		
		CCellInRegionIterator iter(fCellsView, static_cast<TGridViewDesignator*>(aSection->GetDesignator()));
		for (GridCell aGridCell = iter.FirstCell(); iter.Current() != gZeroVPt; aGridCell = ++iter)
			if (CellExists(aGridCell))
				GetCell(aGridCell)->AddDependent(aSection);
	}
}

//----------------------------------------------------------------------------------------
// TCalcDocument::RemovePublisherDependency
//----------------------------------------------------------------------------------------

void TCalcDocument::RemovePublisherDependency(TSection* aSection)
{
	if (fCellsView && (aSection->GetSectionType() == stPublisher))
	{
		// Remove the dependencies of the publisher on the cells in the designation 
		
		CCellInRegionIterator iter(fCellsView, static_cast<TGridViewDesignator*>(aSection->GetDesignator()));
		for (GridCell aGridCell = iter.FirstCell(); iter.Current() != gZeroVPt; aGridCell = ++iter)
			if (CellExists(aGridCell))
				GetCell(aGridCell)->RemoveDependent(aSection);
	}
}

//----------------------------------------------------------------------------------------
// TCalcDocument::DoAddBorder: 
//----------------------------------------------------------------------------------------

void TCalcDocument::DoAddBorder(TSection* aSection)
{
	// adding a section, give it a section adorner 
	if (fCellsView)
	{
		if (aSection->GetSectionType() == stSubscriber)
			fCellsView->CreateSubscriberAdorner(dynamic_cast_or_throw_AC(TSubscriber*,aSection));
		else
			fCellsView->CreatePublisherAdorner(dynamic_cast_or_throw_AC(TPublisher*,aSection));

		// invalidate the borders of publishers/subscribers, if we aren't showing all borders
		if (!fShowSectionBorders)
			for (CAdornerIterator iter(fCellsView); iter.Current(); ++iter)
				if (iter->GetIdentifier() == kPublisherAdornerID || iter->GetIdentifier() == kSubscriberAdornerID)
					iter->InvalidateAdorner(fCellsView);
	}

	if (aSection->IsRegistered())
		AddPublisherDependency(aSection);
}

//----------------------------------------------------------------------------------------
// TCalcDocument::DoDeleteBorder: 
//----------------------------------------------------------------------------------------

void TCalcDocument::DoDeleteBorder(TSection* aSection)
{
	// adding a section, give it a section adorner 
	for (CAdornerIterator iter(fCellsView); iter.Current(); ++iter)
		if (iter->GetIdentifier() == kPublisherAdornerID || iter->GetIdentifier() == kSubscriberAdornerID)
			if (dynamic_cast_or_throw_AC(TSectionAdorner*,iter.Current())->GetSection() == aSection)
			{
				fCellsView->DeleteAdorner(iter, kInvalidate);
				break;
			}

	// invalidate the borders of publishers/subscribers, if we aren't showing all borders
	if (!fShowSectionBorders)
		for (CAdornerIterator iter(fCellsView); iter.Current(); ++iter)
			if (iter->GetIdentifier() == kPublisherAdornerID || iter->GetIdentifier() == kSubscriberAdornerID)
				iter->InvalidateAdorner(fCellsView);

	if (!aSection->IsRegistered())
		RemovePublisherDependency(aSection);
}

//----------------------------------------------------------------------------------------
// TCalcDocument::RevealSelection: 
//----------------------------------------------------------------------------------------

void TCalcDocument::RevealSelection(TDesignator* aSelection) 
{
	TEditionDocument::RevealSelection(aSelection);		// make window front-most 

	if (dynamic_cast_AC(TGridViewDesignator*, aSelection))
	{
		fCellsView->SetSelection(dynamic_cast_or_throw_AC(TGridViewDesignator*,aSelection), kDontExtend, kHighlight, kSelect);

		fCellsView->ScrollSelectionIntoView(kRedraw);
	}
	else if (qDebug)
		ProgramBreak_AC("handed an unknown designator");
}

//----------------------------------------------------------------------------------------
// TCalcDocument::DoPostMakeViews: 
//----------------------------------------------------------------------------------------

void TCalcDocument::DoPostMakeViews(bool forPrinting)
{
	if (!forPrinting)
		for (CSectionIterator iter(this); iter.Current(); ++iter)
			AddPublisherDependency(iter);

	TEditionDocument::DoPostMakeViews(forPrinting);
}

#endif

//========================================================================================
// CLASS TCalcWindow
//========================================================================================

MA_DEFINE_CLASS(TCalcWindow);

//----------------------------------------------------------------------------------------
// TCalcWindow destructor
//----------------------------------------------------------------------------------------

TCalcWindow::~TCalcWindow()
{
}

//----------------------------------------------------------------------------------------
// TCalcWindow::DoPostCreate: 
//----------------------------------------------------------------------------------------

void TCalcWindow::DoPostCreate(TDocument* itsDocument)
{
	TWindow::DoPostCreate(itsDocument);

	CPoint_AC minSize(284, 126);
	SetResizeLimits(minSize, fResizeLimits[botRight]);
}

//----------------------------------------------------------------------------------------
// TCalcWindow::Draw: 
//----------------------------------------------------------------------------------------

void TCalcWindow::Draw(const CViewRect& area)
{
	// draw the extra borders for the rows and columns views 
	PenNormal();

	// rows 
	MoveTo(0, 35);
	Line(kRowTitleWidth - 1, 0);

	MoveTo(0, 35 + kCellHeight);
	Line(kRowTitleWidth - 1, 0);

	// columns 
	MoveTo(kRowTitleWidth - 1, 35);
	Line(0, kCellHeight);

#if qGrayscaleAppearance
	CRect_AC bgRect(1, 36, kRowTitleWidth - 1, 36 + kCellHeight - 1);
	AGABackgroundPaint(bgRect, true, kFlatWindowBackground, true, false);
#endif

	TWindow::Draw(area);
}

//========================================================================================
// CLASS TCellsView
//========================================================================================

MA_DEFINE_CLASS(TCellsView);

//----------------------------------------------------------------------------------------
// TCellsView::TCellsView: 
//----------------------------------------------------------------------------------------

TCellsView::TCellsView(bool forClipboard)
	:	TTextGridView(gZeroVPt, gZeroVPt, sizeVariable, sizeVariable, 0, 0, 0, kCellWidth, kAdorn, kAdorn, 0, 0, false, gSystemStyle)
{
	#pragma unused (forClipboard)
	fCalcDocument = NULL;
	fLastOptionKey = false;						// Used for DoSetCursor to the grabber hand 

	fIdleFreq = Max_AC(GetCaretTime() / 2, 1);// So we can trackCursor for the GrabberHand.
	// With MF 7.0 we could setup a VBL that monitered the modifiers and called Wakeup
	// with our PID. Even better would be a call that set the event manager so that an
	// event could be returned on modifier key changesÉ oh, well. 

	fHelpID = kCellsViewHelp;
	fHelpIndex = 1;
}

//----------------------------------------------------------------------------------------
// TCellsView destructor
//----------------------------------------------------------------------------------------

TCellsView::~TCellsView()
{
}

#if !qCarbon

//----------------------------------------------------------------------------------------
// TCellsView::CreatePublisherAdorner: 
//----------------------------------------------------------------------------------------

void TCellsView::CreatePublisherAdorner(TPublisher* aPublisher)
{
	RgnHandle itsBorderRegion = MakeNewRgn();
	ComputeBorderRgn(itsBorderRegion, static_cast<TGridViewDesignator*>(aPublisher->GetDesignator()));

	AddAdorner(TH_new TPublisherAdorner(kPublisherAdornerID, aPublisher, itsBorderRegion), kAdornAfter, fCalcDocument->IsBorderShown(aPublisher));
}

//----------------------------------------------------------------------------------------
// TCellsView::CreateSubscriberAdorner: 
//----------------------------------------------------------------------------------------

void TCellsView::CreateSubscriberAdorner(TSubscriber* aSubscriber)
{
	RgnHandle itsBorderRegion = MakeNewRgn();
	ComputeBorderRgn(itsBorderRegion, static_cast<TGridViewDesignator*>(aSubscriber->GetDesignator()));

	AddAdorner(TH_new TSubscriberAdorner(kSubscriberAdornerID, aSubscriber, itsBorderRegion), kAdornAfter, fCalcDocument->IsBorderShown(aSubscriber));
}

//----------------------------------------------------------------------------------------
// TCellsView::ComputeBorderRgn: 
//----------------------------------------------------------------------------------------

void TCellsView::ComputeBorderRgn(RgnHandle itsBorderRegion,
								  const TGridViewDesignator* itsDesignation)

{
	CTempRegion_AC tempRgn;

	if (Focus())
		CellsToPixels(itsDesignation, tempRgn);

	RectRgn(itsBorderRegion, CRect_AC((*tempRgn)->rgnBBox) + CRect_AC(-5, -5, 4, 4));
	RectRgn(tempRgn, CRect_AC((*tempRgn)->rgnBBox) + CRect_AC(-2, -2, 1, 1));

	DiffRgn(itsBorderRegion, tempRgn, itsBorderRegion);
}

#endif

//----------------------------------------------------------------------------------------
// TCellsView::DoPostCreate: 
//----------------------------------------------------------------------------------------

void TCellsView::DoPostCreate(TDocument* itsDocument)
{
	fCalcDocument = dynamic_cast_AC(TCalcDocument*, itsDocument);
	fHelpID = kCellsViewHelp;
	fHelpIndex = 1;
}

//----------------------------------------------------------------------------------------
// TCellsView::DoMouseCommand: 
//----------------------------------------------------------------------------------------

void TCellsView::DoMouseCommand(CViewPoint& theMouse,
								TToolboxEvent* event,
								CPoint_AC hysteresis)
{
	#pragma unused (hysteresis)
	GridCell aCell(-1, -1);
	GridViewPart whichPart = IdentifyPoint(theMouse, aCell);	//since almost §

	if (event->IsOptionKeyPressed())
		PostCommand(TH_new TGrabberTracker(cNoCommand, fCalcDocument, this, GetScroller(false), theMouse));
	else
	{
		switch (whichPart)
		{
			case inCell:
				PostCommand(TH_new TCalcSelectCommand(fCalcDocument, this, theMouse, event->IsShiftKeyPressed(), event->IsCommandKeyPressed()));
				fCalcDocument->fSelectionType = kCellSelection;
				break;

			case inColumn:
			case inVertex:
				if (aCell.h > 1)
					PostCommand(TH_new TColumnSizer(fCalcDocument, aCell.h - 1, theMouse));
				break;
		}

		fCalcDocument->fColumnsView->SetEmptySelection(kHighlight);
		fCalcDocument->fRowsView->SetEmptySelection(kHighlight);
		fCalcDocument->fColumnIsSelected = false;
		fCalcDocument->fEditCell = NULL;
	}
}

//----------------------------------------------------------------------------------------
// TCellsView::DoSetupMenus: 
//----------------------------------------------------------------------------------------

void TCellsView::DoSetupMenus()
{
	TTextGridView::DoSetupMenus();

	// If user isn't editing, then assume edit commands refer to cells 
	if (!fCalcDocument->fEntryView->fTEditing)
	{
		SetEditCommandName(cCut, cCutCells);
		SetEditCommandName(cCopy, cCopyCells);
		SetEditCommandName(cClear, cClearCells);

		gClipboardMgr->CanPaste(kCalcScrapType);
	}

	TypeOfSelection selection = fCalcDocument->fSelectionType;
	Enable(cCut, selection != kNoSelection);
	Enable(cCopy, selection != kNoSelection);
	Enable(cClear, selection != kNoSelection);
	Enable(cSelectAll, true);
}

//----------------------------------------------------------------------------------------
// TCellsView::DoMenuCommand: 
//----------------------------------------------------------------------------------------

void TCellsView::DoMenuCommand(CommandNumber aCommandNumber)
{
	switch (aCommandNumber)
	{
		case cSelectAll:
			{
				GridRect aRect = fCalcDocument->fInUseBounds;
				++aRect[botRight];

				SetSelection(&TGridViewDesignator(aRect), kDontExtend, kHighlight, kSelect);

				fCalcDocument->fSelectionType = kAllSelection;
				fCalcDocument->fRowsView->SetEmptySelection(kHighlight);
				fCalcDocument->fColumnsView->SetEmptySelection(kHighlight);
				fCalcDocument->fColumnIsSelected = false;
				break;
			}

		case cCut:
		case cCopy:
		case cClear:
			// If user isn't editing this cell, he must want the cell itself. 
			{
				if (!fCalcDocument->fEntryView->fTEditing)
					PostCommand(TH_new TCellEditCommand(fCalcDocument, aCommandNumber));
				else
				{								// get ready for TextEdit operation 
					fCalcDocument->fEditCell = fCalcDocument->GetCell(fCalcDocument->fEditLocation);
					TTextGridView::DoMenuCommand(aCommandNumber);
				}
				break;
			}

		case cPaste:
			{
				if (gClipboardMgr->GetClipView()->ContainsClipType(kCalcScrapType))
					PostCommand(TH_new TCellPasteCommand(fCalcDocument));
				else
				{								// paste text into entry view 
					// was "WITH fCalcDocument"
					fCalcDocument->fEditCell = fCalcDocument->GetCell(fCalcDocument->fEditLocation);
					if (!fCalcDocument->fEntryView->fTEditing)
						fCalcDocument->fEntryView->SetEditMode();// prepare view for paste of text 

					TTextGridView::DoMenuCommand(aCommandNumber);
				}
				break;
			}

		default:
			TTextGridView::DoMenuCommand(aCommandNumber);
	}
}

//----------------------------------------------------------------------------------------
// TCellsView::DoKeyEvent: This view only handles arrow keys, tab, return and enter. It
// assumes the other keys are handled by the entry view object.
//----------------------------------------------------------------------------------------

void TCellsView::DoKeyEvent(TToolboxEvent* event)
{
	GridCoordinate c = fCalcDocument->fEditLocation.h;
	GridCoordinate r = fCalcDocument->fEditLocation.v;

	bool handled = true;

	if (event->GetText() == chEnter)
		fCalcDocument->MarkChanged();// enable Save - document may have changed Stay on same cell 
	else if (event->GetText() == chTab || event->GetText() == chRight)
		c = Min_AC(static_cast<GridCoordinate>(c + 1), fCalcDocument->fNoOfColumns);
	else if (event->GetText() == chLeft)
		c = Max_AC(static_cast<GridCoordinate>(c - 1), kMinCell);
	else if (event->GetText() == chUp)
		r = Max_AC(static_cast<GridCoordinate>(r - 1), kMinCell);
	else if (event->GetText() == chReturn || event->GetText() == chDown)
	{
		if (r)	// only do this if a cell is selected
			r = Min_AC(static_cast<GridCoordinate>(r + 1), fCalcDocument->fNoOfRows);
	}
	else
		handled = false;

	if (handled)
	{
		GridCell aCell(c, r);
	
		//  used to be one HUGE "with fCalcDocument" 
		//-- why is the view messing so much with the doc's internals?????
	
		fCalcDocument->fEntryView->EditMode(false);
		fCalcDocument->fColumnsView->SetEmptySelection(kHighlight);
		fCalcDocument->fRowsView->SetEmptySelection(kHighlight);
		fCalcDocument->fColumnIsSelected = false;
	
		SelectCell(aCell, kDontExtend, kHighlight, kSelect);
		if (fCalcDocument->fEntryView->fTouched)
			fCalcDocument->DoRecalculate(!kForceAutomatic, kUpdateDependencies);
		ScrollSelectionIntoView(true);
	
		// fix the columns view 
		CViewPoint minToSee(fCalcDocument->fColumnsView->GetColWidth(aCell.h), kCellHeight);
		aCell.v = 1;
	
		fCalcDocument->fColumnsView->RevealRect(fCalcDocument->fColumnsView->CellToVRect(aCell), minToSee, true);
	
		// fix the rows view 
		minToSee.h = kCellWidth;
		minToSee.v = kCellHeight;
		aCell.v = r;
		aCell.h = 1;
		fCalcDocument->fRowsView->RevealRect(fCalcDocument->fRowsView->CellToVRect(aCell), minToSee, true);
	
		// redraw anything that has changed, so the user can see what's being scrolled to
		Update();
	}
	else
	{
		TTextGridView::DoKeyEvent(event);
		fCalcDocument->fEditCell = fCalcDocument->GetCell(GridCell(c, r));
	}
}

//----------------------------------------------------------------------------------------
// TCellsView::AdornCol: 
//----------------------------------------------------------------------------------------

void TCellsView::AdornCol(GridCoordinate aCol, const CViewRect& area)
{
	#pragma unused (aCol)

	PenPat(&gColumnSeparatorPattern);
	PenSize(1, 1);

	CRect_AC qdArea(ViewToQD(area));
	--qdArea[botRight];

	MoveTo(qdArea.right, qdArea.top);
	LineToPt(qdArea[botRight]);
}

//----------------------------------------------------------------------------------------
// TCellsView::AdornRow: 
//----------------------------------------------------------------------------------------

void TCellsView::AdornRow(GridCoordinate aCol, const CViewRect& area)
{
	#pragma unused (aCol)

	PenPat(&gRowSeparatorPattern);
	PenSize(1, 1);

	CRect_AC qdArea(ViewToQD(area));
	--qdArea[botRight];

	MoveTo(qdArea.left, qdArea.bottom);
	LineToPt(qdArea[botRight]);
}

//----------------------------------------------------------------------------------------
// TCellsView::DesignatorAsTEXT: 
//----------------------------------------------------------------------------------------

Handle TCellsView::DesignatorAsTEXT(TDesignator* aDesignator)
{
	Handle textHandle = NewPermHandle(100);

	THandleStream aHandleStream(textHandle, 10);

	TGridViewDesignator* aRgn = dynamic_cast_or_throw_AC(TGridViewDesignator*,aDesignator);
	GridRect bounds(aRgn->GetBounds());
	--bounds[botRight];
	CCellIterator iter(this, bounds[topLeft], bounds[botRight], kIterateForward_AC, kIterateForward_AC, CCellIterator::kIterateRowMajor);
	for (GridCell aCell = iter.FirstCell(); iter.Current() != gZeroVPt; aCell = ++iter)
	{
		// write out the cell's contents if the cell is in the designation && it exists 
		if (aRgn->Contains(aCell) && fCalcDocument->CellExists(aCell))
		{
			CStr255_AC theString(fCalcDocument->GetCell(aCell)->GetValueAsString());
			aHandleStream.WriteBytes(&theString[1], theString.Length());// we can't use WriteString
			// because it writes the
			// length byte as well
		}

		// write out the delimitter - tab or cr 
		SignedByte aChar = aCell.h == bounds.right ? chReturn : chTab;
		aHandleStream.WriteBytes(&aChar, sizeof(SignedByte));
	}

	return textHandle;
}

//----------------------------------------------------------------------------------------
// TCellsView::DoIdle: 
//----------------------------------------------------------------------------------------

bool TCellsView::DoIdle(IdlePhase phase)
{
	if (phase == idleContinue)
	{
		KeyMap aKeyMap;

		GetKeys(aKeyMap);
		bool optionKeyDown = IsOptionKeyDown();
		if (fLastOptionKey != optionKeyDown)
		{
			fLastOptionKey = optionKeyDown;
			gApplication->InvalidateCursorRgn();	// Since we track the option key, we now need  
													// to recalculate cursor rgn and SET the
													// cursor at next opportunity
		}
	}
	return false;								// Didn't free myself 
}

//----------------------------------------------------------------------------------------
// TCellsView::DoSetCursor: 
//----------------------------------------------------------------------------------------

void TCellsView::DoSetCursor(const CViewPoint& localMouse,
							 RgnHandle cursorRegion) 
{
	KeyMap aKeyMap;
	GetKeys(aKeyMap);

	// We may have been called from a mouse-moved.  Be kind to the DoIdle 
	fLastOptionKey = IsOptionKeyDown();

	if (fLastOptionKey)
	{
		MacSetCursor(*MacGetCursor(kGrabberHand));
		CRegion_AC(cursorRegion).Set(GetQDExtent());
	}
	else
	{
		CViewRect cellsExtent;

		GridCell aCell(-1, -1);						// This value should never be used
		GridViewPart aGridViewPart = IdentifyPoint(localMouse, aCell);

		switch (aGridViewPart)					//since almost §
		{
			case badChoice:
#if qDebug
				gApplication->Beep(1);
#endif
				break;

			case inColumn:
			case inVertex:
				{
					if (aCell.h > 1)
					{
						MacSetCursor(*MacGetCursor(kColumnSizingCursor));
						ColToVRect(Min_AC(aCell.h, fNumOfCols), 1, cellsExtent);
						CRect_AC columnQDExtent(ViewToQD(cellsExtent));

						// Which edge is the mouse closer to? 
						if (labs(columnQDExtent.right - localMouse.h) < labs(columnQDExtent.left - localMouse.h))
							columnQDExtent.left = columnQDExtent.right;

						columnQDExtent.left = columnQDExtent.left - fColInset / 2;
						columnQDExtent.right = columnQDExtent.left + fColInset;
						RectRgn(cursorRegion, columnQDExtent);
					}
					break;
				}
			case inRow:
			case inCell:
				{
					MacSetCursor(*MacGetCursor(plusCursor));
					ColToVRect(Min_AC(aCell.h, fNumOfCols), 1, cellsExtent);
					cellsExtent.Inset(fColInset / 2, 0);// Account for the column resizer 
					::RectRgn(cursorRegion, ViewToQD(cellsExtent));
					break;
				}
		}
	}
}


//----------------------------------------------------------------------------------------
// TCellsView::GetText: 
//----------------------------------------------------------------------------------------

CStr255_AC TCellsView::GetText(const GridCell& aCell) const
{
	TCell * theCell = fCalcDocument->GetExistingCell(aCell);
	return (theCell && !theCell->IsDeleted()) ? theCell->GetValueAsString() : CStr255_AC(gEmptyString);
}

//----------------------------------------------------------------------------------------
// TCellsView::DrawCell: 
//----------------------------------------------------------------------------------------

void TCellsView::DrawCell(const GridCell& aCell, const CViewRect& aRect)
{
	TCell * theCell = fCalcDocument->GetExistingCell(aCell);
	if (theCell && !theCell->IsDeleted())
	{
		CStr255_AC		tString = theCell->GetValueAsString();
		SmartDrawString(tString, ViewToQD(aRect), fCalcDocument->GetColumn(aCell.h)->fFormat.fJustification);
	}
}

//----------------------------------------------------------------------------------------
// TCellsView::GetVisibleCells: 
//----------------------------------------------------------------------------------------

GridRect TCellsView::GetVisibleCells()
{
	Focus();
	CViewRect visibleVRect(GetVisibleRect());
	visibleVRect[topLeft] = GetScroller(true)->GetTranslation();

	return GridRect(VPointToCell(visibleVRect[topLeft]), VPointToCell(visibleVRect[botRight]));
}

//----------------------------------------------------------------------------------------
// TCellsView::GivePasteData: 
//----------------------------------------------------------------------------------------

long TCellsView::GivePasteData(Handle aDataHandle, ResType dataType)
{
	long aSize = 0;

#if qCarbon
	ScrapRef scrapRef;
	::GetCurrentScrap(&scrapRef);
#endif

	if (dataType == kCalcScrapType)
	{
		WriteCalcScrap(aDataHandle);
#if qCarbon
		GetScrapFlavorSize(scrapRef, kCalcScrapType, &aSize);
#else
		aSize = GetHandleSize(aDataHandle);
#endif
	}
	else if (dataType == kTextScrapType)
	{
		WriteTextScrap(aDataHandle);
#if qCarbon
		GetScrapFlavorSize(scrapRef, kTextScrapType, &aSize);
#else
		aSize = GetHandleSize(aDataHandle);
#endif
		
	}
	else
	
		aSize = TTextGridView::GivePasteData(aDataHandle, dataType);

	return aSize;
}

//----------------------------------------------------------------------------------------
// TCellsView::IsCellVisible: 
//----------------------------------------------------------------------------------------

bool TCellsView::IsCellVisible(const GridCell& aCell)
{
	return GetVisibleCells().Contains(aCell);		// ??? use fCalcDocument.CellInRange 
}

//----------------------------------------------------------------------------------------
// TCellsView::PositionAtCell: 
//----------------------------------------------------------------------------------------

void TCellsView::PositionAtCell(const GridCell& aCell)
{
	// position the cells view first 
	CViewRect aRect(CellToVRect(aCell));
	RevealRect(aRect, aRect.GetSize(), true);

	// fix up the columns view 
	fCalcDocument->fColumnsView->RevealRect(fCalcDocument->fColumnsView->CellToVRect(GridCell(aCell.h, 1)),
	CViewPoint(fCalcDocument->fColumnsView->GetColWidth(aCell.h), kCellHeight), true);

	// fix up the rows view 
	fCalcDocument->fRowsView->RevealRect(fCalcDocument->fRowsView->CellToVRect(GridCell(1, aCell.v)),
	CViewPoint(kCellWidth, kCellHeight), true);
}

//----------------------------------------------------------------------------------------
// TCellsView::ReSelect: 
//----------------------------------------------------------------------------------------

void TCellsView::ReSelect(const TGridViewDesignator* cellRegion)
{
	GridRect rgnBBox(cellRegion->GetBounds());

	GridCell aCell(rgnBBox[topLeft]);
	if (!IsCellVisible(aCell))
		PositionAtCell(aCell);			// position cellRegion at top left of grid 

	if (rgnBBox != GetSelections()->GetBounds())
	{
		fCalcDocument->fColumnsView->SetEmptySelection(kHighlight);
		fCalcDocument->fRowsView->SetEmptySelection(kHighlight);
		fCalcDocument->fColumnIsSelected = false;
		SetSelection(cellRegion, kDontExtend, kHighlight, kSelect);
	}
}

//----------------------------------------------------------------------------------------
// TCellsView::ReSelectCell: 
//----------------------------------------------------------------------------------------

void TCellsView::ReSelectCell(const GridCell& aCell)
{
	if (!IsCellVisible(aCell))
		PositionAtCell(aCell);			// position aCell at top left of grid 

	if (GridRect(aCell, aCell + GridCell(1, 1)) != GetSelections()->GetBounds())
	{
		fCalcDocument->fColumnsView->SetEmptySelection(kHighlight);
		fCalcDocument->fRowsView->SetEmptySelection(kHighlight);
		fCalcDocument->fColumnIsSelected = false;
		SelectCell(aCell, kDontExtend, kHighlight, kSelect);
	}
}

//----------------------------------------------------------------------------------------
// TCellsView::ScrollSelectionIntoView: 
//----------------------------------------------------------------------------------------

void TCellsView::ScrollSelectionIntoView(bool redraw)
{
	if (!GetSelections()->IsEmpty())
	{
		CViewRect topLeftRect(CellToVRect(GetSelections()->GetBounds()[topLeft]));
		RevealRect(topLeftRect, topLeftRect.GetSize(), redraw);
	}
}

//----------------------------------------------------------------------------------------
// TCellsView::SetCell: 
//----------------------------------------------------------------------------------------

void TCellsView::SetCell(const GridCell& aCell)
{
	fCalcDocument->fEditLocation = aCell;
	fCalcDocument->EditCell();					// cell formula = CPascalStr_AC in entry view 
	InvalidateCell(aCell);						// redraw the cell 
}

//----------------------------------------------------------------------------------------
// TCellsView::SetColWidth: 
//----------------------------------------------------------------------------------------

void TCellsView::SetColWidth(GridCoordinate aCol,
							 GridCoordinate numOfCols,
							 ViewCoordinate aWidth)
{
	TTextGridView::SetColWidth(aCol, numOfCols, aWidth);

	{
		// notify the cells that the width was changed 
		for (CExistingCalcCellIterator iter(fCalcDocument); iter.Current(); ++iter)
			if (iter->fLocation.h == aCol)
				iter->Changed(mWidthChanged, this);
	}

#if !qCarbon
	// recompute the border rgns 
	{
		for (CAdornerIterator iter(this); iter.Current(); ++iter)
		{
			TSectionAdorner* aSectionAdorner = dynamic_cast_AC(TSectionAdorner*, iter.Current());
#if 0
// ¥¥¥  need to come up with a way to construct a TGridViewDesignator from a region
			if (aSectionAdorner)
				ComputeBorderRgn(aSectionAdorner->fBorderRegion, dynamic_cast_or_throw_AC(TGridViewDesignator*,aSectionAdorner->fSection->fDesignator));
#endif
		}
	}
#endif
}

//----------------------------------------------------------------------------------------
// TCellsView::SetSelection: 
//----------------------------------------------------------------------------------------

void TCellsView::SetSelection(const TGridViewDesignator* cellsToSelect,
							  bool extendSelection,
							  bool highlight,
							  bool select)
{
	TTextGridView::SetSelection(cellsToSelect, extendSelection, highlight, select);

	if (fCalcDocument->fEntryView->fTouched)	// "commit" last cell 
	{
		fCalcDocument->EditCell();				/* change fEditCell's formula to the CPascalStr_AC
												  in fEntryView */
		fCalcDocument->fEntryView->SetToString(gEmptyString);
	}

	GridRect boundRect(cellsToSelect->GetBounds());
	if (!extendSelection && boundRect.GetSize() == CLongPoint_AC(1, 1))
	{
		GridCell cellTopLeft = cellsToSelect->GetBounds()[topLeft];

		fCalcDocument->fEditLocation = cellTopLeft;
		fCalcDocument->fEditCell = fCalcDocument->fCells.GetCell(fCalcDocument->fEditLocation);

		fCalcDocument->fCoordView->ForceRedraw();
		fCalcDocument->fEntryView->SetEnable(true);	// Allow editing.
	}
	else
		if (!extendSelection)
		{
			fCalcDocument->fEditLocation.Clear();
		
			if (boundRect.GetLength(hSel) == 1)
				fCalcDocument->fEditLocation.h = boundRect.left;

			if (boundRect.GetLength(vSel) == 1)	
				fCalcDocument->fEditLocation.v = boundRect.top;

			fCalcDocument->fEditCell = NULL;

			fCalcDocument->fCoordView->ForceRedraw();
			fCalcDocument->fEntryView->SetEnable(false);	// Don't allow editing of thin air.
		}

	fCalcDocument->SetEntry(fCalcDocument->fEditLocation);// set entry view contents to new cell 
}

//----------------------------------------------------------------------------------------
// TCellsView::DoBreakFollowing: 
//----------------------------------------------------------------------------------------
// Determines where page breaks occur for printing. 

ViewCoordinate TCellsView::DoBreakFollowing(VHSelect vhs,
										 ViewCoordinate previousBreak,
										 bool& Automatic) 
{
	#pragma unused (Automatic)
	ViewCoordinate thisBreak = 0;
	short rowsPerPage;
	short totalWidth;
	short width;
	short pageWidth;
	GridCoordinate firstCol;
	GridCoordinate c;

	CViewRect extentRect(GetExtent());
	switch (vhs)
	{
		case hSel:
			{
				rowsPerPage = static_cast<short>(GetPrintHandler()->GetViewPerPage().v / kCellHeight);
				thisBreak = previousBreak + (rowsPerPage * kCellHeight);
				break;
			}
		case vSel:
			{
				pageWidth = static_cast<short>(GetPrintHandler()->GetViewPerPage().h);
				totalWidth = 0;
				// This section used to be "firstCol = ColumnAtCoord(previousBreak);"
				if (previousBreak)
				{
					c = 0;
					width = 0;
					do
					{
						++c;
						width = width + GetColWidth(c);
					} while (width < previousBreak);
					firstCol = c + 1;
				}
				else
					firstCol = 1;

				for (c = firstCol; c <= fCalcDocument->fNoOfColumns; ++c)
				{
					width = GetColWidth(c);
					if (totalWidth + width <= pageWidth)
						totalWidth += width;
					else
					{
						thisBreak = previousBreak + totalWidth;
						break;
					}
				}
				
				// Did we set it?
				if (!thisBreak)
					thisBreak = previousBreak + totalWidth;
					
				if (thisBreak == previousBreak)	// Prevent ° loop resizing a far-right column (L.T.!)
					thisBreak = extentRect.right;
				break;
			}
	}
	thisBreak = Min_AC(thisBreak, extentRect[botRight][gOrthogonal[vhs]]);

#if qDebug
	if ((thisBreak <= previousBreak) || gDebugPrinting)
	{
		ProgramBreak_AC("TCellsView.DoBreakFollowing: previousBreak=");
		if (vhs == vSel)
			ProgramBreak_AC("[v]%d  thisBreak=[v]%d\n", previousBreak, thisBreak);
		else
			ProgramBreak_AC("[h]%d  thisBreak=[h]%d\n", previousBreak, thisBreak);

		if (thisBreak <= previousBreak)
			ProgramBreak_AC("thisBreak <= previousBreak");
	}
#endif

	return thisBreak;
}


//----------------------------------------------------------------------------------------
// TCellsView::DoDrawPageBreak: 
//----------------------------------------------------------------------------------------

#if qDebug

void TCellsView::DoDrawPageBreak(VHSelect vhs,
								 short whichBreak,
								 ViewCoordinate loc,
								 bool Automatic)
{
	#pragma unused (whichBreak, Automatic)

	CViewPoint vPt;
	CPoint_AC qdStartPt;
	CPoint_AC qdEndPt;

	if (gDebugPrinting)
	{
		vPt[gOrthogonal[vhs]] = loc;
		vPt[vhs] = 0;
		qdStartPt = ViewToQD(vPt);
		vPt[vhs] = fSize[vhs] - ((CPoint_AC &)gBreaksPenState.pnSize)[vhs];
		qdEndPt = ViewToQD(vPt);

		MoveToPt(qdStartPt);
		LineToPt(qdEndPt);
	}
}

#endif

//----------------------------------------------------------------------------------------
// TCellsView::GetPrintExtent:  Overridden to provide for Print Selection command. 
//----------------------------------------------------------------------------------------

CViewRect TCellsView::GetPrintExtent() 
{
	GridCell tlCell;
	GridCell brCell;

	if (dynamic_cast_AC(TCalcPrintHandler*,GetPrintHandler())->fCmdNumber == cPrintSelection)
	{
		tlCell = GetSelections()->GetBounds()[topLeft];
		brCell = GetSelections()->GetBounds()[botRight];
		brCell.h = Min_AC(static_cast<GridCoordinate>(brCell.h - 1), fCalcDocument->fInUseBounds.right);
		brCell.v = Min_AC(static_cast<GridCoordinate>(brCell.v - 1), fCalcDocument->fInUseBounds.bottom);
	}
	else
	{
		tlCell = fCalcDocument->fInUseBounds[topLeft];
		brCell = fCalcDocument->fInUseBounds[botRight];
	}

	CViewRect printExtent;
	printExtent[topLeft] = CellToVRect(tlCell)[topLeft];
	printExtent[botRight] = CellToVRect(brCell)[botRight];

#if qDebug
	if (gDebugPrinting)
	{
		ProgramBreak_AC("printExtent %s\n", printExtent.AsText());
	}
#endif

	return printExtent;
}

#if !qCarbon

//----------------------------------------------------------------------------------------
// TCellsView::UserSelectionChanged: 
//----------------------------------------------------------------------------------------

void TCellsView::UserSelectionChanged(TView* changedView)
{
	if (!fCalcDocument->GetShowSectionBorders()) // invalidate all adorners
		for (CAdornerIterator iter(this); iter.Current(); ++iter)
			if (((*iter).GetIdentifier() == kPublisherAdornerID) || ((*iter).GetIdentifier() == kSubscriberAdornerID))
				(*iter).InvalidateAdorner(this);

	TTextGridView::UserSelectionChanged(changedView);
}

#endif

//----------------------------------------------------------------------------------------
// TCellsView::UpdateFromDocument - update this gridview's number of rows, columns, etc
//									from the document. Called when making a clipboard view.
//----------------------------------------------------------------------------------------

void TCellsView::UpdateFromDocument()
{
	fNumOfCols = fCalcDocument->fInUseBounds.right - fCalcDocument->fInUseBounds.left + 1;
	fNumOfRows = fCalcDocument->fInUseBounds.bottom - fCalcDocument->fInUseBounds.top + 1;

	// Set column widths and row heights to default values
	SetColWidth(1, fNumOfCols, kCellWidth);
	SetRowHeight(1, fNumOfRows, kCellHeight);
}

//----------------------------------------------------------------------------------------
// TCellsView::ContainsClipType: 
//----------------------------------------------------------------------------------------

bool TCellsView::ContainsClipType(ResType aType)
{
	return ((aType == kCalcScrapType) || (aType == kTextScrapType));
}

//----------------------------------------------------------------------------------------
// TCellsView::WriteCalcScrap: 
//----------------------------------------------------------------------------------------

void TCellsView::WriteCalcScrap(Handle calcScrap)
{
	SetHandleSize(calcScrap, 0);
	long scrapOffset = 0;

	ScrapInfoRecord scrapInfo;
	scrapInfo.selection.top = 1;
	scrapInfo.selection.left = 1;
	scrapInfo.selection.bottom = fCalcDocument->fNoOfRows;
	scrapInfo.selection.right = fCalcDocument->fNoOfColumns;
	scrapInfo.noOfCells = fCalcDocument->fAllocatedCells;
	WriteScrap(calcScrap, scrapOffset, reinterpret_cast<unsigned char*>(&scrapInfo), sizeof(scrapInfo));

	short cellsWritten = 0;

	short i;
	for (i = 1; i <= fCalcDocument->fNoOfRows; ++i)
		fCalcDocument->GetRow(i)->WriteToScrap(calcScrap, scrapOffset);

	for (i = 1; i <= fCalcDocument->fNoOfColumns; ++i)
		fCalcDocument->GetColumn(i)->WriteToScrap(calcScrap, scrapOffset);

	for (CExistingCalcCellIterator iter(fCalcDocument); iter.Current(); ++iter)
	{
		iter->WriteToScrap(calcScrap, scrapOffset);
		++cellsWritten;
	}

#if qDebug
	if (cellsWritten != scrapInfo.noOfCells)
	{
		ProgramReport_AC("WriteCalcScrap: Incorrect number of cells written.");
		ProgramReport_AC("     Should be %d , was %d\n", scrapInfo.noOfCells, cellsWritten);
		ProgramBreak_AC("");
	}
#endif
}

//----------------------------------------------------------------------------------------
// TCellsView::WriteTextScrap: 
//----------------------------------------------------------------------------------------

void TCellsView::WriteTextScrap(Handle textScrap)
{
	GrafPtr savedPort;
	GetPort(&savedPort);					// Use work port because GetValueAsString 
#if qCarbon
	MacSetPort((OpaqueGrafPtr*)gWorkPort);		// Ésets the current port's font 
#else
	MacSetPort(gWorkPort);						// Ésets the current port's font 
	SetHandleSize(textScrap, 0);
#endif

	long scrapOffset = 0;

	CStr255_AC theText;
	for (GridCoordinate r = 1; r <= fCalcDocument->fNoOfRows; ++r)
	{
		for (GridCoordinate c = 1; c <= fCalcDocument->fNoOfColumns; ++c)
		{
			if (fCalcDocument->CellExists(GridCell(c, r)))
				theText = fCalcDocument->GetCell(GridCell(c, r))->GetValueAsString();
			else
				theText.Empty();
			if (c > 1)
				theText = chTab + theText;
			WriteScrap(textScrap, scrapOffset, &(theText[1]), theText.Length());
			//WriteString(theText);
		}
		theText = chReturn;
		WriteScrap(textScrap, scrapOffset, &(theText[1]), theText.Length());
		//WriteString(theText);
	}

	MacSetPort(savedPort);
}

//----------------------------------------------------------------------------------------
// TCellsView::WriteToDeskScrap: 
//----------------------------------------------------------------------------------------

void TCellsView::WriteToDeskScrap()
{
	TView::WriteToDeskScrap();
	
	{
		CTempHandle_AC textScrap = NewPermHandle(0);
		
		WriteTextScrap(textScrap);
		
		gClipboardMgr->PutDeskScrapData(kTextScrapType, textScrap);
	}

	{
		CTempHandle_AC calcScrap = NewPermHandle(0);

		WriteCalcScrap(calcScrap);
		
		gClipboardMgr->PutDeskScrapData(kCalcScrapType, calcScrap);
	}
}

//========================================================================================
// CLASS TCalcPrintHandler
//========================================================================================

MA_DEFINE_CLASS(TCalcPrintHandler);

//----------------------------------------------------------------------------------------
// TCalcPrintHandler destructor
//----------------------------------------------------------------------------------------

TCalcPrintHandler::~TCalcPrintHandler()
{
}

//----------------------------------------------------------------------------------------
// TCalcPrintHandler::CalcViewPerPage: 
//----------------------------------------------------------------------------------------

CViewPoint TCalcPrintHandler::CalcViewPerPage() const
{
	CViewPoint amtPerPage(TStdPrintHandler::CalcViewPerPage());
	
	long noOfRows = amtPerPage.v / kCellHeight;
	amtPerPage.v = noOfRows * kCellHeight;
	
	return amtPerPage;
}

//----------------------------------------------------------------------------------------
// TCalcPrintHandler::DoMenuCommand: 
//----------------------------------------------------------------------------------------

void TCalcPrintHandler::DoMenuCommand(CommandNumber aCommandNumber)
{
	fCmdNumber = aCommandNumber;				// Save command number for GetPrintExtent 
	if (aCommandNumber == cPrintSelection)
		aCommandNumber = cPrint;				// proceed like regular Print 

	TStdPrintHandler::DoMenuCommand(aCommandNumber);
}

//----------------------------------------------------------------------------------------
// TCalcPrintHandler::DoSetupMenus: 
//----------------------------------------------------------------------------------------

void TCalcPrintHandler::DoSetupMenus()
{
	TStdPrintHandler::DoSetupMenus();

	Enable(cPrintSelection, gCouldPrint && fView);
}

//========================================================================================
// CLASS TEntryView
//========================================================================================

MA_DEFINE_CLASS(TEntryView);

//----------------------------------------------------------------------------------------
// TEntryView destructor
//----------------------------------------------------------------------------------------

TEntryView::~TEntryView()
{
}

//----------------------------------------------------------------------------------------
// TEntryView::DoPostCreate: 
//----------------------------------------------------------------------------------------

void TEntryView::DoPostCreate(TDocument* itsDocument)
{
	fDocument = itsDocument;
	fCalcDocument = dynamic_cast_AC(TCalcDocument*,itsDocument);
	fTouched = false;
	fTEditing = false;
	fFirstEdit = false;

	fControlChars = macroAsSetElem(chBackspace);	// The others are handled by the cells view
}

//----------------------------------------------------------------------------------------
// TEntryView::DoKeyEvent: 
//----------------------------------------------------------------------------------------

void TEntryView::DoKeyEvent(TToolboxEvent* event)
{
	// If this is the first character, wipe out old value and activate caret. 
	if (!fTEditing && (event->GetText() >= chSpace || event->GetText() == chBackspace))
		SetEditMode();

	TTEView::DoKeyEvent(event);
}

//----------------------------------------------------------------------------------------
// TEntryView::DoMakeTypingCommand: 
//----------------------------------------------------------------------------------------

TTETypingCommand* TEntryView::DoMakeTypingCommand(const CStr2_AC& ch) 
{
	return TH_new TCalcTypingCommand(this, ch);
}

//----------------------------------------------------------------------------------------
// TEntryView::DoMouseCommand: 
//----------------------------------------------------------------------------------------

void TEntryView::DoMouseCommand(CViewPoint& theMouse,
								TToolboxEvent* event,
								CPoint_AC hysteresis) 
{
	// If no characters typed, active caret, then handle mouse down. 
	if (!fTouched)
	{
		SetActive(true);
		fTouched = true;
	}
	EditMode(true);
	TTEView::DoMouseCommand(theMouse, event, hysteresis);
}

//----------------------------------------------------------------------------------------
// TEntryView::DoMenuCommand: 
//----------------------------------------------------------------------------------------

void TEntryView::DoMenuCommand(CommandNumber aCommandNumber)
{
	if (fTEditing)
	{
		// TTEView.DoMenuCommand will process the Cut/ Paste/ Clear for us, but we only want
        // it to if we're editing in the first place. Otherwise, we can't call inherited,
        // because then CPC commands we recieve should go to the CellsView, so therefore
        // we just tell the next handler to do its thing, thus continuing the chain (see
        // TEventHandler::DoMenuCommand)

		TTEView::DoMenuCommand(aCommandNumber);
	}
	else
	{
		TEventHandler* nextHandler = GetNextHandler();
		if (nextHandler)
			nextHandler->HandleMenuCommand(aCommandNumber);
	}
}

//----------------------------------------------------------------------------------------
// TEntryView::DoSetupMenus: 
//----------------------------------------------------------------------------------------

void TEntryView::DoSetupMenus()
{
	if (fTEditing)
	{
		// TTEView.DoSetupMenus will setup the Edit menu commands for us if we're editing.
        // But if we're not, we can't call inherited, because then they'll still get set
        // up. To give somebody else the chance to setup, we'll just move onto the next
        // handler (see TEventHandler::DoSetupMenus )
		TTEView::DoSetupMenus();

		SetEditCommandName(cCut, cCutText);
		SetEditCommandName(cCopy, cCopyText);
		SetEditCommandName(cClear, cClearText);
	}
	else
	{
		TEventHandler* nextHandler = GetNextHandler();
		if (nextHandler)
			nextHandler->HandleSetupMenus();
	}
}

//----------------------------------------------------------------------------------------
// TEntryView::Draw: 
//----------------------------------------------------------------------------------------

void TEntryView::Draw(const CViewRect& area) 
{
	// We want a rectangle around the whole view
	PenSize(1, 1);
	PenPat(CPattern_AC::Black());
	
	CTempRegion_AC extentRegion;
	GetExtentRegion(extentRegion);
	MacFrameRgn(extentRegion);

	TTEView::Draw(area);
}

//----------------------------------------------------------------------------------------
// TEntryView::WantsToBeTarget: 
//----------------------------------------------------------------------------------------

bool TEntryView::WantsToBeTarget() 
{
	// Return false for now, because Calc currently relies on the cells view being the target
	return false;
} 

//----------------------------------------------------------------------------------------
// TEntryView::EditMode: 
//----------------------------------------------------------------------------------------

void TEntryView::EditMode(bool editing)
{
	fTEditing = editing;
	fFirstEdit = false;							// set to true only by DoKeyEvent 
}

//----------------------------------------------------------------------------------------
// TEntryView::GetAsString: 
//----------------------------------------------------------------------------------------

CStr255_AC TEntryView::GetAsString()
{
	CharsHandle theText = (CharsHandle)ExtractText();
	short numberOfChars = Min_AC(kStr255Len, GetHandleSize(Handle(theText)));

	return CStr255_AC(static_cast<void*>(*theText), Min_AC(255, numberOfChars));
}

//----------------------------------------------------------------------------------------
// TEntryView::SetActive: 
//----------------------------------------------------------------------------------------

void TEntryView::SetActive(bool state)
{
	TTEView::SetActive(state);

	if (Focus())
	{
		CRect_AC r(GetQDExtent());
		r.Inset(2, 2);

		Invalidate(r);
	}
}

//----------------------------------------------------------------------------------------
// TEntryView::SetEditMode: 
//----------------------------------------------------------------------------------------

void TEntryView::SetEditMode()
{
	EditMode(true);						// sets fFirstEdit to false 
	fFirstEdit = true;					// the only place it is set to true 
	SetSelect(0, fMaxChars, fHTE);		// select entire string so that it gets replaced
	SetActive(true);
	fTouched = true;
}

//----------------------------------------------------------------------------------------
// TEntryView::SetToString: 
//----------------------------------------------------------------------------------------

void TEntryView::SetToString(const CStr255_AC& theString)
{
//	CStr255_AC tempString(theString);

	Focus();
	SetJustification(teFlushDefault, kDontRedraw);	// initialize text to system-justified 
	SetActive(false);
	fTouched = false;
	TESetText(&theString[1], theString[0], fHTE);
	// first cast away the const so that the [] operator returns a reference to
	// the actual location in the array (otherwise returns the character itself
	// on the stack) since we're interested in an address, not what it contains,
	// then actually do the [] operator to get the start of the CPascalStr_AC to stuff.
	SetSelection(0, 32767, !kRedraw);				// hilight the entire CPascalStr_AC.
}

//========================================================================================
// CLASS TCoordView
//========================================================================================

MA_DEFINE_CLASS(TCoordView);

//----------------------------------------------------------------------------------------
// TCoordView destructor
//----------------------------------------------------------------------------------------

TCoordView::~TCoordView()
{
}

//----------------------------------------------------------------------------------------
// TCoordView::DoPostCreate: 
//----------------------------------------------------------------------------------------

void TCoordView::DoPostCreate(TDocument* itsDocument)
{
	fCalcDocument = dynamic_cast_AC(TCalcDocument*,itsDocument);
}

//----------------------------------------------------------------------------------------
// TCoordView::Draw: 
//----------------------------------------------------------------------------------------

void TCoordView::Draw(const CViewRect& area)
{
	CStr255_AC aString(" ");
	CStr255_AC anotherString(" ");

	if (fCalcDocument->fEditLocation.h > 0)
		fCalcDocument->fColumnsView->CoordToString(fCalcDocument->fEditLocation.h, aString);

	if (fCalcDocument->fEditLocation.v > 0)
		NumToString(fCalcDocument->fEditLocation.v, anotherString);

	aString += anotherString;
	SetTheFont(kEntryFont, kEntryFontSize, bold);

	CRect_AC aRect(2, 0, 46, kEntryHeight);
	SmartDrawString(aString, aRect, teFlushDefault);

	TView::Draw(area);
}

//========================================================================================
// CLASS TCalcSelectCommand
//========================================================================================

//----------------------------------------------------------------------------------------
// TCalcSelectCommand::ICalcSelectCommand: 
//----------------------------------------------------------------------------------------

TCalcSelectCommand::TCalcSelectCommand(TCalcDocument* itsDocument,
											TGridView* itsView,
											const CViewPoint& theMouse,
											bool theShiftKey,
											bool theCommandKey) :
	TCellSelectCommand(itsView, theMouse, theShiftKey, theCommandKey),

	fCalcDocument(itsDocument)
{
	if (fCalcDocument)
		fCalcDocument->fEntryView->EditMode(false);
}

//----------------------------------------------------------------------------------------
// TCalcSelectCommand destructor
//----------------------------------------------------------------------------------------

TCalcSelectCommand::~TCalcSelectCommand()
{
}

//----------------------------------------------------------------------------------------
// TCalcSelectCommand::ComputeNewSelection: 
//----------------------------------------------------------------------------------------

void TCalcSelectCommand::ComputeNewSelection(const GridCell& clickedCell) 
{
	if (fGridView->CanSelectCell(clickedCell))
	{
		GridRect r(fAnchorCell, clickedCell);
		r.Validate();
		++r[botRight];
		fThisSelection->Set(r);

#if !qCarbon
		// add in the designated region for subscribers 
		for (CSectionIterator iter(fCalcDocument); iter.Current(); ++iter)	// for each section do
			if (!(*iter).IsCanceled() && (*iter).GetSectionType() == stSubscriber)
			{
				TGridViewDesignator tempRegion(*fThisSelection);
				tempRegion.Intersect(dynamic_cast_or_throw_AC(TGridViewDesignator*, ((*iter).GetDesignator())));
				if (!tempRegion.IsEmpty())// if this section is in selection 
					fThisSelection->Append(dynamic_cast_or_throw_AC(TGridViewDesignator*,((*iter).GetDesignator())));
			}
#endif

		//
		// Combine the selection if necessary
		//
		if (fCommandKey && (!fGridView->GetSingleSelection()))
			if (fDeselecting)
			{
				TGridViewDesignator saveThisSelection(*fThisSelection);
				fThisSelection->Set(&fPreviousSelection);
				fThisSelection->Remove(&saveThisSelection);
			}
			else
				fThisSelection->Append(&fPreviousSelection);
	}
}

//========================================================================================
// CLASS TRowSelector
//========================================================================================

//----------------------------------------------------------------------------------------
// TRowSelector::TRowSelector: 
//----------------------------------------------------------------------------------------

TRowSelector::TRowSelector(TCalcDocument* itsDocument,
									   TGridView* itsView,
									   const CViewPoint& theMouse,
									   bool theShiftKey,
									   bool theCommandKey) :
	TCalcSelectCommand(itsDocument, itsView, theMouse, theShiftKey, itsDocument->fSelectionType == kRowSelection ? theCommandKey : false),

	fCellSelector(itsDocument, itsDocument->fCellsView, theMouse, theShiftKey, fCommandKey)
{
}

//----------------------------------------------------------------------------------------
// TRowSelector::Free: 
//----------------------------------------------------------------------------------------

TRowSelector::~TRowSelector()
{
}

//----------------------------------------------------------------------------------------
// TRowSelector::ComputeAnchorCell: 
//----------------------------------------------------------------------------------------

void TRowSelector::ComputeAnchorCell(const GridCell& clickedCell)
{
	TCalcSelectCommand::ComputeAnchorCell(clickedCell);

	fAnchorCell.h = 1;
	
	GridCell newClickedCell(clickedCell);
	newClickedCell.h = 1;
	fCellSelector.ComputeAnchorCell(newClickedCell);
}

//----------------------------------------------------------------------------------------
// TRowSelector::ComputeNewSelection: 
//----------------------------------------------------------------------------------------

void TRowSelector::ComputeNewSelection(const GridCell& clickedCell)
{
	GridCell newClickedCell(clickedCell);
	newClickedCell.h = 1;

	newClickedCell.h = fGridView->GetNumOfCols();
	TCalcSelectCommand::ComputeNewSelection(newClickedCell);

	newClickedCell.h = fCalcDocument->fNoOfColumns;
	fCellSelector.ComputeNewSelection(newClickedCell);
}

//----------------------------------------------------------------------------------------
// TRowSelector::DoIt: 
//----------------------------------------------------------------------------------------

void TRowSelector::DoIt() 
{
	TCalcSelectCommand::DoIt();

	fCellSelector.DoIt();
}

//----------------------------------------------------------------------------------------
// TRowSelector::TrackMouse: 
//----------------------------------------------------------------------------------------

TTracker* TRowSelector::TrackMouse(	TrackPhase		aTrackPhase,
									CViewPoint& 	anchorPoint,
									CViewPoint& 	previousPoint,
									CViewPoint&		nextPoint,
									bool			mouseDidMove) 
{
	#pragma unused (anchorPoint, previousPoint)

	GridCell clickedCell;

	if (mouseDidMove)
	{
		clickedCell = fGridView->VPointToCell(nextPoint);
		if (aTrackPhase == trackBegin)
		{
			ComputeAnchorCell(clickedCell);
			if (fCommandKey)
			{
				fDeselecting = fGridView->GetSelections()->Contains(fAnchorCell);
				fCellSelector.fDeselecting = fDeselecting;
			}
		}

		if (clickedCell != fPreviousCell)
		{
			ComputeNewSelection(clickedCell);
			HighlightNewSelection();
			fCellSelector.HighlightNewSelection();

			fPreviousSelection.Set(fThisSelection);
			fPreviousCell = clickedCell;
			fCellSelector.fPreviousSelection.Set(fCellSelector.fThisSelection);
			fCellSelector.fPreviousCell = clickedCell;
		}
	}

	return this;
} 

//========================================================================================
// CLASS TColumnSelector
//========================================================================================

//----------------------------------------------------------------------------------------
// TColumnSelector::TColumnSelector: 
//----------------------------------------------------------------------------------------

TColumnSelector::TColumnSelector(TCalcDocument*	itsDocument,
											 TGridView* itsView,
											 const CViewPoint& theMouse,
											 bool theShiftKey,
											 bool theCommandKey) :
	TCalcSelectCommand(itsDocument, itsView, theMouse, theShiftKey, itsDocument->fSelectionType == kColumnSelection ? theCommandKey : false),

	fCellSelector(itsDocument, itsDocument->fCellsView, theMouse, theShiftKey, fCommandKey)
{
}

//----------------------------------------------------------------------------------------
// TColumnSelector::Free: 
//----------------------------------------------------------------------------------------

TColumnSelector::~TColumnSelector()	
{
}

//----------------------------------------------------------------------------------------
// TColumnSelector::ComputeAnchorCell: 
//----------------------------------------------------------------------------------------

void TColumnSelector::ComputeAnchorCell(const GridCell& clickedCell)
{
	TCalcSelectCommand::ComputeAnchorCell(clickedCell);
	fAnchorCell.v = 1;

	GridCell newClickedCell(clickedCell);
	newClickedCell.v = 1;
	fCellSelector.ComputeAnchorCell(newClickedCell);
}

//----------------------------------------------------------------------------------------
// TColumnSelector::ComputeNewSelection: 
//----------------------------------------------------------------------------------------

void TColumnSelector::ComputeNewSelection(const GridCell& clickedCell)
{
	GridCell newClickedCell(clickedCell);
	newClickedCell.v = fGridView->GetNumOfRows();
	TCalcSelectCommand::ComputeNewSelection(newClickedCell);

	newClickedCell.v = fCalcDocument->fCellsView->GetNumOfRows();
	fCellSelector.ComputeNewSelection(newClickedCell);
}

//----------------------------------------------------------------------------------------
// TColumnSelector::DoIt: 
//----------------------------------------------------------------------------------------

void TColumnSelector::DoIt()
{
	TCalcSelectCommand::DoIt();

	fCellSelector.DoIt();
}

//----------------------------------------------------------------------------------------
// TColumnSelector::TrackMouse: 
//----------------------------------------------------------------------------------------

TTracker* TColumnSelector::TrackMouse(	TrackPhase	aTrackPhase,
										CViewPoint&	anchorPoint,
										CViewPoint&	previousPoint,
										CViewPoint&	nextPoint,
										bool		mouseDidMove)
{
	#pragma unused (anchorPoint, previousPoint)
	GridCell clickedCell;

	if (mouseDidMove)
	{
		clickedCell = fGridView->VPointToCell(nextPoint);
		if (aTrackPhase == trackBegin)
		{
			ComputeAnchorCell(clickedCell);
			if (fCommandKey)
			{
				fDeselecting = fGridView->GetSelections()->Contains(fAnchorCell);
				fCellSelector.fDeselecting = fDeselecting;
			}
		}

		if (clickedCell != fPreviousCell)
		{
			ComputeNewSelection(clickedCell);
			HighlightNewSelection();
			fCellSelector.HighlightNewSelection();

			fPreviousSelection.Set(fThisSelection);
			fPreviousCell = clickedCell;
			fCellSelector.fPreviousSelection.Set(fCellSelector.fThisSelection);
			fCellSelector.fPreviousCell = clickedCell;
		}
	}
	return this;
}

//========================================================================================
// CLASS TCalcTypingCommand
//========================================================================================

//----------------------------------------------------------------------------------------
// TCalcTypingCommand::TCalcTypingCommand: 
//----------------------------------------------------------------------------------------

TCalcTypingCommand::TCalcTypingCommand(TEntryView* inEntryView,
									   const CStr2_AC& inFirstChar)
	:	TTETypingCommand(inEntryView, inFirstChar),
		fEntryView(inEntryView),
		fCellsView(inEntryView ? inEntryView->fCalcDocument->fCellsView : NULL),
		fTargetCell(fCellsView ? fCellsView->FirstSelectedCell() : GridCell(gZeroPt))
{
}

//----------------------------------------------------------------------------------------
// TCalcTypingCommand destructor
//----------------------------------------------------------------------------------------

TCalcTypingCommand::~TCalcTypingCommand()
{
}

//----------------------------------------------------------------------------------------
// TCalcTypingCommand::AddCharacter: Switch the entry view from left to right
// justification when the typed characters overflow the entry box, and switch back to left
// justification if the text shrinks enough
//----------------------------------------------------------------------------------------

void TCalcTypingCommand::AddCharacter(const CStr2_AC& ch) 
{
	if (ch != chBackspace && fEntryView->fJustification == teFlushDefault)
	{
		short selRight = (*fHTE)->selRect.right;
		if (selRight < 0 || selRight > (*fHTE)->destRect.right)
			selRight = (*fHTE)->selPoint.h;
		if ((selRight + StringWidth(ch) > (*fHTE)->destRect.right))
			fEntryView->SetJustification(teFlushRight, kDontRedraw);
	}

	TTETypingCommand::AddCharacter(ch);

	if (ch == chBackspace && fEntryView->fJustification == teFlushRight)
	{
		CStr255_AC aString;

		GetDialogItemText((*fHTE)->hText, aString);
		if (StringWidth(aString) < LengthRect((*fHTE)->destRect, hSel))
			fEntryView->SetJustification(teFlushDefault, kRedraw);
	}
}

//----------------------------------------------------------------------------------------
// TCalcTypingCommand::UndoIt: If the selection has changed since this command was
// created, restore it to the target cell before Undoing.
//----------------------------------------------------------------------------------------

void TCalcTypingCommand::UndoIt()
{
	fCellsView->ReSelectCell(fTargetCell);		// make sure fTargetCell is selected 

	TTETypingCommand::UndoIt();

	if (!(fEntryView->fTEditing && !fEntryView->fFirstEdit))
		fCellsView->SetCell(fTargetCell);		// change fTargetCell's contents and redraw it
}

//----------------------------------------------------------------------------------------
// TCalcTypingCommand::RedoIt: If the selection has changed since this command was
// created, restore it to the target cell before Redoing.
//----------------------------------------------------------------------------------------

void TCalcTypingCommand::RedoIt()
{
	fCellsView->ReSelectCell(fTargetCell);		// make sure fTargetCell is selected 

	TTETypingCommand::RedoIt();

	if (!(fEntryView->fTEditing && !fEntryView->fFirstEdit))
		fCellsView->SetCell(fTargetCell);		// change fTargetCell's contents and redraw it
}

//----------------------------------------------------------------------------------------
// End of UCalc.cpp

/*
	Historical Change Record:
		----- R11 -----
		06/27/96	Make conditional tests implicit as in if(x) instead of if(x != 0).
		06/26/96	Install release marker.  Scope many globals.  Change TRUE/FALSE/NULL.
		06/26/96	==/!=NULL to implicit tests, except in the case of assignment to or passing/returning as bool/bool.
		 6/25/96	[1336165] (Views, GridViews) TTextGridView::DoFulfillPromise.
		06/19/96	SCpp and MrCpp can't handle declarations in the expression portion of while loops
							so we just changed them all to for loops
		06/09/96	Removed UStreamable to a separate file from UObject
		05/09/96	Adjust the Failure Handling macros to allow for easy switching to native exceptions.
		05/02/95	Call FreeIfObject, don't call Free directly since it will eventually be removed.
		04/30/96	Make all constructors use initialization lists if they weren't already
							doing do. Switch several more empty constructors to inlines.
		 4/26/96	Made C/CViewPoint/Rect default constructors set the point/rect to a cleared value. Made
		 					clearing very fast/compact. Eliminated the now unnecessary hand clearing of C/CViewPoint/Rects.
		04/25/96	More use of CTempxxx classes instead of Failure handling where poss.
		04/24/96	Use PRE-Increment/Decrement operators whenever possible for eff.
		04/23/96	Update iterators to be OD stylish.
							Pass GridCells as parameters rather than separate coordinates
		04/18/96	More Use post-increment with iterators in while loops
		04/18/96	Use post-increment with iterators in while loops
		04/16/96	Use "while" style iteration
		----- R10 -----
		03/29/96	GetPrintExtent returns a CViewRect
		03/27/96	Replace several BlockMoves_AC with string operations
		03/26/96	Cleanup references to gEmptyString and ""
		03/26/96	CStr255_AC to char* conversion now requires const
		 3/25/96	Fix a little faux-pas. 
		 3/25/96	CopyPat not needed anymore. 
		 3/23/96	TCalcTypingCommand::AddCharacter takes a CStr2_AC now.
		 3/21/96	The "SquareDots" parameter of IStdPrintHandler is obsolete
		 3/18/96	Made better use of TView calls that return CRect_AC/CViewPoint/CViewRect
		12/21/95	Don't disable undo/redo in EditMode. This needs more work. 
		12/21/95	Remove SetupUndoMenu. 
		----- 3.3 -----
		10/19/95	Use MoveToPt, LineToPt.
		----- 3.3b1 -----
		 8/ 9/95	mrw		Cosmetic.
		07/30/95	Made fViewPerPage, fDeviceRes protected and added accessors.
		 6/28/95	Window size limits now are dynamic.
		 6/28/95    GJC     Changed if test in TCalcDocument:SetEntry to include a test for
		 					fDeleted. Prevents ghost value from setting up. Fixes 1239698.
		  4/9/95	Put them in GNonRes2. 
		  4/8/95	Move several TCellsViews method from ANonRes to ARes segment.
		  4/7/95	ARM 8.4.3 x& cannot be initialized with volatile x. 
		  4/5/95	Register TGridViewDesignator.
		 3/17/95	MAVolatile. 
		 3/13/95	Change Free methods to destructors. 
		  3/6/95	Call IRow and IColumn when reading from scrap. 
		02/22/95	1222899 Use CopyPat when appropriate
		02/22/95	1222850 MacApp should use BlockMove_AC and BlockMoveOverlap_AC everywhere
		 11/1/94	Specify volatile variables in TCalcDocument::DoRead. 
							(Fixes 1184647). 
*/