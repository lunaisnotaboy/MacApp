//----------------------------------------------------------------------------------------
// UFracDoc.cpp
// Copyright © 1997-2001 by Apple Computer, Inc.  All rights reserved.
//----------------------------------------------------------------------------------------

/*
	Change History
		08/14/01	Include string.h to get memcpy. 
		07/23/01	Removing old features. 
		06/22/01	Remove unused fThreadStyle. 
					Added zoom to selection command. 
		06/13/01	Use accessors for grafport contents. 
		02/06/01	Include StdStringUtils_AC.h.  Use CString_AC in SetMethodName.
					Use Str255 in other areas instead of CStr255_AC.
		02/06/01	Carbon: Use modern names for date/time utilities. 
					Use accessors for QD data structures. 
					COldGrossOffscreen will not be carbonized. 
					DoNeedDiskSpace went const. 
		01/02/01	Update copyright.
		07/14/00	Eliminated GetRegionCode calls.
		01/31/00	Replace CExtended with CExtended80. 
		12/08/99	Use REGISTER_CLASS_AC instead of macroDontDeadStrip.  Take 
					out MA_DEFINE_CLASS of TFracAppDocument.  Added qWantsMP
					flag check.  Change catch all to catch CException_AC.
					Cleanup fPaintQueue in FreeData.
		03/24/99	Update copyright notice.
		11/13/98	[2279258] Delete fPaintQueue in FreeData.
		11/12/98	[2279256] Added default definition of qDwellRangeCheck.
*/

#ifndef __UFRACDOC__
#include "UFracDoc.h"
#endif

// FracApp

#ifndef __CEXTENDED__
#include "CExtended.h"
#endif

#ifndef __UENGINE__
#include "UEngine.h"
#endif

#ifndef __FRACAPP__
#include "UFracApp.h"
#endif

#ifndef __UFRACGLOBALS__
#include "UFracGlobals.h"
#endif

#ifndef __UFRACVIEWS__
#include "UFracViews.h"
#endif

#ifndef __UOFFSCREEN__
#include "UOffscreen.h"
#endif

#ifndef __URECTSTACK__
#include "URectStack.h"
#endif

// MacApp

#ifndef __UFILE__
#include "UFile.h"
#endif

#ifndef __UERRORMGR__
#include "UErrorMgr.h"
#endif

#ifndef __UMEMORY__
#include "UMemory.h"
#endif

#ifndef __UMENUMGR__
#include "UMenuMgr.h"
#endif

#ifndef __UPRINTING__
#include "UPrinting.h"
#endif

#ifndef __UVIEWSERVER__
#include "UViewServer.h"
#endif

// ACS

#ifndef __StdStringUtils_AC__
#include "StdStringUtils_AC.h"
#endif

#ifndef __ThreadUtilities_AC__
#include "ThreadUtilities_AC.h"
#endif

// Toolbox

#ifndef __MULTIPROCESSING__
#include <Multiprocessing.h>
#endif

#ifndef __TOOLUTILS__
#include <ToolUtils.h>
#endif

#ifndef __PACKAGES__
#include <Packages.h>
#endif

// ANSI

#ifndef __STDIO__
#include <stdio.h>
#endif

#ifndef __STRING__
#include <string.h>
#endif

// Default definitions.

#ifndef qDwellRangeCheck
#define qDwellRangeCheck qDebug
#endif

//-------------------------------------------------------------------------------------------

const short kNormalVersion		= 4;				/* Identifies a document created by
													 FracApp 3.1 and using the
													 CNormalFracAppEngine */
const short kFastVersion		= 5;				/* Identifies a document created by
													 FracApp 3.1 and using the CFastFracApp
													 engine */
const short kUnknownVersion 	= - 1;				/* Used when initializing the version
													 number before the real version is
													 known. */

/* The dimensions of our Fractal documents. These are tailored to the size of the spiffy
  color printer we have in DTS. Your values may vary. */

const short kRectRight			= 608;
const short kRectBottom 		= 798;

/* String list (STR#) resource number and string indexes. These are used when building up the
  string that describes the algorithm being used. That string is of the form Òfractal
  algorithmÓ/Òoffscreen routines being usedÓ. */

const short kAlgorithmStrings	= 1200;
const short kUsing				= 1;
const short kUnknownAlgorithm	= 2;
const short kNormalAlgorithm	= 3;
const short kFastAlgorithm		= 4;
const short kSlash				= 5;
const short kHomebrewRoutines	= 6;
const short k32CQDRoutines		= 7;

/* Amount of time to spend on calculating fractals when we are in the foreground and in the
  background. 
*/

const long kFgCalcTime 		= 3;			// 3 ticks = 3/60 = 1/20 of sec
const long kBkCalcTime 		= 1;
const long kUnitsPerSecond 	= 60;

inline long TheTime()
{
	return ::TickCount();
}

const bool kWantSeconds		= true;			/* passed to IUTimePString to indicate that
													we want the time string to include seconds. */

/* We use the International Utilities for creating a time string when we are showing the
  elapsed times. But we canÕt just take the standard default format that the IU give us. We
  have to munge them so that we donÕt get things like AM or PM after the time, and so that
  we get leading zeros in the places we want them. This handle holds a copy of the default
  INTL(0) or itl0 resource, modified to our liking. */

Handle		gIntlHandle;

//-------------------------------------------------------------------------------------------
//-----------------------------------Global Procedures---------------------------------------
//-------------------------------------------------------------------------------------------


/* Utility routine that strips leading and trailing spaces. This is used by the time printing
  routines to remove mornStr and eveStr, wherever they may be. */

void StripString(StringPtr aString);
void StripString(StringPtr aString)
{
	short theEnd;
	for (theEnd = aString[0]; theEnd > 0; --theEnd)
	{
		if (aString[theEnd] != ' ') break;
	}
	aString[0] = theEnd;

	short theBegin;
	for (theBegin = 1; theBegin <= theEnd; ++theBegin)
	{
		if (aString[theBegin] != ' ') break;
	}
	if (theBegin > 1)
	{
		// Delete(aString, 1, theBegin - 1);
		short j = 1;
		for (short i = theBegin; i <= theEnd; ++i)
		{
			aString[j++] = i;
		}
		aString[0] = theEnd - theBegin + 1;
	}
}

//-------------------------------------------------------------------------------------------


void InitUFracDoc()
{
	/* Collect some information needed for working with the time string items in the
	  infobar. In order to convert an elapsed time, in seconds, into a time string,
	  we use IUTimePString. We pass to it a modified Intl0 Handle, that has no
	  morning and evening string attribute, and will display the time starting at
	  00:00:00, rather than 12:00:00 or 24:00:00. This modified Intl0 Handle is
	  saved in ÒgIntlHandleÓ */

	gIntlHandle = Handle(::GetIntlResource(0));
	::ThrowIfNULL_AC(gIntlHandle);
	::ThrowIfError_AC(::HandToHand(&gIntlHandle));

	(**(Intl0Hndl)gIntlHandle).timeCycle = zeroCycle;
	{
		char* p = (**(Intl0Hndl)gIntlHandle).mornStr;
		*p++ = ' ';
		*p++ = ' ';
		*p++ = ' ';
		*p   = ' ';
		p = (**(Intl0Hndl)gIntlHandle).eveStr;
		*p++ = ' ';
		*p++ = ' ';
		*p++ = ' ';
		*p   = ' ';
	}
	const long kZeroTime = 0;
	::TimeString(kZeroTime, kWantSeconds, gMaxWidthTimeString, gIntlHandle);
	StripString(gMaxWidthTimeString);

	REGISTER_CLASS_AC(TFracAppWindow);
	REGISTER_CLASS_AC(TFracAppView);
	REGISTER_CLASS_AC(TNoFlashStaticText);
}

//-------------------------------------------------------------------------------------------
//--------------------------------CPaintRectCache Methods------------------------------------
//-------------------------------------------------------------------------------------------


CPaintRectCache::CPaintRectCache() :
	fColor(gRGBWhite),
	fRect(gZeroRect)
{
}

void CPaintRectCache::Put(const CRGBColor_AC& aColor, const CRect_AC& aRect)
{
	if (fColor == aColor)
	{
		if ((aRect.left == fRect.left) && (aRect.right == fRect.right))
		{
			if (aRect.top == fRect.bottom)
			{
				fRect.bottom = aRect.bottom;
				return;
			}
			else if (fRect.top == aRect.bottom)
			{
				fRect.top = aRect.top;
				return;
			}
		}
		else if ((aRect.top == fRect.top) && (aRect.bottom == fRect.bottom))
		{
			if (aRect.left == fRect.right)
			{
				fRect.right = aRect.right;
				return;
			}
			else if (fRect.left == aRect.right)
			{
				fRect.left = aRect.left;
				return;
			}
		}
	}
	Flush();
	fColor = aColor;
	fRect = aRect;
}

//--------------------------------------------------------------------------------------------------


void CPaintRectCache::Flush()
{
	if ((fRect.bottom > fRect.top) && (fRect.right > fRect.left))
	{
		::RGBForeColor(fColor);
		::PaintRect(fRect);
	}
	fRect = gZeroRect;
}

//-------------------------------------------------------------------------------------------
//--------------------------------TFracAppDocument Methods-----------------------------------
//-------------------------------------------------------------------------------------------


/* Init for the FracAppDocument itself. We set a couple of fields to NULL so that we can Fail
  gracefully, and then init the base TPICTDocument. When we come back, we store in the
  FracHeader what kind of offscreen stuff we want to use. */

#undef Inherited
#define Inherited TPICTDocument

TFracAppDocument::TFracAppDocument(TFile* itsFile, bool use32BitCQD, CommandNumber startupMode) :
	TPICTDocument(itsFile, kFileType),
	fFracAppEngine(NULL),
	fFracAppWindow(NULL),
	fOffWorlder(NULL),
	fDwells(NULL),
	fDwellWidth(0),
	fPaintQueue(NULL),
	fStartupMode(startupMode),
	fThreadCount(0)
{
#if qPowerPC
#if qWantsMP
	if (::HasMP_AC())
	{
		fThreadCount =  /* 2 * */ ::MPProcessors();
	}
	else 
#endif // qWantsMP
	if (::HasThreadManager_AC())
	{
		fThreadCount = 2;
	}
	else {
		fThreadCount = 0;	// Use idling, not threads.
	}
#else
	// 68k.
	if (::HasThreadManager_AC())
	{
		fThreadCount = 2;
	}
	else
	{
		fThreadCount = 0;	// Use idling, not threads.
	}
#endif

	/* We just initialize Ôuse32BitCQDÕ here because this is where we get passed its
	  value. The rest of fFracHeader gets initialized in DoInitialState. */

	fFracHeader.use32BitCQD = use32BitCQD;

	const short kPaintQueueSize = 1000;
	const short kCompletedQueueSize = 200;

	Boolean oldPerm = PermAllocation(true);
	CRectQueue* aRectQueue = TH_new CRectQueue(kPaintQueueSize);
	PermAllocation(oldPerm);
	::ThrowIfNULL_AC(aRectQueue);
	fPaintQueue = aRectQueue;
}

//-------------------------------------------------------------------------------------------


/* Free method for the documents themselves.  We need to override so that we can throw away
  the data object that was read in from the disk if it exists. */

TFracAppDocument::~TFracAppDocument()
{
	FreeData();
}

//-------------------------------------------------------------------------------------------


/* Adds ÒareaAmountÓ to the areaComplete field. We keep track of this stuff so that we can
  display the percentage complete. This is my own method that the TFracAppEngines call when
  theyÕve updated a new area of the fractal. */

void TFracAppDocument::BumpAreaComplete(long areaAmount)
{
	SetAreaComplete(fFracHeader.areaComplete + areaAmount, kDontForceUpdate);
}

//-------------------------------------------------------------------------------------------


/* Increments the elapsedTime field and updates the window display. Called by the document
  idling routine: CalcTown. */

void TFracAppDocument::BumpCalculationTime(long elapsedAmount)
{
	SetCalculationTime(fFracHeader.elapsed + elapsedAmount, kDontForceUpdate);
}

//-------------------------------------------------------------------------------------------


/* DocumentÕs idling routine. Called by TFracAppApplication::DoIdle when itÕs this documentÕs
  turn to calculate part of itself. Takes care of calling the CFracAppEngine, and updating
  the window timer displays.

  It determines how much time to give to the FracAppEngine in 3 ways. First, if we are in
  the background, we donÕt want to be CPU hogs, so we take up as little time as possible.
  Mostly this mean limiting ourselves to about one call to the engine. */

bool TFracAppDocument::CalcTown()
{
	short maxIterations = 1;
	if (fThreadCount == 0)
		maxIterations = 100;

	bool done = false;

	for (short i = 1; i <= maxIterations && ! done; ++i)
	{
		long startTime = TheTime();
		{
			if (fThreadCount == 0)
				fFracAppEngine->CalcCity();

			done = PaintDwellQueue();
		}
		long endTime = TheTime();

		/* WeÕre done with calculating our part of the fractal for now. Now update our
		  counters in the window. */

		BumpCalculationTime(endTime - startTime);
		SetElapsedTime(kDontForceUpdate);

		/* If the engine signalled that weÕre all done, then remember that. Also return that fact
		to the routine that called us so that it can take appropriate action. */

		if (done)
		{
			done = fFracAppEngine->GetDone();
			if (done)
			{
				long pictureArea = fFracHeader.plotWidth * fFracHeader.plotHeight;
				done = fFracHeader.done = (fFracHeader.areaComplete >= pictureArea);
			}
		}
	}

	return done;
}

//-------------------------------------------------------------------------------------------


/* This method overrides the abstract method in TPICTDocument. It is called in the writing
  routines to image the data for the PICT. */

void TFracAppDocument::DoDrawPicture()
{

	/* The next couple of lines are really weird. Take a look at pages V 71-72 of
	  Inside Mac. There, in the description of CopyBits, youÕll see that it says
	  that ÒDuring a CopyBits call, the foreground and background colors are
	  applied to the image.Ó Technote 163, ÒAdding Color with CopyBitsÓ explains
	  more on exactly what happens. What my point is, though, is that we donÕt want
	  this to happen. So to effectively get a null color addition, we set the
	  foreground and background colors to black and white. */

	::RGBForeColor(gRGBBlack);
	::RGBBackColor(gRGBWhite);

	/* Copy all of the image to itself. This has no effect on the grafPort, but it
	  does cause all of the data to get captured by the PICT grafProcs. */

	CRect_AC portRect = GetPortRect_AC();
#if qCarbon
	const BitMap* portBits = GetPortBitMapForCopyBits(GetGrafPtr_AC());
#else
	const BitMap* portBits = &(qd.thePort->portBits);
#endif
	::CopyBits(portBits, portBits, portRect, portRect, srcCopy, NULL);
}

//-------------------------------------------------------------------------------------------
// DoInitialState
//-------------------------------------------------------------------------------------------

/* Does the work for a New operation, where we start with a new fractal that doesnÕt have any
  stored data. This is to set up the view with no data and set up the fractal coordinates to
  the default. */

void TFracAppDocument::DoInitialState()
{
	/* Start by filling in the fields that identify this document. These fields will
	  be examined when we read the document back in from disk. If we donÕt
	  recognize them, we bail out of reading them back in. The fType field is set
	  to our fileÕs signature. The hdrID identifies this header as one that is
	  associated with FracApp. Finally, the version number identifies which FracApp
	  engine we are using. At this point, we set it to kUnknownVersion, because we
	  donÕt know how the engine will identify itself; we rely on it to ultimately
	  fill this field correctly. */

	fFracHeader.fType = kSignature;
	fFracHeader.hdrId = short(kHeaderID);
	fFracHeader.version = kUnknownVersion;

	fFracHeader.done = false;				// not done, starting brand new document.
	fFracHeader.elapsed = 0;				/* just starting, set the time spent on
											 calculating the fractal to zip. */
	{
		unsigned long secs;
		::GetDateTime(&secs);
		fFracHeader.startingTime = secs;
	}
	fFracHeader.endingTime = 0;
	fFracHeader.areaComplete = 0;

	if (fStartupMode == cNewFromSelection)
	{
		/* We are being created from a previous document. This is because the user 
		   selected a range and told us to zoom in on it. All the information we 
		   need to boot up is in gPageRecord */

		fFracHeader.pages = gPageRecord;
		fFracHeader.pages.multiPaging = false;
	}
	else
	{
		/* We start from scratch. This is the standard set of coordinates to start the
		  default Mandelbrot set. Set up the coordinates to do, saving state in header
		  variables. The other variables (currentH, currentV, maxH, maxV) are not
		  needed if we are not multipaging. Since this part of the IF/THEN statement
		  doesnÕt handle multipaging, we donÕt have to futz with them. */

		fFracHeader.pages.realMin = -2.5;
		fFracHeader.pages.realMax = 1.5;
		fFracHeader.pages.imagMin = -1.5232;
		fFracHeader.pages.imagMax = 1.5232;
		fFracHeader.pages.multiPaging = false;
	}

	// Set the fractal rectangle to be the full page size at 300 dpi.
	Rect tmpRect;
	::SetRect(&tmpRect, 0, 0, kRectRight, kRectBottom);
	fFracHeader.calcRect = tmpRect;

	/* Set up the width/height of fractal, the delta in each axis as a real number,
	  and ensure that the starting min/max values for the figure are set to supply
	  a 1:1 aspect ratio. */

	/* Set up the iterations by calculating up the step constants, and the
	  edges of the view area in pixels. */

	CExtended realMax(fFracHeader.pages.realMax);
	CExtended realMin(fFracHeader.pages.realMin);
	CExtended imagMax(fFracHeader.pages.imagMax);
	CExtended imagMin(fFracHeader.pages.imagMin);
	CExtended deltaP(fFracHeader.deltaP);
	CExtended deltaQ(fFracHeader.deltaQ);

	fFracHeader.plotWidth = (fFracHeader.calcRect.right - fFracHeader.calcRect.left);
	fFracHeader.plotHeight = (fFracHeader.calcRect.bottom - fFracHeader.calcRect.top);
	deltaP = (realMax - realMin) / (fFracHeader.plotHeight - 1);
	deltaQ = (imagMax - imagMin) / (fFracHeader.plotWidth - 1);

	/* Force aspect ratio 1:1, making delta smallest of two.  This effectively grows
	  one side or the other out, like rMax/iMax becoming bigger number. */

	if (deltaP > deltaQ)
	{
		deltaQ = deltaP;
		imagMax = deltaQ * (fFracHeader.plotWidth - 1) + imagMin;
	}	// grow the q side
	else
	{
		deltaP = deltaQ;
		realMax = deltaP * (fFracHeader.plotHeight - 1) + realMin;
	}	// grow the p side


	fFracHeader.pages.realMax = realMax;
	fFracHeader.pages.realMin = realMin;
	fFracHeader.pages.imagMax = imagMax;
	fFracHeader.pages.imagMin = imagMin;
	fFracHeader.deltaP = deltaP;
	fFracHeader.deltaQ = deltaQ;

	// Create our supporting objects, the OffWorld object, and the Fractal engine object.

	COffscreen* anOffWorlder = MakeOffWorlder(fFracHeader.calcRect);
	fOffWorlder = anOffWorlder;

	/* Set up the dwells buffer. */
	Byte* dwells = MakeDwells();
	fDwells = dwells;

	short versionToMake = gUseFastAlgorithm ? kFastVersion : kNormalVersion;

	CFracAppEngine* aFracAppEngine = MakeFracAppEngine(versionToMake);
	fFracAppEngine = aFracAppEngine;
	fFracHeader.version = versionToMake;

	::ThrowIfError_AC(StartCalculating());

}

//-------------------------------------------------------------------------------------------


/* Make something to see our picture in. This uses NewTemplateWindow to create a window and
  its subviews from a ÔviewÕ resource. When we have the window, we read in a ÔplttÕ resource
  and attach it to it. We also initialize a lot of the windows fields with references to its
  subviews. Finally, we create a print handler, and attach it to the TFracAppView. */

void TFracAppDocument::DoMakeViews(bool /*forPrinting*/)
{
	TFracAppWindow* theWindow = (TFracAppWindow*)(gViewServer->NewTemplateWindow(kFracAppWindowID, this));
	fFracAppWindow = theWindow;
	fFracAppWindow->SetResizeLimits(CPoint_AC(0,0), 
			CPoint_AC(fFracHeader.plotWidth+16, fFracHeader.plotHeight+36));

	SetAreaComplete(fFracHeader.areaComplete, kForceUpdate);
	SetCalculationTime(fFracHeader.elapsed, kForceUpdate);
	SetElapsedTime(kForceUpdate);
	SetMethodName(kForceUpdate);

	/* Printing handler as standard print handler will get a color port back
	  from the driver.	The pixels are square, and the dimensions are fixed. */

	TStdPrintHandler* aHandler = TH_new TStdPrintHandler(this,		// its document
							  fFracAppWindow->GetFracAppView(),	// its view
							  kFixedSize,		// horzontal page size is fixed
							  kFixedSize);		// vertical page size is fixed
	::ThrowIfNULL_AC(aHandler);
}

//-------------------------------------------------------------------------------------------


/* The document is in charge of menu items that affect the document. In FracApp, the only
  things that should be active when we have a document are the normal editting commands, and
  the palette munging stuff. We donÕt support Cut or Paste, which donÕt really make sense in
  FracApp, but we support Copy. Doing a Copy will put the current selection to the desk
  scrap as a PICT. We rely on the default MacApp clipboard routines to display the PICT. */

void TFracAppDocument::DoMenuCommand(CommandNumber aCommandNumber)
{
	switch (aCommandNumber)
	{
		case cZoomToSelection:
			{
				FreeData();
				fStartupMode = cNewFromSelection;
				StashSelectedRange();
				DoInitialState();
			}
			break;

		default:
			Inherited::DoMenuCommand(aCommandNumber);
	}
}

//-------------------------------------------------------------------------------------------


/* DoNeedDiskSpace is called when we need to estimate the size the file will be on disk. Most
  of the work is done by the base class, TPICTDocument. It figures out how large the file
  will be when converted into a PICT. However, before we can call it, we have to switch to
  the fractal image off screen. We then call the Inherited::method, and switch back after
  weÕre all done. */

void TFracAppDocument::DoNeedDiskSpace(TFile* itsFile, long& dataForkBytes,
									   long& rsrcForkBytes) const
{
	const_cast<TFracAppDocument*>(this)->PreDraw();
	Inherited::DoNeedDiskSpace(itsFile, dataForkBytes, rsrcForkBytes);
	const_cast<TFracAppDocument*>(this)->PostDraw();
}

//-------------------------------------------------------------------------------------------


/* Called to read in the file. We let the base class, TPICTDocument, handle reading in the
  actual PICT data. Here, we make sure that we are properly set to the offscreen world first
  so that we image to the right place. We also read in the user header data into our
  FracHeader record. */

void TFracAppDocument::DoRead(TFile* aFile, bool forPrinting)
{
	/* The file is open already, we just have to read the data out of it. The first
	  thing to read is the header we use to describe a fractal. If we get an error
	  here we need to split since we should always have at least a header. The
	  fractal header is the global state for the document. We just read it into the
	  record and use it from there. */

	::ThrowIfError_AC(aFile->SetDataMark(0, fsFromStart)); // starts at first byte of file.
	long recsize = sizeof(fFracHeader); 			// size of header on fractal files.
	::ThrowIfError_AC(aFile->ReadData(&fFracHeader, recsize));

	/* We have the header for the PICT file. Now we need to be sure that it is a
	  fractal document, and not something we canÕt use. Check the header to be
	  sure, and if not right, error out with a good alert message (using a standard
	  MacApp errcode). */

	if (fFracHeader.fType != kSignature)
	{
		#if qDebug
			printf("Failing in DoRead. Signature %.4s\n", &fFracHeader.fType);
			printf("                   should be %.4s\n", &kSignature);
		#endif
		::ThrowIfError_AC(errNotMyType);
	}

	if (fFracHeader.hdrId != short(kHeaderID))
	{
		#if qDebug
			printf("Failing in DoRead. hdrId %x\n", fFracHeader.hdrId);
			printf("               should be %x\n", short(kHeaderID));
		#endif
		::ThrowIfError_AC(errNotMyType);
	}

	/* We have the data from the header. Go ahead and set up an offscreen world for
	  this document, using the header rectangle. Once we got that, switch over to
	  it, and read in the PICT stuff by calling the Inherited::DoRead method. */

	CRect_AC tempRect = fFracHeader.calcRect;
	COffscreen* anOffWorlder = MakeOffWorlder(tempRect);
	fOffWorlder = anOffWorlder;

	try
	{
		PreDraw();
		Inherited::DoRead(aFile, forPrinting);
		PostDraw();
	}
	catch(CException_AC& theException)
	{
		DoCatchMessage_AC(theException);
		PostDraw();
		throw;
	}

	/* Set up the dwells buffer and initialize it from the PICT. */
	Byte* dwells = MakeDwellsFromBitmap();
	fDwells = dwells;

	/* Now weÕve read in the standard header, and have imaged the PICT into the
	  offscreen PixMap. All we have to do now is create a fractal engine, and
	  initialize from the rest of the data on this disk. */

	CFracAppEngine* aFracAppEngine = MakeFracAppEngine(fFracHeader.version);
	fFracAppEngine = aFracAppEngine;

	/* Set the file mark back to the end of the FracHeader. This is done as our last
	  action so that anything subclassing us can read any information it appends to
	  the normal FracHeader. It shouldnÕt know what size the FracRecord is (or even
	  really know that it exists), or realize that there is variable length engine
	  data appended to it, so we reposition the file mark for it. */

	::ThrowIfError_AC(aFile->SetDataMark(sizeof(fFracHeader), fsFromStart));
	fFracAppEngine->DoRead(aFile->GetDataRefNum(), forPrinting);
}

//-------------------------------------------------------------------------------------------


/* Set up the menus that the document is responsible for. These are the ones that logically
  should only be enabled if we have a document on the screen. In our case, this includes the
  Copy Edit command, and the Palette Manager animation commands. */

void TFracAppDocument::DoSetupMenus()
{
	Inherited::DoSetupMenus();					// Do mainline stuff first.
}

//-------------------------------------------------------------------------------------------


/* Called to write out the file. We let the base class, TPICTDocument, handle writing out the
  actual PICT data. Here, we make sure that we are properly set to the offscreen world first
  so that we copybits from the right place. We also write out the user header data from our
  FracHeader record and fractal engine. */

void TFracAppDocument::DoWrite(TFile* aFile, bool makingCopy)
{
	/* Prepare our world for writing the PICT out. First, we do a CatchFailures so
	  that we can restore the world to a reasonable state in case something goes
	  wrong. Then we switch in the offscreen world. The next step is kind of ugly,
	  but necessary. We clear bit 14 of ctFlags before writing out the file. This
	  is because weÕll run into problems later if we try to read the PICT back in
	  with that bit set; we wonÕt match the colors that we would like in our
	  offscreen world.

	  Bit 14 is the bit that tells 32-bit Color QuickDraw to match palette entries
	  when copying from one pixmap to another. However, when we are reading from
	  disk, the destination is our offscreen pixmap, which doesnÕt have a palette.
	  If bit 14 is set, 32bCQD will fall back on a backup plan of trying to match
	  RGB values. So our solution is to clear bit 14. Finally, we call the
	  Inherited::method to write out the PICT. After thatÕs done, we put everything
	  back, and proceed to the part where we write out the header info. */

	try
	{
		PreDraw();							// Swap in our offscreen world
		fOffWorlder->ChangeCTFlag(kAnimationFlag, kClearFlag);
		Inherited::DoWrite(aFile, makingCopy);
		fOffWorlder->ChangeCTFlag(kAnimationFlag, kSetFlag);
		PostDraw();
	}
	catch(CException_AC& theException)
	{
		DoCatchMessage_AC(theException);
		fOffWorlder->ChangeCTFlag(kAnimationFlag, kSetFlag);
		PostDraw();
		throw;
	}

	/* We have legit data in our document, set the mark in the file to be at the front.
	  and write out the header information. Once thatÕs done, we call the Fractal
	  engine to write out anything that it needs to. Notice that we do this last, so
	  that we leave the file mark at the next available spot to write. This is so any
	  thing that sub-classes us will be able to write right where we left them. */

	::ThrowIfError_AC(aFile->SetDataMark(0, fsFromStart));
	long recsize = sizeof(fFracHeader);
	::ThrowIfError_AC(aFile->WriteData(&fFracHeader, recsize));
	fFracAppEngine->DoWrite(aFile->GetDataRefNum(), makingCopy);
}

//-------------------------------------------------------------------------------------------


/* This is typically used in a Revert case which is not really meaningful here, but the
  structure is the same so we use it anyway.  Frees the data associated with a document,
  that is strictly program data, not MacApp data. */

void TFracAppDocument::FreeData()
{
	if (fFracAppEngine)
	{
		delete fFracAppEngine;
		fFracAppEngine = NULL;
	}
	
	if (fOffWorlder)
	{
		delete fOffWorlder;
		fOffWorlder = NULL;
	}
	
	if (fPaintQueue)
	{
		delete fPaintQueue;
		fPaintQueue = NULL;
	}
	
	if (fDwells)
	{
		fDwells = (Byte*) DisposeIfPtr_AC(Ptr(fDwells));
	}
}

//-------------------------------------------------------------------------------------------
/* Access methods. These are here so that objects can query the document for some bits of
  information. Rather than have those objects just look into our instance variables and pull
  out what they need, we have them call these methods. This is so the actual implementation
  of the document data is kept private and, hence, flexible. For instance, an earlier
  version of this program had TFracAppView go into TFracAppDocument and take what it needed.
  This was done for speed purposes, as calling a function to return a value for you is much
  slower than just getting it yourself. However, this caused problems when the world changed
  with FracApp 3.1. Suddenly, document data was managed with COffscreen objects. This
  necessitated modifying TFracAppView because the data wasnÕt where it thought it was any
  more. Only the document should know how its data is managed and stored. Now that
  TFracAppView uses these accessors, we hopefully wonÕt have to make any changes to it in
  the future. */

/* Most of the access methods are now C++ inline functions */

//-------------------------------------------------------------------------------------------


// Returns the offscreen port. Used by the TFracAppView when updating the screen.

CGrafPtr TFracAppDocument::GetFracPort()
{
	return fOffWorlder->GetOffPort();
}

//-------------------------------------------------------------------------------------------


/* Returns the pointer to the bits for the offscreen port. Called by the
   CFracAppEngine when doing its own version of GetCPixel. */

Ptr TFracAppDocument::GetOffPixBase()
{
	return fOffWorlder->GetOffPixBase();
}

//-------------------------------------------------------------------------------------------

#if 0

/* Called in response to the user selecting the ÒJumble PaletteÓ menu item.
   The function has been moved to the window; this just passes control to it. */

void TFracAppDocument::JumblePalette()
{
	fFracAppWindow->JumblePalette();
}

#endif // 0

//-------------------------------------------------------------------------------------------


/* Called by the TFracAppView before it does any CopyBits operations. This is so the View
  only needs to know about the TFracAppDocument; it never needs to know that a TOffScreen
  object exists. */

void TFracAppDocument::LockThePixels(bool lockIt)
{
	if (lockIt)
		fOffWorlder->LockThePixels();
	else
		fOffWorlder->UnlockThePixels();
}

//-------------------------------------------------------------------------------------------


/* Make a dwells buffer. */

Byte* TFracAppDocument::MakeDwells()
{
	fDwellWidth = fFracHeader.calcRect.right - fFracHeader.calcRect.left;
	long bufSize = (long)fDwellWidth * (fFracHeader.calcRect.bottom - fFracHeader.calcRect.top);
	Boolean oldPerm = PermAllocation(true);
	Byte* dwells = (Byte*) ::NewPtrClear(bufSize * sizeof(Byte));
	PermAllocation(oldPerm);
	::ThrowIfNULL_AC(dwells);

	return dwells;
}

//-------------------------------------------------------------------------------------------

#if !ACCESSOR_CALLS_ARE_FUNCTIONS
inline PixMapHandle GetPortPixMap(CGrafPtr port)
{
	return port->portPixMap;
}
#endif

/* Make a dwells buffer and initialize it from the bitmap in our offscreen graphics
  world. */

Byte* TFracAppDocument::MakeDwellsFromBitmap()
{
	Byte* dwells = MakeDwells();
	#if qDwellRangeCheck
		Ptr endBuf = Ptr(dwells) + ::GetPtrSize(Ptr(dwells));
	#endif
	Byte* dwellPtr = dwells;

	/* Go into the PixMap and get the pixels by hand. We start with the pointer to
	  the pixmap base. We then calculate the offset into the pixmap where the pixels lay.
	  This is easy as there is a 1 to 1 correspondance between bytes and pixels. Since the
	  pixmap data could be off in 32-bit space somewhere, we have to jump over into
	  32-bit mode in order to make sure we can access our bits. Once we have the pixels,
	  we jump right back into whatever mode we were in before. This takes up more System
	  calls (GetOffPixBase and GetFracPort make system calls, in addition to 2 SwapMMUModes
	  and and Index2Color) versus a single GetCPixel, but we're saving overall because
	  we're getting all the pixels at once. */

	Ptr rowPtr = GetOffPixBase();
	long rowBytes;
	{
		CGrafPtr offPort = GetFracPort();
		PixMapHandle portPixMap = GetPortPixMap(offPort);
		rowBytes = (**portPixMap).rowBytes & 0x00001FFF;
	}
	SignedByte mode = true32b;
	SwapMMUMode(&mode);
	for (short y = fFracHeader.calcRect.top; y < fFracHeader.calcRect.bottom; ++y)
	{
		Ptr pixelPtr = rowPtr;
		for (short x = fFracHeader.calcRect.left; x < fFracHeader.calcRect.right; ++x)
		{
			#if qDwellRangeCheck
				if ((Ptr(dwellPtr) < Ptr(dwells)) || (Ptr(dwellPtr) >= endBuf))
					ProgramBreak_AC((StringPtr)"\pindex out of range");
			#endif
			*dwellPtr++ = *pixelPtr++;
		}
		rowPtr += rowBytes;
	}
	SwapMMUMode(&mode);

	return dwells;
}

//-------------------------------------------------------------------------------------------


/* All of the know-how that generates a fractal is encapsulated in the CFracAppEngine object.
  WeÕll create a CNormalFracAppEngine to calculate the fractal on a pixel-by-pixel basis, or
  a CFastFracAppEngine if we want to use the Mariani/Silver algorithm. This method creates
  the object based on the version number passed to it, and return it to the caller. */

CFracAppEngine* TFracAppDocument::MakeFracAppEngine(short version)
{
	switch (version)
	{
		case kNormalVersion:
			{
				Boolean oldPerm = PermAllocation(true);
				CNormalFracAppEngine* aNormalFracAppEngine = TH_new CNormalFracAppEngine;
				PermAllocation(oldPerm);
				::ThrowIfNULL_AC(aNormalFracAppEngine);
				aNormalFracAppEngine->INormalFracAppEngine(this, fDwellWidth, fDwells);
				return aNormalFracAppEngine;
			}
			break;

		case kFastVersion:
			{
				Boolean oldPerm = PermAllocation(true);
				CFastFracAppEngine* aFastFracAppEngine = TH_new CFastFracAppEngine;
				PermAllocation(oldPerm);
				::ThrowIfNULL_AC(aFastFracAppEngine);
				aFastFracAppEngine->IFastFracAppEngine(this, fDwellWidth, fDwells);
				return aFastFracAppEngine;
			}
			break;

		default:
			{
				#if qDebug
					printf("Failing in MakeFracAppEngine. version = %d\n", version);
				#endif
				::ThrowIfError_AC(errNotMyType);
			}
			break;
	}
	
	return NULL;
}

//-------------------------------------------------------------------------------------------


/* All the offscreen management will be handled by a COffscreen object. Depending on whether
  or not 32-bit Color QuickDraw is available, we will either create an object that knows how
  to handle the new calls, or one that does things the old fashioned way. Once we have one
  of those, we use it for creating our offworld and for preparing it for being drawn into. */

COffscreen* TFracAppDocument::MakeOffWorlder(const CRect_AC& bounds)
{
	Boolean oldPerm = PermAllocation(true);
	CNewCoolOffscreen* aNewOffWorlder = TH_new CNewCoolOffscreen;
	PermAllocation(oldPerm);
	::ThrowIfNULL_AC(aNewOffWorlder);
	aNewOffWorlder->INewCoolOffscreen(bounds, gOurColors);
	return aNewOffWorlder;
}

//-------------------------------------------------------------------------------------------


bool TFracAppDocument::PaintDwellQueue()
{
	bool done = fPaintQueue->IsEmpty();
	if (!done)
	{
		CRect_AC r;
		TView* fracView = fFracAppWindow->GetFracAppView();
		PreDraw();

		while (!fPaintQueue->IsEmpty())
		{
			fPaintQueue->PopRect(r);
//			PaintDwellRect(r);
			BlitDwellRect(r);
			// Switch to screen context to do updates.
			PostDraw();
			fracView->Invalidate(r);
			BumpAreaComplete((long)(r.right - r.left) * (r.bottom - r.top));
			PreDraw();
		}
		PostDraw();
		BumpChangeCount();
	}
	return done;
}

//-------------------------------------------------------------------------------------------


/* Paints a rectangle in the offscreen bitmap, based on the value in the dwell array.
  It is assumed that all the dwell values in the rectangle are the same. */

void TFracAppDocument::PaintDwellRect(const CRect_AC& r)
{
	short dwell = fFracAppEngine->GetDwell(r.left, r.top);
	CRGBColor_AC itsColor;
	::Index2Color(dwell, itsColor);
	fPaintRect.Put(itsColor, r);
}

//-------------------------------------------------------------------------------------------


/* Blits a rectangle in the offscreen bitmap, based on the values in the dwell array. */

void TFracAppDocument::BlitDwellRect(const CRect_AC& r)
{
	LockThePixels(true);	// Nothing moves memory here.
	long basePixIndex, baseDwellIndex;
	long pixIndex, dwellIndex;
	long rowBytes;
	{
		CGrafPtr offPort = GetFracPort();
		PixMapHandle portPixMap = GetPortPixMap(offPort);
		rowBytes = (**portPixMap).rowBytes & 0x00001FFF;
	}
	Byte* base = (Byte*)GetOffPixBase();
	SignedByte mode = true32b;
	SwapMMUMode(&mode);
	for (short row = r.top; row <= r.bottom - 1; ++row)
	{
		baseDwellIndex = (long)fDwellWidth * row;
		basePixIndex = (long)rowBytes * row;
		pixIndex = basePixIndex + r.left;
		dwellIndex = baseDwellIndex + r.left;
		::memcpy(&base[pixIndex], &fDwells[dwellIndex], r.right - r.left);
	}
	SwapMMUMode(&mode);
	LockThePixels(false);
}

//-------------------------------------------------------------------------------------------


/* Called by CFracAppEngine before it images to the offscreen bitmap. This is so the Engine
  only needs to know about the TFracAppDocument; it never needs to know that a TOffScreen
  object exists. */

void TFracAppDocument::PreDraw()
{
	fOffWorlder->PreDraw();
}

//-------------------------------------------------------------------------------------------


/* Access method to our offscreen management to restore our original world that was swapped
  out with TFracAppDocument::PreDraw. */

void TFracAppDocument::PostDraw()
{
	fPaintRect.Flush();

	fOffWorlder->PostDraw();
}

//-------------------------------------------------------------------------------------------

#if 0

/* This effectively nullifies the effects of AnimateColors or JumblePalette. It makes sure
  that the color tables for our offscreen world and our gDevices match again. */

void TFracAppDocument::RestorePalette()
{
	fFracAppWindow->RestorePalette();
}

#endif // 0

//-------------------------------------------------------------------------------------------


/* Updates the areaCompleted field in fFracHeader. Also updates the percentage field in the
  window. */

void TFracAppDocument::SetAreaComplete(long newComplete, bool forceUpdate)
{
	long pictureArea = fFracHeader.plotWidth * fFracHeader.plotHeight;
	short oldPctComplete = short((fFracHeader.areaComplete * 100) / pictureArea);
	short newPctComplete = short((newComplete * 100) / pictureArea);
	fFracHeader.areaComplete = newComplete;

	if (forceUpdate || (oldPctComplete != newPctComplete))
	{
		CString_AC	pctString;
		stringprintf(pctString, "%d", newPctComplete);
		fFracAppWindow->GetPercentView()->SetText(pctString, kRedraw);
	}
}

//-------------------------------------------------------------------------------------------


/* Updates the elapsedTime field in fFracHeader. Also updates the calculation time field in
  the windowÕs infobar. */

void TFracAppDocument::SetCalculationTime(long newElapsed, bool forceUpdate)
{
	/* Find the new time, and compare it with the time that currently appears in the
	  window. If they are different then call IUTimePString to convert the time
	  into a string, and then update the string in the window.

	  kUnitsPerTime is a constant that converts our counter into a number expressed
	  in seconds. Our counters are either expressed in Ticks or milliseconds.
	  kUnitsPerTime is the right number to convert them to seconds. */

	long newTime = newElapsed / kUnitsPerSecond;

	if (forceUpdate || (newTime > (fFracHeader.elapsed / kUnitsPerSecond)))
	{
		Str255 timeString;
		::TimeString(newTime, kWantSeconds, timeString, gIntlHandle);
		fFracAppWindow->GetCTimeView()->SetText(CString_AC(timeString), kRedraw);
	}

	fFracHeader.elapsed = newElapsed;
}

//-------------------------------------------------------------------------------------------


/* Updates the elapsed time field in the windowÕs infobar based on the starting and current
  time. */

void TFracAppDocument::SetElapsedTime(bool forceUpdate)
{
	/* Determine what to use for our Òending valueÓ for the elapsed time. Normally,
	  this is just the current time. However, if the document is done, then the
	  counters should be stopped, in which case, the Òending valueÓ is the last
	  value stored in fFracHeader.endingTime. */

	unsigned long currentTime;
	if (GetDone())
		currentTime = fFracHeader.endingTime;
	else
		::GetDateTime(&currentTime);

	unsigned long newElapsed = currentTime - fFracHeader.startingTime;

	/* If the current elapsed time is different from the time displayed in the
	  window, convert it into a string with IUTimePString, and update the string in
	  the window. */

	if (forceUpdate || (currentTime > fFracHeader.endingTime))
	{
		Str255 timeString;
		::TimeString(newElapsed, kWantSeconds, timeString, gIntlHandle);
		fFracAppWindow->GetETimeView()->SetText(CString_AC(timeString), kRedraw);
	}

	fFracHeader.endingTime = currentTime;
}

//-------------------------------------------------------------------------------------------


/* Sets the string that displays the algorithm being used to create the fractal. Called by
  TFracAppDocument::DoMakeViews when the document is being created. */

void TFracAppDocument::SetMethodName(bool /*forceUpdate*/)
{
	/* Get the first part of the equation. Our final string will look something like
	  ÒUsing <Calculation Algorithm>/<Offscreen routines>Ó. We first get the string
	  for ÒUsing Ó. */

	CString_AC methodString(static_cast<ResNumber>(kAlgorithmStrings), kUsing);

	/* Next, get the name for the algorithm. Convert the version number in
	  fFracHeader into a string index in our string list. If we donÕt know
	  the version number, punt to a string that says ÒUnknown.Ó This should never
	  happen, but it doesnÕt hurt to play it safe. When we get the string, add it
	  to the first part. We now have ÒUsing <Calculation Algorithm>Ó. */

	ResNumber stringNumber = kUnknownAlgorithm;
	if (fFracHeader.version == kNormalVersion)
		stringNumber = kNormalAlgorithm;
	else if (fFracHeader.version == kFastVersion)
		stringNumber = kFastAlgorithm;

	
	methodString += CString_AC(kAlgorithmStrings, stringNumber);

	/* If we donÕt know what algorithm we are using, then we are done. Otherwise, we
	  need to add the string that says what offscreen routines we are using. Get
	  the slash, add it to the string, and then get the string that describes the
	  offscreen routines. */

	if (stringNumber != kUnknownAlgorithm)
	{
		methodString += CString_AC(static_cast<ResNumber>(kAlgorithmStrings), kSlash);
		methodString += CString_AC(static_cast<ResNumber>(kAlgorithmStrings), fFracHeader.use32BitCQD ? k32CQDRoutines : kHomebrewRoutines);
	}

	fFracAppWindow->GetMethodView()->SetText(methodString, kRedraw);
}

//-------------------------------------------------------------------------------------------


OSErr TFracAppDocument::StartCalculating()
{
	::ThrowIfNULL_AC(fFracAppEngine);

	return fFracAppEngine->StartCalculating();
}

//-------------------------------------------------------------------------------------------


/* Handy routine that stores information describing the current selection to the global
  variable ÔgPageRecordÕ. This is called when creating a new document based on the current
  selection in another document. */

void TFracAppDocument::StashSelectedRange()
{
	CRect_AC selection;
	fFracAppWindow->GetFracAppView()->GetSelection(selection);
	
	CExtended realMin(fFracHeader.pages.realMin);
	CExtended imagMin(fFracHeader.pages.imagMin);
	CExtended deltaP(fFracHeader.deltaP);
	CExtended deltaQ(fFracHeader.deltaQ);

	gPageRecord.realMin = (realMin + deltaP * selection.top);
	gPageRecord.realMax = (realMin + deltaP * selection.bottom);
	gPageRecord.imagMin = (imagMin + deltaQ * selection.left);
	gPageRecord.imagMax = (imagMin + deltaQ * selection.right);
}

//----------------------------------------------------------------------------------------
// End of UFracDoc.cpp
