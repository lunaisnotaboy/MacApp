//----------------------------------------------------------------------------------------
// UStdPrintHandler.cpp
// Copyright � 1986-2001 by Apple Computer, Inc. All rights reserved.
//----------------------------------------------------------------------------------------

/*
	Change History
		04/09/01	In DrawPrintFeedback and GetBreakCoord, previousBreak is 
					used only in debug mode. 
		01/15/01	Use CString_AC instead of CStr255_AC.
		01/02/01	Update copyright.
		11/13/00	Definition of gBreaksPenState was missing a level of braces. 
					Work around some signed vs. unsigned comparison warnings by
					casting. Better fix will be to make page numbers consistently
					signed or unsigned. 
					Need to get C string from standard string for printing. 
					Remove unused variable strip in PageToStrip. 
					Remove unused variable pageStrips in Print. 
		11/11/00	Cosmetic.
		11/03/00	Don�t include Printing.h--already included by the header.
		10/19/00	MrCpp doesn't support mutable.
		09/06/00	Added embedded documentation.
		09/01/00	Stripped dead code.  Cosmetic.  Added pragma unused.
		06/22/00	Added MA_DEFINE_CLONE for TStdPrintHandler.
		06/14/00	Replace MASetResLoad with CTempResLoad in StripPrintInfoResources
					and simplified try block.  Include CMultiLocal_AC.h and ResourceUtils_AC.h.
		05/23/00	[2279264] Remove false from ProgramReport_AC.
		04/25/00	No need to set the port on OneSubJob.  Moved view�s BeInPort
					from OneSubJob into PrintPage.
		04/21/00	Fixed testing of sfFinderPrintInfo in SetupForFinder.  Also, make
					sure we support merging before calling JobMerge.
		04/18/00	Renamed UStdPrintHandler.  Move TPrintInfo into Frameworks new
					UPrinting.h
		04/17/00	Made fPrintInfo a CRefCountingPtr_AC.  Changed Save(..) so it
					does not take a TPrintInfo as an argument.
		04/14/00	Reworked includes.  Changed kClassicQDResolution to scClassicQDResolution.
		04/11/00	NOTE: When writing print info to the data fork in SavePrintInfo
					a length is always written.  This is a change where previously
					only the handle was streamed out.
		04/11/00	Removed itsFile from the interface to GetSavePrintInfoSize.
					Use CFileStream_AC instead of TFileStream.
		04/06/00	Moved Classic, Carbon and GX printing into their own files.
					gFinderPrintInfo is now an CAutoPtr_AC.
		04/05/00	Include CHandle_AC.h.  Additional Carbon management.  Create a
					CInMacPrint in TPrintCommand::DoIt.
		04/04/00	Made many inline functions out-of-line.  Call CBeginPrintSession_AC
					everywhere a Carbon PM call is made.  Removed incorrect inline
					specifiers.  Made PrintGetGeneral, PrintSetGeneral, OpenPrintShop
					NewPrintIDLEProc, and ClosePrintShop members of TMacPrintJob.
					Initialize fPrintSettings, fPrintContext and fPageFormat in
					TMacPrintJob ctors and dispose in dtor.
		04/03/00	Removed duplicate include of PMApplication.h.  Added a bunch
					of OSStatus checking on Carbon Print Manager calls.
		03/24/00	Change assignment of gDefaultPrintInfo in CInMacPrint
					ctor.  FIX NEEDED.
		11/16/99	Clean up unused and debug-only variables in CalcPageStrips.
		10/21/99	Replace EnableItem() with EnableMenuItems_AC() to encapsulate Carbon, Mac OS 8.5,
					menu checks.
		10/14/99	Carbon: move the "a" globals into the TPrintInfo object.
		10/14/99	Move the functions that reference GetHPrint to the headers.
		10/13/99	Carbon: PMCloseDocmument replaces PrCloseDoc, put comments around globals
					so that they can be delt with later.
					Add inline functions (NewPrintIDLEProc, OpenPrintShop(),  ClosePrintShop(),
					ShowPrintDialog(), ShowSetupDialog(), SetPrintIdleProc(), and PrintGet/SetGeneral())
					that handle the one-line #if qCarbon #else
					lines.
		10/07/99	Carbon: Get compile working again (needed to include PMApplication.h).
		10/03/99	Carbon: PMPageSetUpDialog now availabled.
		09/23/99	Carbon: change #warning to #pragma message, take out PMPageSetUpDialog
		08/10/99	Removed Inherited.
		07/23/99	[C] Printing API changes in GetError, SetError, StartJob,
					FinishJob, StartPage, FinishPage.  Many other printing changes.
		03/24/99	Update copyright notice.
		03/23/99	Replace ...Rect_AC calls with standard Toolbox rect calls.
					Don't use qd globals directly.
		03/19/99	Rename GetMessage to GetExceptionMessage
					since it conflicts with a Windows define.
					[W] De-pascalize IdleProc.
		03/18/99	Removed '&' on parms to a variety of Toolbox calls.
		02/12/99	[C] NewPrIdleProc does not seem to be defined in CarbonLib.
		01/15/99	CAEDesc_AC is now in ACS.
		11/16/98	[2284708] qNeedsGXViews is no longer needed.  Minor cosmetic.
		11/05/98	Use SetCursorToArrow_AC
		10/29/98	[W] It is no longer necessary to include QTMLMapNames.h.  Use
					SetCursor_AC, SetPort_AC, FindWindow_AC, FrameRect_AC.
					Include ImagingUtils_AC.h, WindowUtils_AC.h.
		10/29/98	For Carbon, disable cPrint commands since printing isn't supported
		10/27/98	Made changes so compiles for Carbon
		10/08/98	GetPrintCommandContext.
					Copy methods from MPurgeable instead of mixing it in. Avoids
					overhead that is unnecessary because we're not dynamic casting.
					MPurgeable.
					Merge TCommandHandler into TEventHandler.
		10/07/98	Use AsText instead of casting to char*.
*/

#ifndef __UStdPrintHandler__
#include "UStdPrintHandler.h"
#endif

// MacApp

#ifndef __MacAppRequired__
#include "MacAppRequired.h"
#endif

#if qAppleEventAware
	#ifndef __UAPPLEEVENTS__
	#include "UAppleEvents.h"
	#endif

	#ifndef __USCRIPTING__
	#include "UScripting.h"
	#endif
#endif

#ifndef __UDEBUG__
#include "UDebug.h"
#endif

#ifndef __UDISPATCHER__
#include "UDispatcher.h"
#endif

#ifndef __UDOCUMENT__
#include "UDocument.h"
#endif

#ifndef __UFILE__
#include "UFile.h"
#endif

#ifndef __UMEMORY__
#include "UMemory.h"
#endif

#ifndef __UMenuCommands__
#include "UMenuCommands.h"
#endif

#ifndef __UVIEW__
#include "UView.h"
#endif

#ifndef __UWINDOW__
#include "UWindow.h"
#endif

// ACS

#ifndef __CDependencies_AC__
#include "CDependencies_AC.h"
#endif

#ifndef __CMultiLocal_AC__
#include "CMultiLocal_AC.h"
#endif

#ifndef __ResourceUtils_AC__
#include "ResourceUtils_AC.h"
#endif

// Toolbox

#if qAppleEventAware
	#ifndef __AEREGISTRY__
	#include <AERegistry.h>
	#endif
#endif

#ifndef __MENUS__
#include <Menus.h>
#endif

// ANSI

#ifndef __LIMITS__
#include <limits.h>
#endif

#ifndef __STDLIB__
#include <stdlib.h>
#endif

#ifndef __STRING__
#include <string.h>
#endif

//========================================================================================
// Hacks
//========================================================================================

#ifdef __MRC__
#define Mutable(T,v)	const_cast<T>(v)
#else
#define Mutable(T,v)	v
#endif

//========================================================================================
// Globals, static initialization
//========================================================================================

PenState			gBreaksPenState = { {0, 0},
										{2, 2},
										{patCopy},
										{ {0xCC, 0x66, 0x33, 0x99, 0xCC, 0x66, 0x33, 0x99} } };
bool				gCancelAllPrinting;

// ���  The following should be changed to use a resolution initialized from the
// default print job during construction of the default print handler.
CViewRect			gStdPageMargins(1  * TPrintInfo::scClassicQDResolution,
									1  * TPrintInfo::scClassicQDResolution,
									-1 * TPrintInfo::scClassicQDResolution,
									-1 * TPrintInfo::scClassicQDResolution);	// 1" margins std default;
TStdPrintHandler*	gJobPrintHandler;	// This does not own the print handler referenced.

TRefCntPrintInfo	TStdPrintHandler::sfFinderPrintInfo;
CFSSpec_AC						gTargetPrinter;

const short			kFirstMacPrintFormatIndex = 1;

const short			kNumPrintResources = 3;

// We need to know _all_ possible print info resource types here so that we can
// delete them when writing a new print info resource.
const ResType		kPrintResType[kNumPrintResources]
						= { kClassicInfoRsrcType, kCarbonInfoRsrcType, kGXPrintInfoRsrcType};

//========================================================================================
// CLASS TStdPrintHandler
//========================================================================================

MA_DEFINE_CLONE(TStdPrintHandler);

//----------------------------------------------------------------------------------------
// TStdPrintHandler constructor
//----------------------------------------------------------------------------------------

TStdPrintHandler::TStdPrintHandler(	TDocument*	itsDocument,
									TView*		itsView,
									bool		itsHFixedSize,
									bool		itsVFixedSize)
	:	TPrintHandler(itsView),						// sets fView to itsView
		fLastStrip(CViewPoint(SHRT_MAX, SHRT_MAX)),
		fPrintingCommand(cNoCommand),				// Will be set in DoPrintCommand
		fStartPage(1),
		fPageDirection(vSel),						// Page 2 is below page 1, etc.
		fFinderSetup(false),
		fFinderJobDialog(false),
		fMinimalMargins(false),
		fUseMaxResolution(false),
		fMarginsRect(gStdPageMargins),
		fScale(100),
		fIsValid(false)
{
	fFixedSizePages[hSel] = itsHFixedSize;
	fFixedSizePages[vSel] = itsVFixedSize;

	fDocument = itsDocument;
	try
	{
		if (fView)
		{
			SetDefaultPrintInfo();

			if (itsDocument)
				itsDocument->AttachPrintHandler(this);

			fView->AttachPrintHandler(this);

			fPrintInfo->AddDependent(this);
		}
	}
	catch(CException_AC& theException)
	{
		DoCatchMessage_AC(theException);

		// We may have failed AFTER attaching the printhandler to the view.  If we were
		// to free ourself without detaching we would leave the view with a
		// reference to a freed behavior.  So remove ourselves before freeing.  We don't
		// have to worry about detaching from the document since that will occur
		// in our free method. In the same vein, RemoveBehavior will call SetOwner
		// which will detach us from the window.
		if (fView)
			fView->RemoveBehavior(this);

		throw;
	}
}

//----------------------------------------------------------------------------------------
// TStdPrintHandle copy constructor
//----------------------------------------------------------------------------------------

TStdPrintHandler::TStdPrintHandler(const TStdPrintHandler& inStdPrintHandler)
	:	TPrintHandler(inStdPrintHandler),
		fPrintExtent(inStdPrintHandler.fPrintExtent),
		fViewedRect(inStdPrintHandler.fViewedRect),
		fViewToQDOffset(inStdPrintHandler.fViewToQDOffset),
		fPageStrips(inStdPrintHandler.fPageStrips),
		fLastStrip(inStdPrintHandler.fLastStrip),
		fLastBreak(inStdPrintHandler.fLastBreak),
		fQDRectToClipTo(inStdPrintHandler.fQDRectToClipTo),
		fQDOrigin(inStdPrintHandler.fQDOrigin),
		fPrintingCommand(inStdPrintHandler.fPrintingCommand),
		fStartPage(inStdPrintHandler.fStartPage),
		fPageDirection(inStdPrintHandler.fPageDirection),
		fFinderSetup(inStdPrintHandler.fFinderSetup),
		fFinderJobDialog(inStdPrintHandler.fFinderJobDialog),
		fMinimalMargins(inStdPrintHandler.fMinimalMargins),
		fUseMaxResolution(inStdPrintHandler.fUseMaxResolution),
		fPaperRect(inStdPrintHandler.fPaperRect),
		fInkRect(inStdPrintHandler.fInkRect),
		fMarginsRect(inStdPrintHandler.fMarginsRect),
		fInteriorRect(inStdPrintHandler.fInteriorRect),
		fScale(inStdPrintHandler.fScale),
		fIsValid(inStdPrintHandler.fIsValid)
{
	fFixedSizePages[hSel] = inStdPrintHandler.fFixedSizePages[hSel];
	fFixedSizePages[vSel] = inStdPrintHandler.fFixedSizePages[vSel];

	if (inStdPrintHandler.fPrintInfo)
		fPrintInfo = inStdPrintHandler.fPrintInfo->Clone();
}

//----------------------------------------------------------------------------------------
// TStdPrintHandler::~TStdPrintHandler:
//----------------------------------------------------------------------------------------

TStdPrintHandler::~TStdPrintHandler()
{
	if (fView != NULL)
	{
		// If you are freeing a print handler, it is up to you to detach it
		// from the view first.

		fView->DeleteAdorner(&TAdorner::fgPrintAdorner, false);
		fView = NULL;

		if (fDocument)
			fDocument->DetachPrintHandler(this);
		fDocument = NULL;
	}

	if (gJobPrintHandler == this)				// let's be safe
		gJobPrintHandler = NULL;
}

//----------------------------------------------------------------------------------------
// TStdPrintHandler::WasPrintError:
//----------------------------------------------------------------------------------------

bool TStdPrintHandler::WasPrintError(OSErr& error, bool& ranOutOfSpace) const
{
	return fPrintInfo->WasPrintError(error, ranOutOfSpace);
}

//----------------------------------------------------------------------------------------
// TStdPrintHandler::PrintSpoolFile:
//----------------------------------------------------------------------------------------

bool TStdPrintHandler::PrintSpoolFile(OSErr& err)
{
	return fPrintInfo->CallPrPicFile(err);
}

//----------------------------------------------------------------------------------------
// TStdPrintHandler::AdornPage:
//----------------------------------------------------------------------------------------

void TStdPrintHandler::AdornPage()
// AdornPage is intended to draw page adornments that are not drawn by the
// view itself, such as page numbers, headers, footers, frames around inset text,
// row and column titles for spreadsheets, and so on. TStdPrintHandler::AdornPage
// provides debugging support for printing. If gDebugPrinting is true, it prints
// the page number and draws a box around the interior of the page and another
// around the printable area of the page; otherwise, nothing is printed.
//
// Call?		Seldom.
// Override?	Seldom. Use a print adorner instead. The gPrintAdorner print adorner
//				 is installed for you when MacApp attaches a print handler to a view.
{
#if qDebug
	if (gDebugPrinting)							// Print extra stuff if debugging
	{
		const short botSlop = 8;

		CViewRect thePaperRect(GetPaperRect());
		long rPlusL = thePaperRect.right + thePaperRect.left;

		long itsBottom = GetInkRect().bottom - botSlop;

		// draw the heading
		TextFont(applFont);
		TextFace(normal);
		TextSize(12);
		FontInfo theFontInfo;
		GetFontInfo(&theFontInfo);

		CStr255_AC pgStr;
		NumToString(fFocusedPage, pgStr);
		CStr255_AC heading = "-";
		heading += pgStr;
		heading += "-";

		long itsWidth = StringWidth(heading);

		CViewRect theTextRect;
		theTextRect.left = (rPlusL - itsWidth) / 2;
		theTextRect.top = itsBottom - theFontInfo.ascent;
		theTextRect.right = theTextRect.left + itsWidth;
		theTextRect.bottom = itsBottom + theFontInfo.descent;
		MADrawString(heading, theTextRect.ToRect(), teFlushDefault);

		// Additionally frame the printable area of the page if gDebugPrinting
		PenSize(1, 1);
		::MacFrameRect(fView->ViewToQD(GetInkRect()));

		// Frame the 'interior' of the page
		PenSize(2, 2);
		::MacFrameRect(fView->ViewToQD(GetInteriorRect()));
	}
#endif
}

//----------------------------------------------------------------------------------------
// TStdPrintHandler::BreakFollowing: Called from fView->DoBreakFollowing(),
//----------------------------------------------------------------------------------------

ViewCoordinate TStdPrintHandler::BreakFollowing(VHSelect		vhs,
												ViewCoordinate	previousBreak,
												bool&			automatic) const
// BreakFollowing is intended to return the location of the page break that
// follows the specified page break and specify whether the page break was
// calculated automatically or as the result of the user�s
// specification. TStdPrintHandler::BreakFollowing only supports automatic page breaks.
//
// vhs:				hSel specifies a horizontal break; vSel specifies a vertical one.
// previousBreak: 	specifies the page break preceding the one returned by this method.
// automatic:		returns TRUE if the page break is an automatic break; or returns
// 					FALSE if it is a user-specified page break.
//
// Call?		As needed. You can call this method from your override
//				of a view�s DoBreakFollowing method.
// Override?	As needed. You can override this method to implement
//				user-specified page breaks.
{
	VHSelect orthoVHS = gOrthogonal[vhs];
	automatic = true;
	ViewCoordinate newLoc = Min_AC(previousBreak + GetViewPerPage()[orthoVHS], fPrintExtent[botRight][orthoVHS]);

#if qDebugMsg
	if (newLoc <= previousBreak)
	{
		ProgramReport_AC("No advance in BreakFollowing; vhs: %1d previousBreak: %1d newLoc: %1d view size: \n", static_cast<short>(vhs), previousBreak, newLoc, fPrintExtent[botRight][orthoVHS]);
		::ProgramBreak_AC("No advance in BreakFollowing");
	}
#endif

	return newLoc;
}

//----------------------------------------------------------------------------------------
// TStdPrintHandler::CalcPageStrips:
//----------------------------------------------------------------------------------------

CViewPoint TStdPrintHandler::CalcPageStrips() const
{
	CViewPoint pageStrips;
	// If pages are of fixed size, then simple divide the total size by the
	// page size.  Otherwise, count up the page breaks one by one.

	for (VHSelect vhs = vSel; vhs <= hSel; ++vhs)
	{
		VHSelect ortho = gOrthogonal[vhs];
		if (fFixedSizePages[ortho])
			pageStrips[vhs] = (fPrintExtent[botRight][ortho] - fPrintExtent[topLeft][ortho] + GetViewPerPage()[ortho] - 1) / GetViewPerPage()[ortho];
		else
		{
#if qDebug
			ViewCoordinate previousBreak = 0;
#endif
			long nStrips = 0;
			ViewCoordinate startLoc = fPrintExtent[topLeft][gOrthogonal[vhs]];
			ViewCoordinate endLoc = fPrintExtent[botRight][gOrthogonal[vhs]];

			ViewCoordinate loc = startLoc;
			bool automatic = true;
//			bool done = false;
			while (loc < endLoc)
			{
				if (loc != startLoc)
					++nStrips;
#if qDebug
				previousBreak = loc;
#endif
				loc = fView->DoBreakFollowing(vhs, loc, automatic);
#if qDebug
				if (loc <= previousBreak)
					::ProgramBreak_AC("thisBreak (loc) <= previousBreak");// Thanks much to Larry T. !
#endif
			}

			if (loc != startLoc)
				++nStrips;

			pageStrips[vhs] = nStrips;
		}
	}

	return pageStrips;
}

//----------------------------------------------------------------------------------------
// TStdPrintHandler::CalcViewPerPage:
//----------------------------------------------------------------------------------------

CViewPoint TStdPrintHandler::CalcViewPerPage() const
{
	return (GetPaperRect() + GetMarginsRect()).GetSize();
}

//----------------------------------------------------------------------------------------
// TStdPrintHandler::Invalidate:
//----------------------------------------------------------------------------------------

void TStdPrintHandler::Invalidate()
{
	fIsValid = false;

	// ���  Get a message assigned!!!	Changed(mPrinterChanged, this);
}

//----------------------------------------------------------------------------------------
// TStdPrintHandler::Update:
//----------------------------------------------------------------------------------------

void TStdPrintHandler::Update() const
// Update recomputes the projection model and notify views if it changed.
{
	if (!fIsValid)
	{
		fPrintInfo->Update();

		fIsValid = true;

		CPoint_AC oldDevRes(fDeviceRes);
		CViewRect oldPaper(fPaperRect);
		CViewRect oldInk(fInkRect);
		CViewRect oldMargins(fMarginsRect);
		short oldScale(fScale);

		// Store latest data from fPrintInfo into my own instance variables
		fDeviceRes = fPrintInfo->GetDeviceRes();
		fPaperRect = fPrintInfo->GetPaperRect();
		fInkRect = fPrintInfo->GetInkRect();
		fScale = fPrintInfo->GetScale();

		if (fMinimalMargins)
			Mutable(TStdPrintHandler*,this)->fMarginsRect = fInkRect - fPaperRect;
		else
			Mutable(TStdPrintHandler*,this)->fMarginsRect.Set(
				(oldMargins.left   * fDeviceRes.h) / oldDevRes.h * oldScale / fScale,
				(oldMargins.top    * fDeviceRes.v) / oldDevRes.v * oldScale / fScale,
				(oldMargins.right  * fDeviceRes.h) / oldDevRes.h * oldScale / fScale,
				(oldMargins.bottom * fDeviceRes.v) / oldDevRes.v * oldScale / fScale
			);

		// and while we are at it update fViewPerPage�
		fViewPerPage = fView->DoCalcViewPerPage();

		if (fDeviceRes != oldDevRes || fPaperRect != oldPaper || fInkRect != oldInk || fMarginsRect != oldMargins || fScale != oldScale)
		{
			// something important to our projection model changed...
			if (fDocument && fDocument->GetSharePrintInfo())
				for (TemplateIterator_AC<TView*> iter(fDocument->GetViewList()); iter; ++iter)
					(*iter).DoPrinterChanged();
			else
				fView->DoPrinterChanged();
				// didn't send msg to all views, current company included,
				// so now we need to tell must my local view
		}
	}
}

//----------------------------------------------------------------------------------------
// TStdPrintHandler::ChooseSpoolFile:
//----------------------------------------------------------------------------------------

void TStdPrintHandler::ChooseSpoolFile(CFSSpec_AC& theSpoolFile, long& pagesPerSubjob)
// ChooseSpoolFile is intended to select the filename and volume to use for
// spooling and to specify the number of pages to spool.  ChooseSpoolFile
// retrieves an empty string for the filename and 0 for the volume and specifies
// kMaxShort as the spool size.  These values cause MacApp to use the spool file
// specified in the print information record and to attempt to spool the entire
// contents of the print job.
//
// spoolFileName:	Receives the spool file�s name.
// pagesPerSubJob:	receives the number of pages in each subjob of the spooled
//					printing job.
//
// Call?		Seldom.
// Override?	As needed, if you want to specify an actual spool
//				filename and volume reference number, or if you want to specify a
//				spool size that is less than the maximum value.(Note that if
//				spooling uses all the disk space, MacApp automatically reattempts
//				 spooling with a smaller buffer.)
{
	// Default choices tell Print Manager to use its standard choice algorithm
	theSpoolFile.name[0] = 0;
	theSpoolFile.vRefNum = 0;
	theSpoolFile.parID = 0;

	// Print Shop suggests attempting to print entire document.  If it
	// runs out of space, then PerformPrinting will retry with a
	// smaller number of pages.
	pagesPerSubjob = GetDefaultSubJobSize();
}

//----------------------------------------------------------------------------------------
// TStdPrintHandler::GetPaperRect:
//----------------------------------------------------------------------------------------

CViewRect TStdPrintHandler::GetPaperRect() const
// GetPaperRect first insures that the projection model is accurately updated and then
// returns a CViewRect containing the updated paper rect.
{
	Update();

	return fPaperRect;
}

//----------------------------------------------------------------------------------------
// TStdPrintHandler::GetInkRect:
//----------------------------------------------------------------------------------------

CViewRect TStdPrintHandler::GetInkRect() const
// GetInkRect first insures that the projection model is accurately updated and then
// returns a CViewRect containing the updated ink rect.
{
	Update();

	return fInkRect;
}

//----------------------------------------------------------------------------------------
// TStdPrintHandler::GetMarginsRect:
//----------------------------------------------------------------------------------------

CViewRect TStdPrintHandler::GetMarginsRect() const
// GetMarginsRect first insures that the projection model is accurately updated and then
// returns a CViewRect containing the updated margins.
{
	Update();

	return fMarginsRect;
}

//----------------------------------------------------------------------------------------
// TStdPrintHandler::GetInteriorRect:
//----------------------------------------------------------------------------------------

CViewRect TStdPrintHandler::GetInteriorRect() const
// GetInteriorRect first insures that the projection model is accurately updated and then
// returns a CViewRect containing the interior rect.
{
	Update();

	return fInteriorRect;
}

//----------------------------------------------------------------------------------------
// TStdPrintHandler::GetViewPerPage:
//----------------------------------------------------------------------------------------

CViewPoint TStdPrintHandler::GetViewPerPage() const
// GetViewPerPage first insures that the projection model is accurately updated and then
// returns a CViewPoint containing the amount of the view which fits on the page.
{
	Update();

	return fViewPerPage;
}

#if qAppleEventAware

//----------------------------------------------------------------------------------------
// TStdPrintHandler::DoScriptCommand:
//----------------------------------------------------------------------------------------

bool TStdPrintHandler::DoScriptCommand(CommandNumber	aCommandNumber,
									   TAppleEvent*		message,
									   TAppleEvent*		reply)
{
	bool wasHandled = false;

	if (aCommandNumber == cPrint)
	{
		bool setupSuccess;
		// if user interaction is allowed, bring up the job dialog. If no UI is allowed,
		// perform a print one.
		if (MAInteractWithUser() == noErr)
			setupSuccess = PoseJobDialog();
		else
		{
			aCommandNumber = cPrintOne;
			setupSuccess = SetupPrintOne(aCommandNumber);
		}

		if (setupSuccess)
			Print(aCommandNumber);
		wasHandled = true;
	}
	else
		wasHandled = TPrintHandler::DoScriptCommand(aCommandNumber, message, reply);

	return wasHandled;
}

#endif

//----------------------------------------------------------------------------------------
// TStdPrintHandler::DoMenuCommand:
//----------------------------------------------------------------------------------------

void TStdPrintHandler::DoMenuCommand(CommandNumber aCommandNumber)
{
	if (!DoPrintCommand(aCommandNumber))
		TPrintHandler::DoMenuCommand(aCommandNumber);
}

//----------------------------------------------------------------------------------------
// TStdPrintHandler::DoPrintCommand:
//----------------------------------------------------------------------------------------

bool TStdPrintHandler::DoPrintCommand(CommandNumber aCommandNumber)
{
	bool handled = true;						// assume we handle it

	fPrintingCommand = aCommandNumber;

	switch (aCommandNumber)
	{
		case cPageSetup:
			PosePageSetupDialog(true);
			break;

		case cPrint:
			{
				TPrintCommand * aPrintCommand = TH_new TPrintCommand(aCommandNumber, this);
				aPrintCommand->SetUseAppleEvent(true);
				if (fOwner)
					fOwner->PostCommand(aPrintCommand);
				else
					gDispatcher->PostCommand(aPrintCommand);
			}
			break;

		case cPrintOne:
			{
				TPrintCommand * aPrintCommand = TH_new TPrintCommand(aCommandNumber, this);
				// aPrintCommand->fUseAppleEvent = true;		// no way to record this
				if (fOwner)
					fOwner->PostCommand(aPrintCommand);
				else
					gDispatcher->PostCommand(aPrintCommand);
			}
			break;

		case cShowBreaks:						// Toggle state of "Show Breaks"
			fShowBreaks = !fShowBreaks;
			InvalPageFeedback();				// force redraw of area the breaks did or will occupy
			break;

		case cFinderPrint:						// handle Finder printing
			if (SetupForFinder(aCommandNumber))
				gFinderPrintingProceed = Print(cFinderPrint);
			break;

		case cDragPrint:						// handle Drag printing
			if (SetupPrintOne(aCommandNumber))
				gFinderPrintingProceed = Print(cDragPrint);
			break;

		default:
			handled = false;
			break;
	}

	return handled;
}

//----------------------------------------------------------------------------------------
// TStdPrintHandler::DoSetupMenus:
//----------------------------------------------------------------------------------------

void TStdPrintHandler::DoSetupMenus()
{
	TPrintHandler::DoSetupMenus();

	DoSetupPrintMenus();
}

//----------------------------------------------------------------------------------------
// TStdPrintHandler::DoSetupPrintMenus:
//----------------------------------------------------------------------------------------

void TStdPrintHandler::DoSetupPrintMenus()
{
	if (gCouldPrint && fView && !MemSpaceIsLow())
	{
		Enable(cPageSetup, true);
		Enable(cPrint, true);
		Enable(cPrintOne, true);
		Enable(cPrintSelection, fView != NULL);
	}
	EnableCheck(cShowBreaks, true, fShowBreaks);
}

//----------------------------------------------------------------------------------------
// TStdPrintHandler::DrawPrintFeedback: Draws page breaks and page numbers
//----------------------------------------------------------------------------------------

void TStdPrintHandler::DrawPrintFeedback(const CViewRect& area)
{
#if qDebug
	fView->AssumeFocused();
#endif

	if (fShowBreaks || gDebugPrinting)
	{
		SetPrintExtent();						// Make sure print extent is accurate before starting

#if qDebug
		if (gDebugPrinting)						// Now draw Page numbers in the corners of pages, if desired
			SetPortTextStyle(CTextStyle_AC(applFont, bold, 9, gRGBBlack));
#endif

		SetPenState(&gBreaksPenState);

		for (VHSelect vhs = vSel; vhs <= hSel; ++vhs)
		{
			VHSelect orthoVHS = gOrthogonal[vhs];
			short whichBreak = 0;
#if qDebug
			ViewCoordinate previousBreak = 0;
#endif
			bool automatic = true;
			bool done = false;

			ViewCoordinate startLoc = fPrintExtent[topLeft][gOrthogonal[vhs]];
			ViewCoordinate endLoc = fPrintExtent[botRight][gOrthogonal[vhs]];
			ViewCoordinate loc = startLoc;

			while ((loc < endLoc) && !done)
			{
				if (loc != startLoc)
				{
					if (loc > area[botRight][orthoVHS])
						done = true;
					else
					{
						++whichBreak;
						if (loc > (area[topLeft][orthoVHS] - ((CPoint_AC &)gBreaksPenState.pnSize)[orthoVHS]))
							fView->DoDrawPageBreak(vhs, whichBreak, loc, automatic);
						done = false;
					}
				}

#if qDebug
				previousBreak = loc;
#endif

				loc = fView->DoBreakFollowing(vhs, loc, automatic);

#if qDebug
				if (loc <= previousBreak)
					::ProgramBreak_AC("thisBreak (loc) <= previousBreak");// Thanks much to Larry T. !
#endif

			}
		}
	}
}

//----------------------------------------------------------------------------------------
// TStdPrintHandler::DrawPageBreak:
//----------------------------------------------------------------------------------------

void TStdPrintHandler::DrawPageBreak(VHSelect		vhs,
									 long			whichBreak,
									 ViewCoordinate	loc,
									 bool			automatic)
{
	#pragma unused (automatic)
#if !qDebug
	#pragma unused (whichBreak)
#endif
	CViewPoint vPt;
	vPt[gOrthogonal[vhs]] = loc;

	// Get the origin of the view, while accounting for any translation.
	vPt[vhs] = fView->GetExtent()[topLeft][vhs];

	CPoint_AC qdStartPt = fView->ViewToQD(vPt);
	vPt[vhs] = fView->GetSize()[vhs];
	CPoint_AC qdEndPt = fView->ViewToQD(vPt);
	qdEndPt[vhs] -= ((CPoint_AC &)gBreaksPenState.pnSize)[vhs];
	// Subtract the pen size _AFTER__ converting to qd coords. Thank you L.J.!

	if (fShowBreaks)
	{
		::MoveToPt(qdStartPt);
		::LineToPt(qdEndPt);
	}

#if qDebug
	if (gDebugPrinting)
		if (vhs == hSel)
		{
			ViewCoordinate hLoc;
			CStr255_AC aString;
			FontInfo theFontInfo;
			CRect_AC theTextRect;

			for (long i = 0; i <= fPageStrips.v; ++i)
			{
				if (i)
					GetBreakCoord(vSel, i, hLoc);
				else
					hLoc = 0;

				GetFontInfo(&theFontInfo);

				NumToString(StripToPage(CViewPoint(whichBreak - 1, i)), aString);
				// top computed based on the bottom - text height
				theTextRect.Set(static_cast<short>(hLoc) + 3, qdStartPt.v - 3 - theFontInfo.ascent, static_cast<short>(hLoc) + 3 + StringWidth(aString), qdStartPt.v - 3 + theFontInfo.descent);
				MADrawString(aString, theTextRect, teFlushDefault);

				NumToString(StripToPage(CViewPoint(whichBreak, i)), aString);
				// top computed based on the bottom - text height
				theTextRect.Set(static_cast<short>(hLoc) + 3, qdEndPt.v + 10 - theFontInfo.ascent, static_cast<short>(hLoc) + 3 + StringWidth(aString), qdEndPt.v + 10 + theFontInfo.descent);
				MADrawString(aString, theTextRect, teFlushDefault);

				NumToString(StripToPage(CViewPoint(whichBreak - 1, i - 1)), aString);
				// top computed based on the bottom - text height
				theTextRect.Set(static_cast<short>(hLoc) - StringWidth(aString) - 3, qdStartPt.v - 3 - theFontInfo.ascent, static_cast<short>(hLoc) - 3, qdStartPt.v - 3 + theFontInfo.descent);
				MADrawString(aString, theTextRect, teFlushDefault);

				NumToString(StripToPage(CViewPoint(whichBreak, i - 1)), aString);
				// top computed based on the bottom - text height
				theTextRect.Set(static_cast<short>(hLoc) - StringWidth(aString) - 3, qdEndPt.v + 10 - theFontInfo.ascent, static_cast<short>(hLoc) - 3, qdEndPt.v + 10 + theFontInfo.descent);
				MADrawString(aString, theTextRect, teFlushDefault);
			}
		}
#endif
}

//----------------------------------------------------------------------------------------
// TStdPrintHandler::DrawPageInterior:
//----------------------------------------------------------------------------------------

void TStdPrintHandler::DrawPageInterior()
{
	// i.e., by default, the same code used for drawing on the screen
	fView->HandleDraw(fView->QDToView(fQDRectToClipTo));
}

//----------------------------------------------------------------------------------------
// TStdPrintHandler::Focus:
//----------------------------------------------------------------------------------------

bool TStdPrintHandler::Focus()
{
	bool returnVal = false;

	GrafPtr printingPort = fPrintInfo->GetJobPort();
	if (printingPort)
	{
		::SetPort_AC(printingPort);

		SetOrigin(fQDOrigin.h, fQDOrigin.v);
		CRect_AC clipTo = fQDRectToClipTo;
		ClipRect(clipTo);
		returnVal = true;
	}

	return returnVal;
}

//----------------------------------------------------------------------------------------
// TStdPrintHandler::FocusOnBorder:
//----------------------------------------------------------------------------------------

void TStdPrintHandler::FocusOnBorder()
{
	CViewRect rectToClipTo(GetInkRect());

	// Only works for newer LaserWriter drivers
	fQDOrigin = rectToClipTo[topLeft].ToPoint();
	SetOrigin(fQDOrigin.h, fQDOrigin.v);
	fView->InvalidateCoordinates();				// Need to update the coordinates to reflect the
	// change in the port's origin.

	fQDRectToClipTo = fView->ViewToQD(rectToClipTo);
	ClipRect(&fQDRectToClipTo);
}

//----------------------------------------------------------------------------------------
// TStdPrintHandler::FocusOnInterior:
//----------------------------------------------------------------------------------------

void TStdPrintHandler::FocusOnInterior()
{
	const short kMaxOriginFixup = 1024;

	CViewPoint theVOrigin;

	CViewRect aRect = GetInkRect();
	CViewPoint theOrigin = aRect[topLeft];
	for (VHSelect vhs = vSel; vhs <= hSel; ++vhs)
	{
		if (fView->GetSize()[vhs] > kMaxQDCoord)
			theVOrigin[vhs] = gPageOffset[vhs];
		else
		{
			theVOrigin[vhs] = 0;
			theOrigin[vhs] += gPageOffset[vhs];
		}
		aRect[topLeft][vhs] += gPageOffset[vhs];
		aRect[botRight][vhs] += gPageOffset[vhs];
	}

	if (CViewRect(-kMaxQDCoord, -kMaxQDCoord, kMaxQDCoord, kMaxQDCoord).Contains(fView->GetExtent()))
	{
		fQDOrigin = theOrigin.ToPoint();
		fViewToQDOffset = theVOrigin;
	}
	else
	{
		CPoint_AC deltaOrigin(static_cast<short>(theVOrigin.h % kMaxOriginFixup), static_cast<short>(theVOrigin.v % kMaxOriginFixup));
		fViewToQDOffset = theVOrigin - CViewPoint(deltaOrigin);
		fQDOrigin = deltaOrigin;
	}
	SetOrigin(fQDOrigin.h, fQDOrigin.v);
	fView->InvalidateCoordinates();				// Need to update the coordinates to reflect the
	// change in the port's origin.

	// Clip the page to the macroIntersection of the visible part of the view and the
	// printable area of the page.  Note that in some cases (e.g., a WYSIWYG
	// word processor which showed the complete page margin) parts of
	// the interior might lie outside theInk.  We must clip to theInk to
	// avoid slowing down PostScript printers.
	fQDRectToClipTo = fView->ViewToQD(fViewedRect & aRect);
	ClipRect(&fQDRectToClipTo);
}

//----------------------------------------------------------------------------------------
// TStdPrintHandler::GetDefaultSubJobSize:
//----------------------------------------------------------------------------------------

long TStdPrintHandler::GetDefaultSubJobSize() const
{
	return iPFMaxPgs;
	// ���  Is there any subjobbing necessary with GX, ever?
}

//----------------------------------------------------------------------------------------
// TStdPrintHandler::GetQDOrigin:
//----------------------------------------------------------------------------------------

CPoint_AC TStdPrintHandler::GetQDOrigin() const
{
	return fQDOrigin;
}

//----------------------------------------------------------------------------------------
// TStdPrintHandler::GetViewToQDOffset:
//----------------------------------------------------------------------------------------

CViewPoint TStdPrintHandler::GetViewToQDOffset() const
{
	return fViewToQDOffset;
}

//----------------------------------------------------------------------------------------
// TStdPrintHandler::GetBreakCoord:
//----------------------------------------------------------------------------------------

void TStdPrintHandler::GetBreakCoord(VHSelect			vhs,
									 long				whichBreak,
									 ViewCoordinate&	loc) const
{
	bool automatic;
	long startBreak;
	VHSelect orthoVHS;
#if qDebug
	ViewCoordinate previousBreak = 0;
#endif

	orthoVHS = gOrthogonal[vhs];
	if (fFixedSizePages[orthoVHS])
		loc = fPrintExtent[topLeft][orthoVHS] + GetViewPerPage()[orthoVHS] * whichBreak;
	else if (whichBreak == fLastStrip[vhs])
		loc = fLastBreak[vhs];
	else
	{
		if (whichBreak > fLastStrip[vhs])
		{
			startBreak = fLastStrip[vhs] + 1;
			loc = fLastBreak[vhs];
		}
		else
		{
			startBreak = 1;
			loc = fPrintExtent[topLeft][gOrthogonal[vhs]];
		}

		for (long i = startBreak; i <= whichBreak; ++i)
		{
#if qDebug
			previousBreak = loc;
#endif

			loc = fView->DoBreakFollowing(vhs, loc, automatic);

#if qDebug
			if (loc <= previousBreak)
				::ProgramBreak_AC("thisBreak (loc) <= previousBreak");
#endif

		}
	}
	loc = Min_AC(loc, fPrintExtent[botRight][orthoVHS]);

	Mutable(TStdPrintHandler*,this)->fLastStrip[vhs] = whichBreak;
	Mutable(TStdPrintHandler*,this)->fLastBreak[vhs] = loc;
}

//----------------------------------------------------------------------------------------
// TStdPrintHandler::GetDocName:
//----------------------------------------------------------------------------------------

CString_AC TStdPrintHandler::GetDocName() const
{
	CString_AC docName;

	if (fDocument)
		docName = fDocument->GetTitle();

	if (docName.empty())
	{
		TWindow * aWindow = fView->GetWindow();
		if (aWindow)
			docName = aWindow->GetTitle();
	}

#if qDebug
	if (docName.empty())
		::ProgramBreak_AC("GetDocName can't get a document or window name");
#endif

	return docName;
}

//----------------------------------------------------------------------------------------
// TStdPrintHandler::InstallMargins:
//----------------------------------------------------------------------------------------

void TStdPrintHandler::InstallMargins(const CViewRect& newMargins, bool areMinimalMargins)
// InstallMargins installs the margins specified.  If 'areMinimalMargins' is true,
// then the minimal-margins scheme is used; in this scheme, margins are always
// maintained at exactly the size necessary to have the page Interior coincide
// exactly with the printable area of the page.
//
// newMargins:			A CViewRect containing the new margins to be used.
// areMinimalMargins:	If true then use the minimal-margins scheme.
{
	if (fMarginsRect != newMargins || fMinimalMargins != areMinimalMargins)
	{
		fMinimalMargins = areMinimalMargins;

		if (fMinimalMargins)
		{
			CViewRect theInkRect = GetInkRect();
			fInteriorRect = theInkRect;
			fMarginsRect = theInkRect - GetPaperRect();
		}
		else
		{
			CViewRect theInterior = GetPaperRect() + newMargins;
			if (theInterior.Empty())
			{
#if qDebug
				if (gDebugPrinting)
					ProgramReport_AC("margins too big for paper!\n");
#endif
				CViewRect copyMargins(newMargins);
				MarginsTooBig(copyMargins);

				InstallMargins(copyMargins, areMinimalMargins);// try again
			}
			else
			{
				fMarginsRect = newMargins;
				fInteriorRect = theInterior;
			}
		}

		Invalidate();
	}
}

//----------------------------------------------------------------------------------------
// TStdPrintHandler::MarginsTooBig:
//----------------------------------------------------------------------------------------

void TStdPrintHandler::MarginsTooBig(CViewRect& margins) const
{
	// if you wanted, you could put up an alert here, or change the margins differently.
	// We'll set the margins to the minimal amount, as they would be set with minimal margins

	margins = GetInkRect() - GetPaperRect();
}

//----------------------------------------------------------------------------------------
// TStdPrintHandler::InvalPageFeedback:
//----------------------------------------------------------------------------------------

void TStdPrintHandler::InvalPageFeedback()
{
	if (ShowsOnScreen())
		fView->ForceRedraw();
}

//----------------------------------------------------------------------------------------
// TStdPrintHandler::LocatePageInterior:
//----------------------------------------------------------------------------------------

CViewPoint TStdPrintHandler::LocatePageInterior(long pageNumber) const
{
	#pragma unused (pageNumber)

	return GetPaperRect()[topLeft] + GetMarginsRect()[topLeft];
}

//----------------------------------------------------------------------------------------
// TStdPrintHandler::MaxPageNumber:
//----------------------------------------------------------------------------------------

long TStdPrintHandler::MaxPageNumber() const

{
	// respect the maximum page number supported by the printing manager
	// ���  need to call back to TPrintinfo for the max page number
	Update(); // Ensure the fPageStrips is valid!!

	return Min_AC(static_cast<long>(fStartPage + (fPageStrips.v * fPageStrips.h) - 1),
				  static_cast<long>(iPrPgMax));
}

//----------------------------------------------------------------------------------------
// TStdPrintHandler::OneSubJob:
//----------------------------------------------------------------------------------------

bool TStdPrintHandler::OneSubJob(long	subjobFirstPage,
								 long	subjobLastPage,
								 long	minFromPage,
								 long	maxToPage,
								 bool	justSpool,
								 bool	partialJob,
								 bool&	ranOutOfSpace,
								 long&	lastPageTried)
// OneSubJob processes one printing subjob.  Where appropriate, a print job is divided
// automatically into one or more 'subjobs', so that a long document can be
// printed even if there is very limited spool space available on the disk.  This
// is a generalization of the 'spool-a-page/ print-a-page' technique. TStdPrintHandler
// will use a subjob size as large as can be handled by current
// conditions, and will only fall back to more subjobs, each of smaller size, if
// it experiences problems running with a larger subjob size.
// Returns a true if it is okay to proceed to the next subjob, if any.
//
// subjobFirstPage:	A long giving the number of the first page to be printed.
// subjobLastPage:	A long giving the number of the last page to be printed.
// minFromPage:		This does not appear to be used.
// maxToPage:		This does not appear to be used.
// justSpool:		Pass true if the document is to be spooled to a file which
//					is later printed.  Normally false indicating that the file
//					is to be printed immediately.
// partialJob:		Unused.
// ranOutOfSpace:	Is set to true if there was inadequate disk space for printing
//					the document.
// lastPageTried:	Is set to the number of the last page for which printing was
//					attempted.  This gives a hint as to the number of pages which
//					should be attempted on the subsequent attempt.
{
	#pragma unused (partialJob)
	bool proceed = true;

#if qDebugMsg
	if (gDebugPrinting)
		ProgramReport_AC("OneSubJob entered for pages %1d through %1d, proceed=%s\n", subjobFirstPage, subjobLastPage, proceed ? "true" : "false");
#endif

	ranOutOfSpace = false;
	lastPageTried = subjobFirstPage - 1;

	fPrintInfo->SetPrintPages(subjobFirstPage, subjobLastPage, minFromPage, maxToPage);

	long numberOfTimesToImage = fPrintInfo->IsSpooling() ? 1 : fPrintInfo->GetPrintCopies();

	fPrintInfo->StartJob(GetDocName(), subjobLastPage - subjobFirstPage + 1);

	OSErr err;
	if (proceed)
		proceed = WasPrintError(err, ranOutOfSpace);

	if (proceed)
	{
		fView->InvalidateFocus();

		gCurrPrintHandler = this;
		TView::gPrinting = true;

		for (long pass = 1; pass <= numberOfTimesToImage; ++pass)
			for (long aPageNumber = subjobFirstPage; aPageNumber <= subjobLastPage; ++aPageNumber)
				if (proceed)
				{
					lastPageTried = aPageNumber;

					try
					{
						PrintPage(aPageNumber);
					}
					catch(CException_AC& theException)
					{
						DoCatchMessage_AC(theException);
						proceed = false;
						err = theException.GetError();		// pass along client's error code
					}

					if (proceed)
						proceed = WasPrintError(err, ranOutOfSpace);
				}

		TView::gPrinting = false;
		gCurrPrintHandler.release();
		fView->InvalidateFocus();
		fView->BeInPort(fView->GetGrafPort());
	}

	fPrintInfo->FinishJob();			// This will close the port!

	if (proceed)
		proceed = WasPrintError(err, ranOutOfSpace);

	if (!ranOutOfSpace)
	{
		if (proceed)
		{
			if (fPrintInfo->IsSpooling() && !justSpool)
				proceed = PrintSpoolFile(err);
		}
		if ((!proceed) && (err != iPrAbort))
			::ThrowException_AC(err, 0);
	}

	return proceed;
}

//----------------------------------------------------------------------------------------
// TStdPrintHandler::PageToStrip:
//----------------------------------------------------------------------------------------

CViewPoint TStdPrintHandler::PageToStrip(long pageNumber) const
// PageToStrip determines in which page strip the given page number occurs and then
// calculates the position of that page within the view, returning a CViewPoint
// with the horizontal and vertical position.
{
	CViewPoint pageStrip;

	long normalizedPageNum = pageNumber - fStartPage + 1;
	VHSelect ortho = gOrthogonal[fPageDirection];
	pageStrip[ortho] = (normalizedPageNum - 1) / fPageStrips[ortho];
	pageStrip[fPageDirection] = normalizedPageNum - ((pageStrip[ortho]) * fPageStrips[ortho]) - 1;

	return pageStrip;
}

//----------------------------------------------------------------------------------------
// TStdPrintHandler::PoseJobDialog:
//----------------------------------------------------------------------------------------

bool TStdPrintHandler::PoseJobDialog()
{
	// PrepareForDialog;
	bool proceed = fPrintInfo->CallJobDialog();

	OSErr err;
	bool b;
	if (proceed)
		proceed = WasPrintError(err, b);

	// Rectify the range as a public service if needed
	unsigned long firstPage;
	unsigned long lastPage;
	unsigned long minPage;
	unsigned long maxPage;
	fPrintInfo->GetPrintPages(firstPage, lastPage, minPage, maxPage);
	if (firstPage > lastPage)
		fPrintInfo->SetPrintPages(firstPage, lastPage, minPage, maxPage);

	gDispatcher->UpdateAllWindows();

	return proceed;
}

//----------------------------------------------------------------------------------------
// TStdPrintHandler::PosePageSetupDialog:
//----------------------------------------------------------------------------------------

// Needs to be here because it may be called from Print

bool TStdPrintHandler::PosePageSetupDialog(bool isUndoable)
{
	bool returnVal = true;					// proceed

	// Must setup command before putting up page setup dialog because the
	// command records the current print record to make it undoable.
	CAutoPtr_AC<TPrintStyleChangeCommand> aPrintStyleChangeCommand(TH_new TPrintStyleChangeCommand(this, isUndoable));

	// Put up the Page Setup Dialog
	returnVal = fPrintInfo->CallStyleDialog();

	if (returnVal)								// User specified a change
	{
		aPrintStyleChangeCommand->fNewPrintInfo->SetFrom(fPrintInfo);
		if (fView)
			fView->PostCommand(aPrintStyleChangeCommand.release());
		else
			gDispatcher->PostCommand(aPrintStyleChangeCommand.release());
	}

	return returnVal;
}

//----------------------------------------------------------------------------------------
// TStdPrintHandler::Print:
//----------------------------------------------------------------------------------------

bool TStdPrintHandler::Print(CommandNumber itsCommandNumber)
{
	// Kick off the print job and assure safe job shutdown.  Note, this may be the
	// second time the starter will have been called since it is also called
	// in TPrintCommand::DoIt.
	CPrintJobStarterStopper		jobStarterStopper(fPrintInfo);

	gCancelAllPrinting = false;

	SetPrintExtent();							// Make sure we've got the right area.

	try
	{
		bool proceedWithJob = true;
		bool justSpool = (itsCommandNumber == cPrintToFile);

		gJobPrintHandler = this;				// be visible to the idleProc

		//CViewPoint pageStrips;
		fPageStrips = fView->DoCalcPageStrips();

		unsigned long firstPage;
		unsigned long lastPage;
		unsigned long aMinPage;
		unsigned long aMaxPage;
		fPrintInfo->GetPrintPages(firstPage, lastPage, aMinPage, aMaxPage);
		if (!lastPage)
			lastPage = aMaxPage;

		firstPage = Max_AC(firstPage, static_cast<unsigned long>(fStartPage));
		lastPage = Min_AC(lastPage, static_cast<unsigned long>(MaxPageNumber()));

		if (lastPage < firstPage)
		{
			OSErr anErr;
			anErr = MAInteractWithUser();
			if (anErr == noErr)
				anErr = Alert(phNoPages, NULL);
			else if (anErr == errAENoUserInteraction)
				::ThrowIfOSErr_AC(errNoPagesToPrint);
			else
				::ThrowIfOSErr_AC(anErr);
		}
		else
		{
			long pagesPerSubjob = GetDefaultSubJobSize();
			long totalPages = lastPage - firstPage + 1;

			if (fPrintInfo->IsSpooling())
			{
				CFSSpec_AC spoolFile;
				ChooseSpoolFile(spoolFile, pagesPerSubjob);
				// if justSpool is true, then the spool filename and vRefNum will already
				// have been stuffed into the prJob record before this method is called
				if (!justSpool && spoolFile.name[0])
					fPrintInfo->SetSpoolFile(spoolFile);
			}

			long lastPrinted = firstPage - 1;
			pagesPerSubjob = Min_AC(pagesPerSubjob, totalPages);
			fPrintInfo->PosePrintDialog(GetDocName(), itsCommandNumber);

			try
			{
				do
				{
					long firstSubJobPage = lastPrinted + 1;
					bool ranOutOfSpace = false;
					long lastPageAttempted;
					proceedWithJob = OneSubJob(	firstSubJobPage,
												Min_AC(firstSubJobPage + pagesPerSubjob - 1, static_cast<long>(lastPage)),
												fStartPage,
												MaxPageNumber(),
												justSpool,
												(pagesPerSubjob < totalPages),
												ranOutOfSpace,
												lastPageAttempted);
					if (proceedWithJob)
						lastPrinted = lastPageAttempted;
					if (ranOutOfSpace)
					{
						pagesPerSubjob = lastPageAttempted - 1 - firstSubJobPage;
						proceedWithJob = true;
					}
				} while ((lastPrinted != static_cast<long>(lastPage))
						 && (pagesPerSubjob >= 1)
						 && proceedWithJob);

				if (pagesPerSubjob < 1)
					::ThrowException_AC(errSpooling, 0);
			}
			catch(CException_AC& theException)
			{
				DoCatchMessage_AC(theException);
				fPrintInfo->BanishPrintDialog();
				throw;
			}

			fPrintInfo->BanishPrintDialog();
		}
		gJobPrintHandler = NULL;
	}
	catch(CException_AC& theException)
	{
		DoCatchMessage_AC(theException);

		// Certain Print Manager errors should not result in any alert,
		// since the Print Manager will have already put one up.
		// !!! sure would be nice if there were constants for these in the headers!
		if ((theException.GetError() >= -8160) && (theException.GetError() <= -8150))
			::ThrowException_AC(0, messagePrintFailed);

		if (!theException.GetExceptionMessage())
			gErrorParm3 = GetDocName();

		::ThrowNewMessage_AC(	theException.GetError(),
								theException.GetExceptionMessage(),
								messagePrintFailed);
	}

	return !gCancelAllPrinting;
}

//----------------------------------------------------------------------------------------
// TStdPrintHandler::PrinterChanged:
//----------------------------------------------------------------------------------------

void TStdPrintHandler::PrinterChanged()
{
	fView->DoPagination();
}

//----------------------------------------------------------------------------------------
// TStdPrintHandler::PrintPage:
//----------------------------------------------------------------------------------------

void TStdPrintHandler::PrintPage(long aPageNumber)
// PrintPage prints a single page with the given page number.
//
// pageNumber:	The number of the page to print.
{
	SetPage(aPageNumber);	// Set up the print view offsets to the given page.

	try
	{
		fPrintInfo->StartPage(aPageNumber);
		::ThrowIfOSErr_AC(fPrintInfo->GetError());

		fView->BeInPort(fPrintInfo->GetJobPort());

		if (!fView->Focus())
		{
#if qDebug
			::ProgramBreak_AC("TStdPrintHandler::PrintPage: Cannot focus view while printing.");
#endif
		}

		FocusOnInterior();
		DrawPageInterior();

#if qDebug
		// Notify if the view has changed the port underneath us while printing.
		GrafPtr aPort;
		GetPort(&aPort);
		if (aPort != fPrintInfo->GetJobPort())
			::ProgramBreak_AC("TStdPrintHandler::PrintPage: The view's DrawPageInterior method changed the grafPort.");
#endif
		::ThrowIfOSErr_AC(fPrintInfo->GetError());
		FocusOnBorder();
		AdornPage();
		::ThrowIfOSErr_AC(fPrintInfo->GetError());
	}
	catch(CException_AC& theException)
	{
		DoCatchMessage_AC(theException);
		fPrintInfo->FinishPage();
		throw;
	}

	fPrintInfo->FinishPage();
}

//----------------------------------------------------------------------------------------
// TStdPrintHandler::RedoPageBreaks:
//----------------------------------------------------------------------------------------

void TStdPrintHandler::RedoPageBreaks()
// RedoPageBreaks is called by the view's DoPagination method in response to a change
// in view size or printer information.
{
	bool worryAboutBreaks = (fView->GetGrafPort()) && gInitialized && (fShowBreaks || gDebugPrinting);

	if (worryAboutBreaks)
		InvalPageFeedback();			// Invalidate old page breaks, if relevant.

	SetPrintExtent();
	CViewRect oldInterior(GetInteriorRect());
	CViewPoint oldViewPerPage(GetViewPerPage());

	SetMargins();						// Will synch with fViewPerPage automatically.

	SetPageInterior(kUsualPages);
	CViewRect newInterior = GetInteriorRect();

#if qDebug
	if (gDebugPrinting)
		if (oldInterior != newInterior)
			ProgramReport_AC("TStdPrintHandler::RedoPageBreaks: Setting new interior.");
#endif

	if (oldInterior != newInterior)
		fView->PageInteriorChanged(newInterior);

#if qDebug
	if (gDebugPrinting)
		if (oldViewPerPage != GetViewPerPage())
			ProgramReport_AC("TStdPrintHandler::RedoPageBreaks: Setting new view per page.");
#endif

	if ((oldInterior != newInterior) || (oldViewPerPage != GetViewPerPage()))
		fView->AdjustFrame();

	fPageStrips = fView->DoCalcPageStrips();

	if (worryAboutBreaks)
		InvalPageFeedback();			// Force a redraw of new page breaks, if relevant.
}

//----------------------------------------------------------------------------------------
// TStdPrintHandler::Reset:
//----------------------------------------------------------------------------------------

void TStdPrintHandler::Reset()
// Reset returns the print job's settings to the default.
{
	if (fPrintInfo)
		fPrintInfo->SetToDefault();
}

//----------------------------------------------------------------------------------------
// TStdPrintHandler::SetPrintExtent:
//----------------------------------------------------------------------------------------

void TStdPrintHandler::SetPrintExtent()
// SetPrintExtent sets our print extent to that which is indicated by our view after
// validating that the extent is not inverted in coordinate space.
{
	CViewRect printExtent(fView->GetPrintExtent());

	// Make sure the bottom or right is not smaller than the top or left.
	// This can happen when views are being created and before the window
	// has been resized to its actual size.
	printExtent.bottom = Max_AC(printExtent.bottom, printExtent.top);
	printExtent.right = Max_AC(printExtent.right, printExtent.left);
	fPrintExtent = printExtent;
}

//----------------------------------------------------------------------------------------
// TStdPrintHandler::SetDefaultPrintInfo:
//----------------------------------------------------------------------------------------

void TStdPrintHandler::SetDefaultPrintInfo()
// SetDefaultPrintInfo sets the print settings and format information to the settings
// contained in the associated document, if any, otherwise it is fetched from the default.
// This function may be called outside if a normal print loop, such as during application
// startup or view instantiation.
{
	if (!fDocument || (fDocument && !fDocument->GetSharePrintInfo()))
		fPrintInfo.reset();

	if (fView
		&& fDocument
		&& (fDocument->GetSharePrintInfo()
		&& fDocument->GetPrintInfo().get()))
			fPrintInfo = fDocument->GetPrintInfo();
	else
	{
		fPrintInfo = gDefaultPrintInfo->Clone();
		Reset();
	}

	try			// This will fail if no printer has been selected, but that's okay.
	{
		if (fUseMaxResolution)
			fPrintInfo->MaximizeResolution();
	}
	catch(CException_AC& theException)
	{
		DoCatchMessage_AC(theException);
	}

}

//----------------------------------------------------------------------------------------
// TStdPrintHandler::SetMargins:
//----------------------------------------------------------------------------------------

void TStdPrintHandler::SetMargins()
// Set margins simply installs the current margins.
{
	InstallMargins(GetMarginsRect(), fMinimalMargins);
}

//----------------------------------------------------------------------------------------
// TStdPrintHandler::SetPage:
//----------------------------------------------------------------------------------------

void TStdPrintHandler::SetPage(long aPageNumber)
// SetPage determines the page strip in which the page specified occurs and then
// calculates and sets the offset within the printing view.
{
	fFocusedPage = aPageNumber;
	CViewPoint strip(PageToStrip(aPageNumber));

	CViewRect viewedRect;
	for (VHSelect vhs = vSel; vhs <= hSel; ++vhs)
	{
		GetBreakCoord(gOrthogonal[vhs], strip[vhs], viewedRect[topLeft][vhs]);
		GetBreakCoord(gOrthogonal[vhs], strip[vhs] + 1, viewedRect[botRight][vhs]);
	}

	SetPageInterior(aPageNumber);
	fView->DoSetPageOffset(viewedRect[topLeft]);
	fViewedRect = viewedRect;

#if qDebugMsg
	if (gDebugPrinting)
		ProgramReport_AC("pg #: %1d, coord = %s Page Interior: %s\n", aPageNumber, viewedRect[topLeft].AsText().c_str(), GetInteriorRect().AsText().c_str());
#endif

}

//----------------------------------------------------------------------------------------
// TStdPrintHandler::SetPageInterior:
//----------------------------------------------------------------------------------------

void TStdPrintHandler::SetPageInterior(long pageNumber)
// SetPageInterior determines the rectangle representing the page interior
// in view coordinates and sets fInteriorRect accordingly.
//
// pageNumber:	A long containing the number of the page.
{
	CViewPoint pegPoint(LocatePageInterior(pageNumber));

	fInteriorRect.Set(pegPoint, pegPoint + GetViewPerPage());
}

//----------------------------------------------------------------------------------------
// TStdPrintHandler::SetPageOffset:
//----------------------------------------------------------------------------------------

void TStdPrintHandler::SetPageOffset(const CViewPoint& coord)
{
	gPageOffset = coord - GetInteriorRect()[topLeft];
}

//----------------------------------------------------------------------------------------
// TStdPrintHandler::SetupForFinder:
//----------------------------------------------------------------------------------------

bool TStdPrintHandler::SetupForFinder(CommandNumber aCommandNumber)
// SetupForFinder sets up the print record for finder printing. If fFinderPageSetup
// is true, then PosePageSetupDialog is called. If fFinderJobDialog is true, then
// PoseJobDialog is called. Otherwise, prJobMerge is called.
{
	#pragma unused (aCommandNumber)

	bool proceed = true;

	if (fFinderSetup)
		proceed = PosePageSetupDialog(false);

	if (proceed)
	{
		fPrintInfo->ShowDocBeingPrinted(GetDocName(), true);

		if (fFinderJobDialog || sfFinderPrintInfo.IsNULL() || !fPrintInfo->SupportsMerging())
		{
			proceed = PoseJobDialog();

			if (proceed)
			{
				// Put into sfFinderPrintInfo, in case next document needs it
				if (sfFinderPrintInfo.IsNULL())
					sfFinderPrintInfo = fPrintInfo->Clone();

				sfFinderPrintInfo->SetFrom(fPrintInfo);
			}
		}
		else
			fPrintInfo->JobMerge(sfFinderPrintInfo.get());

		fPrintInfo->ShowDocBeingPrinted(GetDocName(), false);
	}

	return proceed;
}

//----------------------------------------------------------------------------------------
// TStdPrintHandler::SetupPrintOne:
//----------------------------------------------------------------------------------------

bool TStdPrintHandler::SetupPrintOne(CommandNumber aCommandNumber)
// SetupPrintOne sets up the print record for a "print one" type of operation, one
// where the entire document or view is printed and no job dialog takes place. This
// is also used for "drag printing".  Return true if the printing should proceed.
{
	// Call PrValidate to 1) make sure the record is OK, and
	// 2) Get the LaserWriter driver to get the name of the front window.

	fPrintInfo->ClearError();
	fPrintInfo->SetPrintPages(fStartPage, MaxPageNumber(), fStartPage, MaxPageNumber());

	if (aCommandNumber == cDragPrint && gTargetPrinter.name[0])
		fPrintInfo->SetTargetPrinter(gTargetPrinter);

	return true;					// Should always be able to continue from here.
}

//----------------------------------------------------------------------------------------
// TStdPrintHandler::ShowsOnScreen:
//----------------------------------------------------------------------------------------

bool TStdPrintHandler::ShowsOnScreen() const
// ShowsOnScreen determines if the printHandler has an fView which is in an open window.
{
	return fView ? fView->IsVisible() : false;
}

//----------------------------------------------------------------------------------------
// TStdPrintHandler::StripToPage:
//----------------------------------------------------------------------------------------

long TStdPrintHandler::StripToPage(CViewPoint pageStrip) const
// StripToPage returns the page number for the given page strip.
//
// pageStrip:	A CViewPoint representing the row and column number of the page strip.
{
	VHSelect ortho = gOrthogonal[fPageDirection];

	return pageStrip[fPageDirection] * fPageStrips[ortho] + pageStrip[ortho] + fStartPage;
}

//----------------------------------------------------------------------------------------
// TStdPrintHandler::DoUpdate:
//----------------------------------------------------------------------------------------

void TStdPrintHandler::DoUpdate(ChangeID_AC				theChange,
								MDependable_AC*			changedObject,
								void*					changeData,
								CDependencySpace_AC*	dependencySpace)
{
	#pragma unused (changedObject, changeData, dependencySpace)

	switch (theChange)
	{
		case mPrintInfoChanged:
			bool wasValid = fIsValid;
			Invalidate();

			if (fShowBreaks || wasValid)		// someone probably wants to see this
				Update();

			break;
	}

}

//----------------------------------------------------------------------------------------
// TStdPrintHandler::PrepareForFinderPrinting:
//----------------------------------------------------------------------------------------

void TStdPrintHandler::PrepareForFinderPrinting(const CFSSpec_AC* targetPrinter)
// PrepareForFinderPrinting should be called to prepare for printing from the Finder.
//
// targetPrinter:	 An CFSSpec_AC* which, if non-NULL, specifies a "drag print" target.
{
	// If we have previously done a finder print we need to toss the old print information
	// or we won't ask the user for some new stuff.
	sfFinderPrintInfo.reset();

	gTargetPrinter.name[0] = 0;

	if (targetPrinter)
		gTargetPrinter = *targetPrinter;
}

//----------------------------------------------------------------------------------------
// TStdPrintHandler::DispatcherIsAvailable:
//----------------------------------------------------------------------------------------

void TStdPrintHandler::DispatcherIsAvailable()
// DispatcherIsAvailable is called by the constructor of the top-level dispatcher
// object during application statup.
{
	if (gDispatcher && !gDefaultPrintInfo.IsNULL())
		gDispatcher->AddDependent(gDefaultPrintInfo);
}

//----------------------------------------------------------------------------------------
// TStdPrintHandler::StripPrintInfoResources:
//----------------------------------------------------------------------------------------

void TStdPrintHandler::StripPrintInfoResources()
// StripPrintInfoResources deletes all print info resources of all types from the
// resource file.  This relies on the appropriate resource file being current.
{
	ACS::CTempResLoad(false);

	for (short idx = 0; idx < kNumPrintResources; ++idx)
	{
		short	numResources = Count1Resources(kPrintResType[idx]);
		Handle	printResource = NULL;

		while (numResources--)
		{
			printResource = Get1IndResource(kPrintResType[idx], 1);

			if (printResource)
			{
				RemoveResource(printResource);
				printResource = NULL;
			}
		}
	}
}

//----------------------------------------------------------------------------------------
// TStdPrintHandler::SavePrintInfo:
//----------------------------------------------------------------------------------------

void TStdPrintHandler::SavePrintInfo(TFile* itsFile, bool useRsrcFork)
// SavePrintInfo writes the print info record out to the file's resource fork if there
// is one, otherwise it is written to the data fork.   In all cases all existing print
// info are deleted.  The print info is checked to see if it is set to the
// default.  Default print info is not saved.   Non-default print info is written
// to the resource fork, if any, as a resource, as expected.  If there is not
// resource fork then the print info is written to the datafork.  A unsigned long
// length is always written to the data fork even if it is zero, such as happens
// with default print info.  Most of this work is done by the TPrintInfo.
// NOTE: There can only be one print info per document!  If you need to have more
// than one then it will be necessary to override this function.
//
// itsPrintInfo:	A pointer to the print info record to be written.
// itsFile:			A pointer to the file to which the print info record is to be written.
// useRsrcFork:		A bool which, when true, indicates that the print info is to be
//					written to the resource fork.
{
	// Do we have a resource fork available and should we try to use it?
	if (itsFile->HasRsrcFork())
	{
		if (itsFile->IsRsrcForkOpen())
		{
			CTempUseResFile_AC tempUseResFile(itsFile->GetRsrcRefNum());

			// Strip any existing printing resources regardless of type.  We are deliberately
			// not careful here to protect existing printer settings in case writing the
			// new settings fail.  If that occurs the user can set up the printer settings
			// again.  More complex error handling would be required if this becomes an
			// issue and you should make SavePrintInfo virtual and override to fix.
			StripPrintInfoResources();
		}
#if qDebug
		else if (useRsrcFork)
			::ProgramBreak_AC("TStdPrintHandler::SavePrintInfo: We want to write the print info to the resource fork but it's not open!");
#endif
	}

	// Now have the print info write itself.
	fPrintInfo->Save(itsFile, useRsrcFork);
}

//----------------------------------------------------------------------------------------
// TStdPrintHandler::RestorePrintInfo:
//----------------------------------------------------------------------------------------

TRefCntPrintInfo TStdPrintHandler::RestorePrintInfo(TFile* itsFile, bool useRsrcFork)
// RestorePrintInfo asks the current print environment (via the default print
// info) to read a print info from the document's resource (or data) fork.
{
	TRefCntPrintInfo aPrintInfo = gDefaultPrintInfo->Clone();
	aPrintInfo->Restore(itsFile, useRsrcFork);

	return aPrintInfo;
}

//========================================================================================
// CLASS TPrintCommand
//========================================================================================

//----------------------------------------------------------------------------------------
// TPrintCommand constructor
//----------------------------------------------------------------------------------------

TPrintCommand::TPrintCommand(CommandNumber		itsCommandNumber,
							 TStdPrintHandler*	itsStdPrintHandler)
	:	TCommand(itsCommandNumber, itsStdPrintHandler->GetPrintCommandContext(),
				 kCantUndo, kDoesNotCauseChange, NULL),
		fStdPrintHandler(itsStdPrintHandler)
{
	fObjectToNotify = fContext;
}

#if qAppleEventAware

//----------------------------------------------------------------------------------------
// TPrintCommand::MakeAppleEvent:
//----------------------------------------------------------------------------------------

TAppleEvent* TPrintCommand::MakeAppleEvent()
{
	CAutoPtr_AC<TAppleEvent> theEvent(TH_new TAppleEvent(kCoreEventClass, kAEPrint, gServerAddress, kAEWaitReply));

	// Send an AppleEvent for recording
	CTempDesc_AC theTargetDesc;
	if (fStdPrintHandler->fDocument)
	{
		TDocument * theDocument = fStdPrintHandler->fDocument;
		theDocument->MakeObjectSpecifier(theTargetDesc, theDocument->GetSpecifierForm());
	}
	else
	{
		::ThrowIfNonObject_AC(fStdPrintHandler->fView);
		TWindow * theWindow = fStdPrintHandler->fView->GetWindow();
		::ThrowIfNonObject_AC(theWindow);
		theWindow->MakeObjectSpecifier(theTargetDesc, theWindow->GetSpecifierForm());
	}

	theEvent->WriteParameter(keyDirectObject, theTargetDesc);

	return theEvent.release();
}

#endif

//----------------------------------------------------------------------------------------
// TPrintCommand::DoIt:
//----------------------------------------------------------------------------------------

void TPrintCommand::DoIt()
{
	bool setupSuccess = false;

	// Some environments (Carbon) insist that the print job be started prior to posing
	// the dialog and/or fetching information about the job, such as page numbers.
	CPrintJobStarterStopper		jobStarterStopper(fStdPrintHandler->GetPrintInfo());

	switch (fIdentifier)
	{
		case cPrint:
			setupSuccess = fStdPrintHandler->PoseJobDialog();
			break;

		case cPrintOne:
		case cDragPrint:
			setupSuccess = fStdPrintHandler->SetupPrintOne(fIdentifier);
			break;
	}

	if (setupSuccess)
		fStdPrintHandler->Print(fIdentifier);
}

//========================================================================================
// CLASS TPrintStyleChangeCommand
//========================================================================================

//----------------------------------------------------------------------------------------
// TPrintStyleChangeCommand constructor
//----------------------------------------------------------------------------------------

TPrintStyleChangeCommand::TPrintStyleChangeCommand(	TStdPrintHandler*	itsPrintHandler,
													bool				isUndoable)
	:	TCommand(cChangePrinterStyle, itsPrintHandler->fView ? itsPrintHandler->fView->GetContext(cChangePrinterStyle) : itsPrintHandler->fDocument->GetContext(cChangePrinterStyle), isUndoable, kCausesChange, itsPrintHandler->fDocument),
		fStdPrintHandler(itsPrintHandler)
{
	TDocument* changedDocument = itsPrintHandler->fDocument;

	fCausesChange = changedDocument && changedDocument->GetSavePrintInfo();

	TPrintInfo*		currentPrintInfo = itsPrintHandler->GetPrintInfo();
	ThrowIfNULL_AC(currentPrintInfo);

	if (isUndoable)
		fOldPrintInfo = currentPrintInfo->Clone();

	fNewPrintInfo = currentPrintInfo->Make();
}

//----------------------------------------------------------------------------------------
// TPrintStyleChangeCommand::DoIt:
//----------------------------------------------------------------------------------------

void TPrintStyleChangeCommand::DoIt()
{
	TPrintInfo*	printInfo = fStdPrintHandler->GetPrintInfo();
	ThrowIfNULL_AC(printInfo);
	printInfo->SetFrom(fNewPrintInfo);
}

//----------------------------------------------------------------------------------------
// TPrintStyleChangeCommand::UndoIt:
//----------------------------------------------------------------------------------------

void TPrintStyleChangeCommand::UndoIt()
{
	TPrintInfo*	printInfo = fStdPrintHandler->GetPrintInfo();
	ThrowIfNULL_AC(printInfo);
	printInfo->SetFrom(fOldPrintInfo);
}

//----------------------------------------------------------------------------------------
// TPrintStyleChangeCommand::SetupDependencies:
//----------------------------------------------------------------------------------------

void TPrintStyleChangeCommand::SetupDependencies()
{
	TCommand::SetupDependencies();

	if (fStdPrintHandler && fStdPrintHandler->fView && CanBeUndone())
	{
		TView*	theView = fStdPrintHandler->GetView();
		ThrowIfNULL_AC(theView);
		theView->AddDependent(this);
		TPrintInfo*	printInfo = fStdPrintHandler->GetPrintInfo();
		ThrowIfNULL_AC(printInfo);
		printInfo->AddDependent(this);
	}
}

//----------------------------------------------------------------------------------------
// TPrintStyleChangeCommand::DoUpdate:
//----------------------------------------------------------------------------------------

void TPrintStyleChangeCommand::DoUpdate(ChangeID_AC				theChange,
										MDependable_AC*			changedObject,
										void*					changeData,
										CDependencySpace_AC*	dependencySpace)
{
	TPrintInfo*	printInfo = fStdPrintHandler->GetPrintInfo();

	if ((theChange == mClosed) && (changedObject == fStdPrintHandler->fView))
		fContext->CommitLastCommand();
	else if (theChange == mPrinterChanged
			 && printInfo
			 && changedObject == printInfo)
		fCanUndo = false;
	else
		TCommand::DoUpdate(theChange, changedObject, changeData, dependencySpace);
}

//----------------------------------------------------------------------------------------
// TPrintStyleChangeCommand::TotalSize:
//----------------------------------------------------------------------------------------

Size TPrintStyleChangeCommand::TotalSize(bool justLocked) const
{
	Size totalSize = 0;

	if (fNewPrintInfo)
		totalSize += fNewPrintInfo->TotalSize(justLocked);

	if (fOldPrintInfo)
		totalSize += fOldPrintInfo->TotalSize(justLocked);

	return totalSize;
}

//----------------------------------------------------------------------------------------
// End of UPrinting.cpp

/*
	Historical Change Record:
		----- R13 -----
		07/16/97	Changed ProgramBreak_AC to ProgramReport_AC in many places
		07/14/97	Replaced AllocateObjectsFromPerm with CTempObjectAllocation.
		07/13/97	[1615633] (TTEView -Clone) Clone crashed at mouse click
		07/13/97	[1615806] (Example -Simple QuickDraw 3D View) Crashed when setting "Box Data"
		07/08/97	[1610528] (Build -CW 68K) Compile errors
		06/30/97	[1353169] fprinf(stderr, blah) to ProgramBreak_AC(blah)
		06/09/97	Use dynamic_cast_AC where we expected dynamic_cast to always work.
		05/19/97	Streams must use new CStreamRep abstraction.
		04/23/97	Remove Clone declarations from classes we don't clone.
		04/22/97	Make the global adorners static members of TAdorner
		04/14/97	Update for real xxx_cast operators.
		04/13/97	Update List and Dependency names for ACS.
		04/09/97	properly use dynamic casting for all down/side casts
		04/08/97	Update for TToolBoxEvent protected fields.
		04/08/97	Update for TAdorner/TBehavior/TEventHandler/TCommandHandler/TCommand/
							TFileBasedDocument/TSection/TEditionDocument protected fields.
		04/04/97	Update for TView/TWindow/TDispatcher/TDocument protected fields.
		04/02/97	Update for TView view coordinate tranform methods.
		03/25/97	AC_ to _AC Name change.
		03/24/97	Migrated Dependencies and Lists to ACS
		03/21/97	kMaxCoord was missing from templatized coords, changed to kMaxQDCoord.
		03/21/97	Migrated to CViewRect, CViewPoint, ViewCoordinate.
		03/13/97	Update CW11 noDebug/68K support
		03/11/97	Update exception support to latest.
		03/07/97	Massive Changes: Use Exceptions_AC, new to TH_new, use Blah_AC,
							Update Copyright, Moved Obsolete APIs into Compatibility.h, etc..
		02/19/97	Use embedded objects instead of auto_ptr based object where possible.
		02/15/97	Fleshed out copy constructor.
		02/11/97	[1615528] Replaced ';' with ',' in TStdPrintHandler::SetPage.
		01/17/97	Updated qMSWindows conditionals.
		01/13/97	Updated qWindows conditionals.
		12/18/96	Use accessors for TFile data members.
		09/30/96	Change local MAauto_ptrs to stack based object allocations where possible
		09/30/96	Fix cloning by turning clone methods into copy constructors
		09/20/96	Cosmetic
		09/19/96	Eliminate all memory leaks identified by TidyHeap.
		09/18/96	Remove the last few remaining assignments to volatile temporary vars.
		09/09/96	[1353705] (GX Printing) Margin double when page scal double
		08/28/96	Remove superview/document arguments to TView (and derived) constructors.
		08/26/96	[1353613] (GX Printing) "Edit" Menu disable problems
		08/15/96	Use constructors for all TCommand descendents
		08/13/96	Use constructors for all TBehavior descendents
		08/12/96	Use constructors for all TStream descendents
		08/10/96	Fixed -noload compiles, made more datamembers auto_ptrs, FreeIfObject->delete
		08/07/96	Goodbye TObject!
		08/01/96	T[Sorted]List now takes a void* T[Sorted]VoidList now typedefed to T[Sorted]List
		07/26/96	[1372385] Changed MDependable_AC* changedBy parameters and member to
							void* changeData.
		07/22/96	Use templates for many Iterator subclasses.
		07/18/96	Use CAutoPtr_AC based pointers for many instance variables.
		07/18/96	Scoped two try/catch blocks correctly.
		07/17/96	define template CAutoPtr_AC and use it in place of CTempObject
		07/16/96	Removed MAVolatile
		07/16/96	Replacing Failxxx with Throwxx procs
		07/16/96	Changed references to failinfos to references of CException_AC
		07/16/96	Goodbye Exception Macros (TRY, CATCH_ALL, ENDTRY)
		07/16/96	Goodbye MDestructo
		07/16/96	Now include UExceptions.h instead of UFailure.h
		07/15/96	Boolean->bool
		07/15/96	Boolean->bool for global/non-virtual functions/variables parm/results that won't affect developers
		----- R11 -----
		06/27/96	Make conditional tests implicit as in if(x) instead of if(x != 0).
		06/26/96	Changed nil back to NULL.
		06/26/96	Install release marker.  Scope many globals.  Change TRUE/FALSE/NULL.
		06/26/96	==/!=NULL to implicit tests, except in the case of assignment to or passing/returning as bool/bool.
		06/25/96	[1345531] Added missing includes for noload buids
		06/21/96	[1353097] (Building) Cannot link against with GX printing.
		06/19/96	SCpp and MrCpp can't handle declarations in the expression portion of while loops
							so we just changed them all to for loops
		06/12/96	Started the release process, removing triple-�, initials,
							inappropriate comments.
		06/09/96	Removed UStreamable to a separate file from UObject
		05/09/96	Adjust the Failure Handling macros to allow for easy switching to native exceptions.
		05/09/96	Added CopyHandle_AC: a better HandToHand replacement. And created
		 					PermCopyHandle a better PermHandToHand.
		05/08/96	Create and use CFSSpec_AC. You should search/replace in your code to switch to
		 					CFSSpec_AC.
		05/08/96	Cleanup CRGBColor_AC and add new class CTextStyle_AC
		05/07/96	Use CTempUseResFile_AC whenever feasible
		05/07/96	Use enums for parameters of CTempHandleLock_AC constructor.
		05/06/96	Combine Lockhandle and LockHandleHigh. Create CTempHandleLock_AC.
		04/30/96	Make all constructors use initialization lists if they weren't already
							doing do. Switch several more empty constructors to inlines.
		04/26/96	Made C/CViewPoint/Rect default constructors set the point/rect to a cleared value. Made
		 					clearing very fast/compact. Eliminated the now unnecessary hand clearing of C/CViewPoint/Rects.
		04/25/96	More use of CTempxxx classes instead of Failure handling where poss.
		04/24/96	Use PRE-Increment/Decrement operators whenever possible for eff.
		04/23/96	Use CTempObject/Handle/Region/Ptr, etc.
		04/23/96	Eliminated custom embedded FailInfo handling, derive from MDestructo
		04/20/96	Remove implementation of CInMacPrint::operator new
		04/18/96	Use post-increment with iterators in while loops
		04/16/96	Use "while" style iteration
		----- R10 -----
		04/06/96	Of course, after providing the correct page numbers to GX we come to find out that MacApp was providing
							relative page numbers in the sub-job to MacPrint for a reason... MacPrint won't print anything until you
							PrOpenPage/PrClosePage a the number of times that represents the first page in the range that you told it
							you were printing. Since it expects you to be stupid, you have to act stupid to satisfy it. Of course,
							we wouldn't want to open/closepage a couple hundred times to start printing in the middle of a doc, so we lie
							to MacPrint.
		04/06/96	In TMacPrintJob::SetPrintPages, set the pages corrected to the maximum number that MacPrint can handle.
							In TStdPrintHandler::OneSubJob, call SetPrintPages with the actual page range not the relative page range.
		04/04/96	in TStdPrintHandler::MaxPageNumber() make an Update() call to Ensure the fPageStrips
							is valid before using it!!
		04/04/96	Fix invalid focus when getting callbacks from filtering printing events
		03/04/96	Fix broken graphics printing with GX if fMinimalMargins is not true. The
							clipping rect that was being passed to the QD Translater was set to -32k to 32k
							which (non-intuitively) caused all the graphics to be clipped out whenever the
							origin of the drawing port moved.
		03/31/96	Fix broken printing margins with GX, fix GX clipping bug
		03/30/96	FailInfo has a default constructor so failInfo.Reset was redundant in CArrayIterator_AC constructors
		03/30/96	Condition out TFileStream dependencies in Reading/Writing TPrintInfos until
							we get TFileStream at the Framework level or even better, move UPrinting to
							the Views level
		03/29/96	Fixed broken dependencies, MacPrint printing now works perfectly again,
							GXPrinting, however clips at the second page... more to come!
		03/26/96	CStr255_AC to char* conversion now requires const
		03/23/96	TGXJob::PrintingEventOverride aware of TToolboxEvent::AddSecondaryKeyEvent
		03/22/96	Add more guards for qGXPrinting
		03/22/96	[1331566] Fixed double-free in a a MakeAppleEvent.
		03/22/96	Fix dynamic use of MacPrint while compiled for compatibility with GX.
		03/21/96	Make drag printing work again.
		03/19/96	Removed fSquareDots, it was obsolete. Removed ,
		03/18/96	Made better use of TView calls that return CRect_AC/CViewPoint/CViewRect
		03/18/96	[1318652 (more)] remove & 0xFF00 since we were shifing right by 8 already
		03/13/96	Add Basic QDGX Initialization and Termination.
		 					Removed TPrintInfo::GetPrintRotation, TPrintInfo::SetPrintRotation, TPrintInfo::fHPrintRotation,
							TMacPrint::CallGetRotn and all rotation parameters. Removed kPortrait and kLandscape
		02/21/96	GX: Added NewPrintInfo, changed TMacPrintPrintInfo->TMacPrintInfo, TMacPrintPrinter->TMacPrint.
		 								Added TGXPrintInfo, TGXPrint, gUsingGXPrinting.
		03/07/96	[1318658] (Printing) fMinimalMargins
		03/07/96	[1318652] (Printing) 2) TStdPrintHandler::Reset:
							Bug was introduced in MacApp 3.1b1 in Nov '93
		03/07/96	Subtract pensize after converting to QD coords in TStdPrintHandler::DrawPageBreak
		03/04/96	Steve made changes to fit with the new CRect_AC changes.
		02/28/96	[1158847] Unesscessary ReSignals in StdPrintHandler::Print, copyright
		01/18/96	[1313792] (Printing) InstallMargins misbehaves
		12/18/95	Include UDispatcher.
		12/07/95	Incredibly, TStdPrintHandler::ChkPrintErr only checked for -1 (the value of iPrSavPFil)
		 					But didn't check for dskFulErr. This was perhaps because the printer drivers have changed
							the values that they return over the years. This resulted in being unable to break large
							print jobs into subjobs based on the amount of disk space available for spooling. The jobs
							would just fail, yech! Also, switch to using print manager constants where applicable.
							NOTE: This still doesn't fix printing LARGE documents when "Background Printing" is enabled.
		12/08/95	Bring back MAInteractWithUser.
							Split up includes for modular MacApp.
		08/08/95	MASelectToolboxWindow.
		----- 3.3 -----
		11/13/95	[1301496] (Printing) fHPrintRotation not updated.
		11/02/95	Check interaction level in Print before posing the "no pages to print" alert.
		11/01/95	Remove call to SetScriptingPrintHandler from IStdPrintHandler.
							It is now done by TPrintHandler:: SetOwner by way of TView::
							AttachPrintHandler.
		11/01/95	Use kMacAppTimeout in calls to InteractWithUser.
		10/31/95	Brought over missing code from branch 11b1.
		10/31/95	Add TStdPrintHandler::DoScriptCommand. TPrintCommand::DoIt
							sets up the print job. cPrintOne is never recorded.
		10/31/95	Add CurResFile_AC, Fix UseResFile_AC to avoid unnecessary UseResFile calls.
		10/31/95	[xxxxxxx] Save/Restore the current resFile to ensure that the print driver is happy.
		10/25/95	[xxxxxxx] TPrintInfo::SetFrom incorrectly sets some fields false
		10/24/95	Replace calls to GetBestType with GetSpecifierForm.
		10/21/95	Use GetBestType() in calls to MakeObjectSpecifier.
		10/19/95	Use MoveToPt, LineToPt.
		10/19/95	[1290711] (Printing)  3.3b1 - TStdPrintHandler::DrawPageBreak()
		10/17/95	1290379	(Printing) MacApp Bug - PAPNoPrinter
		10/10/95	Call gDispatcher->InteractWithUser.
		 9/23/95	[1283105] Added fUseAppleEvent in DoPrintCommand for cPrint.
		----- 3.3b1 -----
		09/01/95	CInMacPrint::operator new comment out size parameter.
		09/01/95	CInMacPrint::operator new returns nil.
		09/01/95	Cosmetic
		08/22/95	Move CInMacPrint outside of outer failure handler in TStdPrintHandler::Print.
							This fixes a bug where the FailInfo imbedded in CInMacPrint doesn't get destroyed
							in the right order along with the two FailInfos in the method, ugh!
		08/08/95	Remove SyncDefaultPrintInfo, Change Validate methods to Update.
		08/08/95	Added Invalidate and Validate. Removed CheckPrinter.
							Moved fShowBreaks to TPrintHandler.
		08/08/95	Remove private depencency space. Remove propagatechanged parameters. Add Invalidate
							Methods. Removed ValidatePrintRecord
		08/04/95	Change to use a simple dependency space.
		8/03/95	Rework dependencies and updating/validation.
		  					Added support for cDragPrint. Add support to set gCouldPrint to
		  					false if a printer not found error is signalled. This should stop
		  					any attempt to use the print manager until or unless the printer is changed.
		07/26/95	Added MakeAppleEvent for recordability.
		08/02/95	ReadFrom needs to do everything IPrintInfo does.
							Include UDependencies and UStream.
		08/02/95	Add TMacPrinter. Use dependencies for printer change notification.
							Use accessors for print info.
		07/31/95	Fixes to compile with SCpp.
		07/26/95	change fLastPrinterName to gLastPrinterName of static CStr255_AC, it doesn't need to be
							in the freestore and it is shared for the whole application.
							Removed RedoIt method of TPrintStyleChangeCommand and added default
							Parameter to IPrintStyleChangeCommand for isUndoable. The command is
							created and executed in all cases now. Changed PrinterDriverHasChanged
							to HasPrinterDriverChanged.
							StripToPage now takes a CViewPoint to identify the strip.
							Created a TPrinter object and a TPrintInfo object
		06/29/95	Remove references to TApplication::GetMyAddress.
		06/12/95	Support TAppleEvent::fgIdleProc, TOSADispatcher::fgDispatcher
		05/16/95	DialogRef
		05/16/95	WindowRef, ControlRef
		04/12/95	Use #if instead of if qDebug.
		04/08/95	Use size limits from limits.h instead of MacAppTypes.
		03/17/95	MAVolatile. UpdateCoordinates.
		03/13/95	Change Free methods to destructors.
		02/22/95	1222850 MacApp should use BlockMove_AC and BlockMoveOverlap_AC everywhere
		02/13/95	make "p" (private) globals static
		02/13/95	Remove unnecessary initialization of static variables. See ARM �8.4
		02/07/95	Create missing prototypes for static functions used internally.
		01/26/95	Add recording to print command.
		11/13/94	In DoPrintIdling, use keyCodeMask as mask rather than shift.
		10/30/94	Fix to compile with PPCC.
		10/27/94	Compile with ETO 15 prerelease headers.
		09/23/94	Add support for relocation of gMacAppAppleEventIdleProc
							to UScripting.
		07/13/94	Fix computation of lastSubJobPage: max is lastPage,
							not totalPages.
		07/11/94	Remove fix <1> as harmful.
		06/27/94	Change TStdPrintHandler::Free to call DetachPrintHandler
							instead of DeleteAdorner. Fix suggested by Roger Dunn.
*/