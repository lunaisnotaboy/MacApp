//----------------------------------------------------------------------------------------
// UGridView.cpp
// Copyright � 1987-2001 by Apple Computer, Inc. All rights reserved.
//----------------------------------------------------------------------------------------

/*
	Change History
		03/01/01	Don't include Core_AC. 
		01/02/01	Update copyright.
		11/27/00	Use nil instead of NULL in call to TextBox_AC in DrawCell.
		11/13/00	Need to get C string from standard string for printing. 
					[PB] Change initialization order to match declaration. 
		11/11/00	Cosmetic.  Pragma unuseds.
		11/09/00	[PB] Change initialization order to match declaration. 
					Need to get C string from standard string for printing. 
		11/04/00	[C] Don�t include Packages.h.
		11/01/00	[PB] Include MacErrors instead of Errors.
		09/08/00	Added embedded documentation.
		09/01/00	Removed dead code.
		08/31/00	Use MStreamable_AC instead of MStreamable.  Cosmetic.
		05/23/00	[2279264] Remove false from ProgramReport_AC.
		03/24/00	[G] Work around problem compiling visibleCellsRgn in CellsToPixels.
		12/27/99	Minor cosmetic cleanup.
		12/08/99	Added tests before deleting rows or columns.
		09/29/99	UnionRgn now called MacUnionRgn.
		08/09/99	Changed MA_REGISTER_SIGNATURE to REGISTER_SIGNATURE_AC.  Added
					a Clone() function in place of the MA_DECLARE_CLONE so it
					matches the header.  Removed Inherited.
		06/29/99	Added SetNumberOfRows, default row heights and column widths,
					and accessors and mutators for them.  Added DoPostCreate to grab
					default row height and column width.
		05/25/99	Allow grid view to report a hit on edge in IdentifyPoint.
		03/29/99	Rename Patterns_AC to CPattern_AC to avoid confusion with the
					include file.
		03/26/99	Remove _AC from SetPenPatToGray.
		03/24/99	Update copyright notice.
		03/23/99	Go back to native Toolbox region and rect calls.
		03/23/99	Renamed SetPenPatToGray_AC to Patterns_AC::SetPenPatToGray.
		03/18/99	Removed '&' on parms to a variety of Toolbox calls.
		11/05/98	Carbon - use SetPenPatToGray_AC instead of PenPat(&qd.gray);
					use FrameRect_AC instead of FrameRect
		10/29/98	[W] It is no longer necessary to include QTMLMapNames.h.  Use
					UnionRgn_AC, FrameRgn_AC, InvertRgn_AC, SetPort_AC.
					Include ImagingUtils_AC.h.
		10/27/98	Carbonize - no direct access to fields of GrafPorts or QD globals
		10/07/98	Use AsText instead of casting to char*.
*/

#ifndef __UGRIDVIEW__
#include "UGridView.h"
#endif

// MacApp

#ifndef __UADORNERS__
#include "UAdorners.h"
#endif

#ifndef __UDEBUG__
#include "UDebug.h"
#endif

#if qDrag
#ifndef __UDISPATCHER__
#include "UDispatcher.h"
#endif
#endif

#if qDrag
#ifndef __UDRAGDROP__
#include "UDragDrop.h"
#endif
#endif

#ifndef __UGEOMETRY__
#include "UGeometry.h"
#endif

#ifndef __UMACAPPGLOBALS__
#include "UMacAppGlobals.h"
#endif

#ifndef __UMACAPPUTILITIES__
#include "UMacAppUtilities.h"
#endif

#ifndef __UMEMORY__
#include "UMemory.h"
#endif

#ifndef __USTREAM__
#include "UStream.h"
#endif

// ACS

#ifndef __CRegion_AC__
#include "CRegion_AC.h"
#endif

#ifndef __TextBox_AC__
#include "TextBox_AC.h"
#endif

#ifndef __ImagingUtils_AC__
#include "ImagingUtils_AC.h"
#endif

// Toolbox

#ifndef __FONTS__
#include <Fonts.h>
#endif

#ifndef __MACERRORS__
#include <MacErrors.h>
#endif

#if !qCarbon
	#ifndef __PACKAGES__
	#include <Packages.h>
	#endif
#endif

#ifndef __TOOLUTILS__
#include <ToolUtils.h>
#endif

// ANSI

#ifndef __STDLIB__
#include <stdlib.h>
#endif

//========================================================================================
// GLOBAL Procedures
//========================================================================================

//----------------------------------------------------------------------------------------
// InitUGridView:
//----------------------------------------------------------------------------------------

void InitUGridView()
{
	if (!gUGridViewInitialized)
	{
		if(qTemplateViews)
		{
			REGISTER_SIGNATURE_AC(TGridView, kStdGridView);
			REGISTER_SIGNATURE_AC(TTextGridView, kStdTextGridView);
			REGISTER_SIGNATURE_AC(TTextListView, kStdTextListView);
		}

		gUGridViewInitialized = true;
	}
}

//========================================================================================
// CLASS TRunArray
//========================================================================================

//----------------------------------------------------------------------------------------
// TRunArray Clone()
//----------------------------------------------------------------------------------------

MA_DEFINE_CLASS(TRunArray);

//----------------------------------------------------------------------------------------
// TRunArray constructor
//----------------------------------------------------------------------------------------

TRunArray::TRunArray(ArrayIndex_AC initialSize)
	:	TemplateArray_AC<RunArrayChunk>(initialSize),
		fTotal(0),
		fLastTotal(0),
		fLastItem(0),
		fLastChunk(0),
		fLastIndex(1),
		fNoOfItems(0)
{
}

//----------------------------------------------------------------------------------------
// TRunArray::~TRunArray:
//----------------------------------------------------------------------------------------

TRunArray::~TRunArray()
{
}

//----------------------------------------------------------------------------------------
// TRunArray::DeleteItems:
//----------------------------------------------------------------------------------------

void TRunArray::DeleteItems(ArrayIndex_AC firstItem, ArrayIndex_AC noOfItems)
{
	ArrayIndex_AC num;
	long theTotal;
	ArrayIndex_AC index;

	if (!FindChunk(firstItem, num, index, theTotal))
	{
#if qDebug
		CStr255_AC theString;
		ConcatNumber("Unable to find chunk for item ", firstItem, theString);
#endif
	}
	else
	{
		for (GridCoordinate i = 1; i <= noOfItems; ++i)
		{
			fTotal -= ChunkAt(num).value;

			--ChunkAt(num).count;

			if (ChunkAt(num).count < index)
			{
				index = 1;
				if (ChunkAt(num).count)
					++num;
				else
				{
					// need to delete that chunk
					DeleteElementsAt(num + 1, 1); // TDynamicArrays are one based (except for [] operator)

					// Thanks JDR 10/28/89
					// see if we can consolidate chunks
					if ((num > 0) && (num < GetSize()) && (ChunkAt(num - 1).value == ChunkAt(num).value))
					{
						index = ChunkAt(num - 1).count + 1;
						ChunkAt(num - 1).count += ChunkAt(num).count;
						// need to delete that chunk
						DeleteElementsAt(num + 1, 1); // TDynamicArrays are one based (except for [] operator)
						--num;
					}
				}
			}
		}

		fNoOfItems -= noOfItems;

		// reset the cache
		fLastItem = 0;
		fLastChunk = 0;
		fLastTotal = 0;
		fLastIndex = 1;
	}
}

//----------------------------------------------------------------------------------------
// TRunArray::FindChunk:
//----------------------------------------------------------------------------------------

bool TRunArray::FindChunk(ArrayIndex_AC		inItem,
						  ArrayIndex_AC&	outChunk,
						  ArrayIndex_AC&	outIndexInChunk,
						  long&				outTheTotal) const
{
	bool result = false;
	if (!GetSize() || (inItem > fNoOfItems) || (inItem <= 0))
	{
		outChunk = 0;
		outTheTotal = 0;
		outIndexInChunk = 0;
		inItem = 0;
	}
	else if (inItem == fLastItem)
	{
		// check for the very easy case
		outChunk = fLastChunk;
		outTheTotal = fLastTotal;
		outIndexInChunk = fLastIndex;

		result = true;
	}
	else
	{
		ArrayIndex_AC thisItem = 0;
		ArrayIndex_AC count;

		ArrayIndex_AC delta = abs(inItem - fLastItem);

		ArrayIndex_AC currChunk = 0;
		long currTotal = 0;

		if ((delta >= inItem) || (inItem <= ChunkAt(0).count))
			; // start from the first chunk
		else if (delta > (fNoOfItems - inItem + 1))
		{
			// start from the end chunk
			currChunk = GetSize() - 1;
			count = ChunkAt(currChunk).count;
			currTotal = GetTotal() - (count * ChunkAt(currChunk).value);
			thisItem = fNoOfItems - count;
		}
		else
		{										// start from the previous values
			currChunk = fLastChunk;
			currTotal = fLastTotal;
			thisItem = fLastItem - fLastIndex;
		}

		if (inItem > thisItem)
		{
			while ((thisItem + ChunkAt(currChunk).count) < inItem)
			{
				count = ChunkAt(currChunk).count;
				currTotal += count * ChunkAt(currChunk).value;
				thisItem += count;
				++currChunk;
			}
		}
		else
		{
			do
			{
				--currChunk;
				count = ChunkAt(currChunk).count;
				currTotal -= count * ChunkAt(currChunk).value;
				thisItem -= count;
			} while (thisItem >= inItem);
		}

		outChunk = currChunk;
		outIndexInChunk = inItem - thisItem;
		outTheTotal = currTotal;

		result = true;
	}

	// cache the last values
	TRunArray* nonConst = const_cast<TRunArray*>(this);
	nonConst->fLastItem = inItem;
	nonConst->fLastChunk = outChunk;
	nonConst->fLastTotal = outTheTotal;
	nonConst->fLastIndex = outIndexInChunk;

	return result;
}

//----------------------------------------------------------------------------------------
// TRunArray::FindItem:
//----------------------------------------------------------------------------------------

ArrayIndex_AC TRunArray::FindItem(long theTotal) const
{
	ArrayIndex_AC result = 0;

	if ((theTotal >= 0) && (theTotal <= GetTotal()) && GetSize())
		if (GetSize() == 1)
		{
			if (ChunkAt(0).value > 0)
				result = Min_AC((theTotal / ChunkAt(0).value) + 1, fNoOfItems);
		}
		else if (!theTotal)
			result = 1;
		else
		{
			++theTotal;
			long runningCount = 0;
			for (long i = 0; i < GetSize(); ++i)
			{
				RunArrayChunk chunk = ChunkAt(i);

				theTotal -= chunk.value * chunk.count;
				runningCount += chunk.count;
				if (theTotal <= 0)
				{
					result = runningCount + (theTotal / chunk.value);
					break;
				}
			}
			if (!result)
				result = fNoOfItems;
		}

	return result;
}

//----------------------------------------------------------------------------------------
// TRunArray::GetValue:
//----------------------------------------------------------------------------------------

long TRunArray::GetValue(ArrayIndex_AC item) const
{
	ArrayIndex_AC num;
	long theTotal;
	ArrayIndex_AC index;

	return GetSize() == 1 ? ChunkAt(0).value : ((FindChunk(item, num, index, theTotal)) ? ChunkAt(num).value : 0);
}

//----------------------------------------------------------------------------------------
// TRunArray::InsertItems:
//----------------------------------------------------------------------------------------

void TRunArray::InsertItems(ArrayIndex_AC firstItem, ArrayIndex_AC noOfItems, long value)
{
	ArrayIndex_AC num;
	long theTotal;
	ArrayIndex_AC index;

	// Check if we can just increment the last size count
	if ((firstItem > fNoOfItems) && GetSize() && (ChunkAt(GetSize() - 1).value == value))
		ChunkAt(GetSize() - 1).count += noOfItems;

	// check if we can increment any size count
	else if (FindChunk(firstItem, num, index, theTotal) && (ChunkAt(num).value == value))
		ChunkAt(num).count += noOfItems;

	// check if this would actually fit as the last item in the previous chunk
	// Thanks Martin Frick�, 10/31/89
	else if ((num > 0) && (index == 1) && (ChunkAt(num - 1).value == value))
		ChunkAt(num - 1).count += noOfItems;

	// We need to create a new chunk, possibly two
	else
	{
		struct TempChunksStruct		// Windows wants this to be named.
		{
			RunArrayChunk chunk1;
			RunArrayChunk chunk2;
		} tempChunks;

		tempChunks.chunk1.value = value;
		tempChunks.chunk1.count = noOfItems;

		if ((index <= 1) || (firstItem > fNoOfItems))
		{
			// need to add one chunk
			if (firstItem > fNoOfItems)
				num = GetSize();				// add a row on the end

			InsertElementsBefore(num + 1, &tempChunks, 1); // TDynamicArrays are one based (except for [] operator)
		}
		else
		{
			// need to add two
			tempChunks.chunk2.count = ChunkAt(num).count - index + 1;
			tempChunks.chunk2.value = ChunkAt(num).value;
			ChunkAt(num).count = index - 1;

			InsertElementsBefore(num + 1 + 1, &tempChunks, 2); // TDynamicArrays are one based (except for [] operator)
		}
	}

	// reset the cache
	fLastItem = 0;
	fLastChunk = 0;
	fLastTotal = 0;
	fLastIndex = 1;

	fNoOfItems += noOfItems;
	fTotal += noOfItems * value;
}

//----------------------------------------------------------------------------------------
// TRunArray::SumValues:
//----------------------------------------------------------------------------------------

long TRunArray::SumValues(ArrayIndex_AC firstItem, ArrayIndex_AC noOfItems) const
{
	long result = 0;

	ArrayIndex_AC chunk;
	ArrayIndex_AC indexInChunk;
	long total;

	if (GetSize() == 1)
		result = noOfItems * ChunkAt(0).value;
	else if (firstItem == 1)
	{
		if (FindChunk(noOfItems, chunk, indexInChunk, total))
			result = total + (indexInChunk * ChunkAt(chunk).value);
	}
	else if (FindChunk(firstItem, chunk, indexInChunk, total))
	{
		long precedingTotal = total + ((indexInChunk - 1) * ChunkAt(chunk).value);
		if (FindChunk(firstItem + noOfItems - 1, chunk, indexInChunk, total))
			result = total + (indexInChunk * (ChunkAt(chunk).value) - precedingTotal);
	}

	return result;
}

//========================================================================================
// CLASS TGridViewDesignator
//========================================================================================

MA_DEFINE_CLASS(TGridViewDesignator);

//----------------------------------------------------------------------------------------
// TGridViewDesignator constructor
//----------------------------------------------------------------------------------------

TGridViewDesignator::TGridViewDesignator()
	:	fSelection(0, sizeof(GridRect))
{
}

//----------------------------------------------------------------------------------------
// TGridViewDesignator copy constructor
//----------------------------------------------------------------------------------------

TGridViewDesignator::TGridViewDesignator(const GridRect& fromRect)
	:	fSelection(0, sizeof(GridRect))
{
	Set(fromRect);
}

//----------------------------------------------------------------------------------------
// TGridViewDesignator copy constructor
//----------------------------------------------------------------------------------------

TGridViewDesignator::TGridViewDesignator(const TGridViewDesignator& inGridViewDesignator)
	:	TDesignator(inGridViewDesignator),
		fSelection(0, sizeof(GridRect))
{
	Set(&inGridViewDesignator);
}

//----------------------------------------------------------------------------------------
// TGridViewDesignator destructor
//----------------------------------------------------------------------------------------

TGridViewDesignator::~TGridViewDesignator()
{
}

//----------------------------------------------------------------------------------------
// TGridViewDesignator Set
//----------------------------------------------------------------------------------------

void TGridViewDesignator::Set()
{
	fSelection.DeleteAll();
}

//----------------------------------------------------------------------------------------
// TGridViewDesignator Set
//----------------------------------------------------------------------------------------

void TGridViewDesignator::Set(const TGridViewDesignator* fromSelection)
{
	// empty the list
	Set();

	fSelection.Merge(&fromSelection->fSelection);
}

//----------------------------------------------------------------------------------------
// TGridViewDesignator Set
//----------------------------------------------------------------------------------------

void TGridViewDesignator::Set(const GridRect& fromRect)
{
	// empty the list
	Set();

	// save the one rectangle
	fSelection.InsertElementsBefore(1, &fromRect, 1);
}

//----------------------------------------------------------------------------------------
// TGridViewDesignator Contains
//----------------------------------------------------------------------------------------

bool TGridViewDesignator::Contains(const GridCell& itsPoint) const
{
	bool result = false;

	for (TemplateArrayIterator_AC<GridRect>iter(&fSelection); iter; ++iter)
		if ((*iter).Contains(itsPoint))
		{
			result = true;
			break;
		}

	return result;
}

//----------------------------------------------------------------------------------------
// TGridViewDesignator IsContained
//----------------------------------------------------------------------------------------

ContainmentType TGridViewDesignator::IsContained(TDesignator* aDesignator)
{
	ContainmentType returnVal = kNotContained;

#if qDebug
	if (aDesignator && !dynamic_cast_AC(TGridViewDesignator*,aDesignator))
		::ProgramBreak_AC("The containing designator for the TGridViewDesignator is not of the same class");
#endif

	if (aDesignator && !this->IsEmpty())
	{
		TGridViewDesignator* gvDesignator = dynamic_cast_AC(TGridViewDesignator*,aDesignator);
		ThrowIfNULL_AC(gvDesignator);

		long count = 0;

		for (TemplateArrayIterator_AC<GridRect>iter(&fSelection); iter; ++iter)
			if (gvDesignator->Contains((*iter)[topLeft]))
				++count;

		if (count == GetSize())
			returnVal = kFullyContained;
		else if (count != 0)
			returnVal = kPartiallyContained;
	}

	return returnVal;
}

//----------------------------------------------------------------------------------------
// TGridViewDesignator GetBounds
//----------------------------------------------------------------------------------------

GridRect TGridViewDesignator::GetBounds() const
{
	GridRect result;

	if (!const_cast<TGridViewDesignator*>(this)->IsEmpty())
	{
		result = *static_cast<GridRect*>(fSelection.ComputeAddress(1));

		for (TemplateArrayIterator_AC<GridRect>iter(&fSelection); iter; ++iter)
		{
			result.left = Min_AC(result.left, (*iter).left);
			result.top = Min_AC(result.top, (*iter).top);
			result.right = Max_AC(result.right, (*iter).right);
			result.bottom = Max_AC(result.bottom, (*iter).bottom);
		}
	}

	return result;
}

//----------------------------------------------------------------------------------------
// TGridViewDesignator Append
//----------------------------------------------------------------------------------------

void TGridViewDesignator::Append(const TGridViewDesignator* fromSelection)
{
	fSelection.Merge(&fromSelection->fSelection);

	Reduce();
}

//----------------------------------------------------------------------------------------
// TGridViewDesignator Intersect
//----------------------------------------------------------------------------------------

void TGridViewDesignator::Intersect(const TGridViewDesignator* fromSelection)
{
	CDynamicArray_AC result(0, sizeof(GridRect));

	for (TemplateArrayIterator_AC<GridRect>iter(&fSelection); iter; ++iter)
		for (TemplateArrayIterator_AC<GridRect>iter2(&fromSelection->fSelection); iter2; ++iter2)
		{
			GridRect interSectRect((*iter) & (*iter2));

			if (!interSectRect.IsEmpty())
				result.InsertElementsBefore(result.GetSize() + 1, &interSectRect, 1);
		}

	// empty the list
	Set();

	fSelection.Merge(&result);

	Reduce();
}

//----------------------------------------------------------------------------------------
// TGridViewDesignator Remove
//----------------------------------------------------------------------------------------

void TGridViewDesignator::Remove(const TGridViewDesignator* fromSelection)
{
	for (TemplateArrayIterator_AC<GridRect>iter(&fSelection); iter; ++iter)
	{
		GridRect myRect(*iter);

		for (TemplateArrayIterator_AC<GridRect>iter2(&fromSelection->fSelection); iter2; ++iter2)
		{
			GridRect interSectRect(myRect & (*iter2));

			if (!interSectRect.IsEmpty())
			{
				// output up to 4 rectangles as the result and remove the original
				GridRect outputList[4] = {// constructors follow
				GridRect(myRect.left, myRect.top, myRect.right, interSectRect.top),						//top
				GridRect(myRect.left, interSectRect.top, interSectRect.left, interSectRect.bottom),		//left
				GridRect(interSectRect.right, interSectRect.top, myRect.right, interSectRect.bottom),	// right
				GridRect(myRect.left, interSectRect.bottom, myRect.right, myRect.bottom) };				//bottom

				for (int x = 0; x < 4; ++x)
					if (!outputList[x].IsEmpty())
					{
						fSelection.InsertElementsBefore(fSelection.GetSize() + 1, &outputList[x], 1);
						++iter.fHighBound;	// extend the iteration
					}

				fSelection.DeleteElementsAt(iter.CurrentIndex(), 1);

				break;
			}
		}
	}

	Reduce();
}

//----------------------------------------------------------------------------------------
// TGridViewDesignator GetSize
//----------------------------------------------------------------------------------------

Size TGridViewDesignator::GetSize() const
{
	return fSelection.GetSize();
}

//----------------------------------------------------------------------------------------
// TGridViewDesignator IsEmpty
//----------------------------------------------------------------------------------------

bool TGridViewDesignator::IsEmpty() const
{
	return fSelection.GetSize() == 0;
}

//----------------------------------------------------------------------------------------
// TGridViewDesignator ReadFrom
//----------------------------------------------------------------------------------------

void TGridViewDesignator::ReadFrom(CStream_AC* aStream)
{
	MStreamable_AC::ReadFrom(aStream);

	fSelection.ReadFrom(aStream);

	ArrayIndex_AC selectionSize = aStream->ReadLong();

	fSelection.SetArraySize(selectionSize);

	fSelection.InsertElementsBefore(1, fSelection[0],selectionSize);
	// this yucky line is because dynamic arrays don't stream themselves
	// AND we can't set the current fSize of the array.

	aStream->ReadBytes(fSelection[0], selectionSize * fSelection.GetElementSize());
}

//----------------------------------------------------------------------------------------
// TGridViewDesignator WriteTo
//----------------------------------------------------------------------------------------

void TGridViewDesignator::WriteTo(CStream_AC* aStream) const
{
	MStreamable_AC::WriteTo(aStream);

	fSelection.WriteTo(aStream);

	aStream->WriteLong(fSelection.GetSize());
	aStream->WriteBytes(fSelection[0], fSelection.GetSize() * fSelection.GetElementSize());
}

//----------------------------------------------------------------------------------------
// TGridViewDesignator Reduce
//----------------------------------------------------------------------------------------

void TGridViewDesignator::Reduce()
{
	// ���  Need to reduce resulting list, eliminate overlaps, delete duplicates and coalesce
}

//========================================================================================
// CLASS TGridView
//========================================================================================

MA_DEFINE_CLASS(TGridView);

//----------------------------------------------------------------------------------------
// TGridView constructor
//----------------------------------------------------------------------------------------

TGridView::TGridView()
	:	TView(),
		fNumOfRows(0),
		fNumOfCols(0),
		fRowInset(0),
		fColInset(0),
		fDefaultRowHeight(20),
		fDefaultColWidth(20),
		fAdornRows(false),
		fAdornCols(false),
		fSingleSelection(false),
		fDrawRowsForward(true),
		fDrawColsForward(true),
		fDrawRowMajor(true)
{
#if qDebug
	if (!gUGridViewInitialized)
	{
		::ProgramBreak_AC("InitUGridView must be called before creating a grid view.");
		::ThrowException_AC(noErr, 0);
	}
#endif
}

//----------------------------------------------------------------------------------------
// TGridView constructor
//----------------------------------------------------------------------------------------

TGridView::TGridView(const CViewPoint&	itsLocation,
					 const CViewPoint&	itsSize,
					 SizeDeterminer		itsHSizeDet,
					 SizeDeterminer		itsVSizeDet,
					 GridCoordinate		numOfRows,
					 GridCoordinate		numOfCols,
					 ViewCoordinate		rowHeight,
					 ViewCoordinate		colWidth,
					 bool				adornRows,
					 bool				adornCols,
					 ViewCoordinate		rowInset,
					 ViewCoordinate		colInset,
					 bool				singleSelection)
	:	TView(itsLocation, itsSize, itsHSizeDet, itsVSizeDet),
		fNumOfRows(0),	// will be set by InsRowFirst
		fNumOfCols(0),	// will be set by InsColFirst
		fRowInset(rowInset),
		fColInset(colInset),
		fDefaultRowHeight(rowHeight),
		fDefaultColWidth(colWidth),
		fAdornRows(adornRows),
		fAdornCols(adornCols),
		fSingleSelection(singleSelection),
		fDrawRowsForward(true),
		fDrawColsForward(true),
		fDrawRowMajor(true)
{
#if qDebug
	if (!gUGridViewInitialized)
	{
		::ProgramBreak_AC("InitUGridView must be called before creating a grid view.");
		::ThrowException_AC(noErr, 0);
	}
#endif

	// Make sure the insets are evenly divided between top/bottom or left/right
	if (::Odd_AC(rowInset))
		++fRowInset;

	if (::Odd_AC(colInset))
		++fColInset;

	if (numOfCols > 0)
		InsColFirst(numOfCols, colWidth);
	if (numOfRows > 0)
		InsRowFirst(numOfRows, rowHeight);
}

//----------------------------------------------------------------------------------------
// TGridView copy constructor
//----------------------------------------------------------------------------------------

TGridView::TGridView(const TGridView& inGridView)
	:	TView(inGridView),
		fColWidths(inGridView.fColWidths),
		fRowHeights(inGridView.fRowHeights),
		fSelections(inGridView.fSelections),
		fHLRegion(inGridView.fHLRegion),
		fNumOfRows(0),
		fNumOfCols(0),
		fRowInset(inGridView.fRowInset),
		fColInset(inGridView.fColInset),
		fDefaultRowHeight(inGridView.fDefaultRowHeight),
		fDefaultColWidth(inGridView.fDefaultColWidth),
		fAdornRows(inGridView.fAdornRows),
		fAdornCols(inGridView.fAdornCols),
		fSingleSelection(inGridView.fSingleSelection),
		fDrawRowsForward(inGridView.fDrawRowsForward),
		fDrawColsForward(inGridView.fDrawColsForward),
		fDrawRowMajor(inGridView.fDrawRowMajor)
{
	if (inGridView.fNumOfCols > 0)
		InsColFirst(inGridView.fNumOfCols, inGridView.GetColWidth(1));
	if (inGridView.fNumOfRows > 0)
		InsRowFirst(inGridView.fNumOfRows, inGridView.GetRowHeight(1));
}

//----------------------------------------------------------------------------------------
// TGridView::Free:
//----------------------------------------------------------------------------------------

TGridView::~TGridView()
{
}

//----------------------------------------------------------------------------------------
// TGridView::GetStandardSignature:
//----------------------------------------------------------------------------------------

IDType TGridView::GetStandardSignature() const
{
	return kStdGridView;
}

//----------------------------------------------------------------------------------------
// TGridView::ReadFields:
//----------------------------------------------------------------------------------------

void TGridView::ReadFields(CStream_AC* aStream)
{
#if qDebug
	if (!gUGridViewInitialized)
	{
		::ProgramBreak_AC("InitUGridView must be called before creating a grid view.");
		::ThrowException_AC(noErr, 0);
	}
#endif

	TView::ReadFields(aStream);

	GridCoordinate numOfRows = aStream->ReadInteger();
	GridCoordinate numOfCols = aStream->ReadInteger();

	ViewCoordinate rowHeight = aStream->ReadInteger();
	ViewCoordinate colWidth = aStream->ReadInteger();

	fRowInset = aStream->ReadInteger();
	fColInset = aStream->ReadInteger();

	fAdornRows = aStream->ReadBoolean();
	fAdornCols = aStream->ReadBoolean();

	fSingleSelection = aStream->ReadBoolean();

	if (::Odd_AC(fRowInset))
		++fRowInset;

	if (::Odd_AC(fColInset))
		++fColInset;

	if (numOfCols > 0)
		InsColFirst(numOfCols, colWidth);
	if (numOfRows > 0)
		InsRowFirst(numOfRows, rowHeight);
}

//----------------------------------------------------------------------------------------
// TGridView::WriteFields:
//----------------------------------------------------------------------------------------

void TGridView::WriteFields(CStream_AC* aStream) const
{
	ViewCoordinate rowHeight = 0,
	colWidth = 0;

	TView::WriteFields(aStream);

	if (fNumOfRows > 0)
		rowHeight = GetRowHeight(1);

	if (fNumOfCols > 0)
		colWidth = GetColWidth(1);

	aStream->WriteInteger(fNumOfRows);
	aStream->WriteInteger(fNumOfCols);
	aStream->WriteInteger(rowHeight);
	aStream->WriteInteger(colWidth);
	aStream->WriteInteger(fRowInset);
	aStream->WriteInteger(fColInset);
	aStream->WriteBoolean(fAdornRows);
	aStream->WriteBoolean(fAdornCols);
	aStream->WriteBoolean(fSingleSelection);
}

//----------------------------------------------------------------------------------------
// TGridView::AdornCol:
//----------------------------------------------------------------------------------------

void TGridView::AdornCol(GridCoordinate aCol, const CViewRect& area)
// AdornCol adorns the specified column by drawing single-pixel-wide black
// lines between the columns and, if necessary, in front of column 1.
//
// aCol:	Is the index of the first column to be adorned(the leftmost column
// 			in a TGridView object is numbered 1).
// area:	Is the rectangle occupied by the columns in the TGridView object�s
// 			local coordinates.
//
// Call?		Seldom. When the fAdornCols field is true(typically
//				set at initialization), MacApp calls this method to draw the column
// 				adornment when it draws a TGridView object.
// Override?	As needed, to change the appearance of the column
//				adornment.
{
	PenNormal();
	CRect_AC qdRect(ViewToQD(area));

	::MoveTo(qdRect.right, qdRect.top);
	::Line(0, qdRect.GetLength(vSel));
	if (aCol == 1)
	{
		::MoveToPt(qdRect[topLeft]);
		::Line(0, qdRect.GetLength(vSel));
	}
}

//----------------------------------------------------------------------------------------
// TGridView::AdornRow:
//----------------------------------------------------------------------------------------

void TGridView::AdornRow(GridCoordinate aRow,  const CViewRect& area)
// AdornRow adorns the rows by drawing single-pixel-wide black lines between
// the rows and above row 1.
//
// Call?		Seldom. When the fAdornRows field is true (typically set at initialization),
// 				MacApp calls this method to draw the row adornment when it draws a TGridView
// 				object.
// Override?	As needed, to change the appearance of the row adornment.
{
	PenNormal();
	CRect_AC qdRect(ViewToQD(area));

	::MoveTo(qdRect.left, qdRect.bottom);
	::Line(qdRect.GetLength(hSel), 0);
	if (aRow == 1)
	{
		::MoveToPt(qdRect[topLeft]);
		::Line(qdRect.GetLength(hSel), 0);
	}
}

//----------------------------------------------------------------------------------------
// TGridView::CalcMinFrame:
//----------------------------------------------------------------------------------------

CViewRect TGridView::CalcMinFrame()
{
	CViewRect minFrame(TView::CalcMinFrame());

	// Set the amount of room needed for that many items
	minFrame[botRight] = minFrame[topLeft] + CViewPoint(fColWidths.GetTotal(), fRowHeights.GetTotal());

	return minFrame;
}

//----------------------------------------------------------------------------------------
// TGridView::CanSelectCell:
//----------------------------------------------------------------------------------------

bool TGridView::CanSelectCell(const GridCell& aCell)
// CanSelectCell returns true if the specified cell can be selected. The default
// version of this method performs a range check on a cell and returns true if the cell
// falls within the grid�s boundaries.
// For example, MacApp calls this method from TRCSelectCommand::ComputeNewSelection
// to test if the cell can be selected before computing the selection based on that cell.
//
// aCell:	Specifies the cell to test.
//
// Call?		As needed.
// Override?	As needed. You can override this method to determine whether a
//				particular cell can be selected according to conditions that you define.
{
	return aCell.h >= 1 && aCell.v >= 1 && aCell.h <= fNumOfCols && aCell.v <= fNumOfRows;
}

//----------------------------------------------------------------------------------------
// TGridView::CellToVRect:
//----------------------------------------------------------------------------------------

CViewRect TGridView::CellToVRect(const GridCell& aCell) const
// CellToVRect calculates the view coordinates of the rectangle that surrounds
// the specified cell. The calculated rectangle includes the row and column insets of the cell.
//
// VRect:		CellToVRect(const GridCell& aCell) const;
// aCell:		Specifies the cell whose rectangle is to be calculated.
// theVRect:	Contains the calculated rectangle when the method returns.
//
// Call?		As needed.
// Override?	Never. It is not virtual.
{
	CViewRect aRect;

	if (aCell.h >= 1 && aCell.v >= 1 && aCell.h <= fNumOfCols && aCell.v <= fNumOfRows)
	{
		// all the params look OK
		ViewCoordinate width = fColWidths.GetValue(aCell.h);
		if (fColWidths.GetSize() == 1)
			aRect.left = width * (aCell.h - 1);
		else
			aRect.left = fColWidths.SumValues(1, aCell.h - 1);
		aRect.right = aRect.left + width;

		ViewCoordinate height = fRowHeights.GetValue(aCell.v);
		if (fRowHeights.GetSize() == 1)
			aRect.top = height * (aCell.v - 1);
		else
			aRect.top = fRowHeights.SumValues(1, aCell.v - 1);
		aRect.bottom = aRect.top + height;
	}
	else
	{
#if qRangeCheck && qDebugMsg
		ProgramReport_AC("aCell.h == %6d fNumOfCols == %6d\n", aCell.h, fNumOfCols);
		ProgramReport_AC("aCell.v == %6d fNumOfRows == %6d\n", aCell.v, fNumOfRows);
		::ProgramBreak_AC("Range Check in CellToVRect");
#endif
	}

	return aRect;
}

//----------------------------------------------------------------------------------------
// TGridView::ColToVRect:
//----------------------------------------------------------------------------------------

CViewRect TGridView::ColToVRect(GridCoordinate aCol, GridCoordinate numOfCols) const
// ColToVRect calculates the rectangle that bounds the specified columns.
//
// VRect:		ColToVRect(GridCoordinate aCol, GridCoordinate numOfCols) const;
// aCol:		specifies the number of the column whose rectangle is to be calculated.
// 				Columns are numbered from left to right; the leftmost column is number 1.
// numOfCols:	specifies the number of columns to include in the rectangle calculation.
// theVRect:	contains the calculated rectangle when the method returns.
//
// Call?		As needed.
// Override?	Never. It is not virtual.
{
	CViewRect aRect;

	if ((aCol < 1) || (numOfCols < 1) || (aCol + numOfCols - 1 > fNumOfCols))
	{
#if qDebugMsg && qRangeCheck
		ProgramReport_AC("fNumOfCols == %1d aCol == %1d\n", fNumOfCols, aCol);
		::ProgramBreak_AC("Range Check in ColToVRect");
#endif
	}
	else										// all the params look OK
	{
		long width;
		long leftEdge;
		if (fColWidths.GetSize() == 1)	// only one column width
		{
			width = GetColWidth(1);
			leftEdge = width * (aCol - 1);
			width *= numOfCols;
		}
		else
		{
			leftEdge = fColWidths.SumValues(1, aCol - 1);
			width = fColWidths.SumValues(aCol, numOfCols);
		}

		aRect.Set(leftEdge, 0, leftEdge + width, fRowHeights.GetTotal());
	}

	return aRect;
}

//----------------------------------------------------------------------------------------
// TGridView::AddStrip:
//----------------------------------------------------------------------------------------

void TGridView::AddStrip(RgnHandle			thePixels,
						 VHSelect			direction,
						 ViewCoordinate&	startOfStrip,
						 ViewCoordinate		endOfStrip,
						 CViewRect&			stripRect,
						 GridCoordinate		row,
						 GridCoordinate		col,
						 CViewRect&			pixels,
						 CViewRect&			previousPixels,
						 CViewRect&			prevStripRect)
// Internal to MacApp - not documented.
{
	if (direction == vSel)
		stripRect.Set(col, startOfStrip, col, endOfStrip);
	else
		stripRect.Set(startOfStrip, row, endOfStrip, row);

#if qDebugMsg
	if (gIntenseDebugging)
	{
		ProgramReport_AC("Adding cells = %s\n", stripRect.AsText().c_str());
	}
#endif

	pixels = previousPixels;

	if (stripRect.top != prevStripRect.top)
		pixels.top = fRowHeights.SumValues(1, stripRect.top - 1);
	if (stripRect.bottom != prevStripRect.bottom)
	{
		if (stripRect.bottom == stripRect.top)
			pixels.bottom = pixels.top + fRowHeights.GetValue(stripRect.bottom);
		else
			pixels.bottom = fRowHeights.SumValues(1, stripRect.bottom);
	}
	if (stripRect.left != prevStripRect.left)
		pixels.left = fColWidths.SumValues(1, stripRect.left - 1);
	if (stripRect.right != prevStripRect.right)
	{
		if (stripRect.right == stripRect.left)
			pixels.right = pixels.left + fColWidths.GetValue(stripRect.right);
		else
			pixels.right = fColWidths.SumValues(1, stripRect.right);
	}

	previousPixels = pixels;

	CTempRegion_AC tempRgn;

	SetEmptyRgn(tempRgn);
	::RectRgn(tempRgn, ViewToQD(pixels));
	::MacUnionRgn(tempRgn, thePixels, thePixels);

	prevStripRect = stripRect;
	startOfStrip = 0;
}

//----------------------------------------------------------------------------------------
// TGridView::CellsToPixels:
//----------------------------------------------------------------------------------------

void TGridView::CellsToPixels(const TGridViewDesignator* theCells, RgnHandle thePixels)
// CellsToPixels converts cells into a region of pixels that covers those cells.
// For example, MacApp uses this method to help determine what area on the
// screen should change its appearance to highlight a cell.
//
// theCells:	specifies a handle to a QuickDraw region that represents some
// 				part of the TGridView object.
// thePixels:	specifies a handle to a region that contains the QuickDraw coordinates
// 				of the cells in the region defined by the parameter theCells.
//
// Call?		As needed.
// Override?	Never. It is not virtual.
{
	::SetEmptyRgn(thePixels);

	if (!const_cast<TGridViewDesignator*>(theCells)->IsEmpty() && Focus())
	{
		// Reduce the cells to only those that are visible
		CViewRect visibleVRect(GetVisibleRect());

#if __GNUC__
		GridRect  tempGridRect(VPointToLastCell(visibleVRect[topLeft]), VPointToLastCell(visibleVRect[botRight]) + GridCell(1, 1));
		TGridViewDesignator visibleCellsRgn(tempGridRect);
#else
		TGridViewDesignator visibleCellsRgn(GridRect(VPointToLastCell(visibleVRect[topLeft]), VPointToLastCell(visibleVRect[botRight]) + GridCell(1, 1)));
#endif
		visibleCellsRgn.Intersect(theCells);
		CViewRect cellBounds(visibleCellsRgn.GetBounds());

		CViewRect prevStripRect;
		VHSelect direction = LongerSide(cellBounds);
		if (direction == vSel)
		{
			CViewRect stripRect;
			CViewRect pixels;
			CViewRect previousPixels;

			for (GridCoordinate col = cellBounds.left; col < cellBounds.right; ++col)
			{
				GridCell aCell;

				aCell.h = col;
				ViewCoordinate startOfStrip = 0;
				GridCoordinate row;
				for (row = cellBounds.top; row < cellBounds.bottom; ++row)
				{
					aCell.v = row;
					if (visibleCellsRgn.Contains(aCell))
					{
						if (!startOfStrip)
							startOfStrip = row;
					}
					else if (startOfStrip > 0)
						AddStrip(thePixels, direction, startOfStrip, row - 1, stripRect, row, col, pixels, previousPixels, prevStripRect);
				}
				if (startOfStrip > 0)
					AddStrip(thePixels, direction, startOfStrip, cellBounds.bottom - 1, stripRect, row, col, pixels, previousPixels, prevStripRect);
			}
		}
		else
		{
			CViewRect stripRect;
			CViewRect pixels;
			CViewRect previousPixels;

			for (GridCoordinate row = cellBounds.top; row < cellBounds.bottom; ++row)
			{
				GridCell aCell;

				aCell.v = row;
				ViewCoordinate startOfStrip = 0;
				GridCoordinate col;
				for (col = cellBounds.left; col < cellBounds.right; ++col)
				{
					aCell.h = col;
					if (visibleCellsRgn.Contains(aCell))
					{
						if (!startOfStrip)
							startOfStrip = col;
					}
					else if (startOfStrip > 0)
						AddStrip(thePixels, direction, startOfStrip, col - 1, stripRect, row, col, pixels, previousPixels, prevStripRect);
				}
				if (startOfStrip > 0)
					AddStrip(thePixels, direction, startOfStrip, cellBounds.right - 1, stripRect, row, col, pixels, previousPixels, prevStripRect);
			}
		}
	}
}

//----------------------------------------------------------------------------------------
// TGridView::DoHighlightSelection:
//----------------------------------------------------------------------------------------

void TGridView::DoHighlightSelection(HLState fromHL, HLState toHL)
{
	if (!fHLRegion.IsEmpty())
		HighlightCells(&fHLRegion, fromHL, toHL);
}

//----------------------------------------------------------------------------------------
// TGridView::HighlightCells:
//----------------------------------------------------------------------------------------

void TGridView::HighlightCells(const TGridViewDesignator*	theCells,
							   HLState						fromHL,
							   HLState						toHL)
{
	if ((fromHL != toHL) && Focus())
	{
		CTempRegion_AC pixelsHighlight;
		CellsToPixels(theCells, pixelsHighlight);
		SetupDrawingEnvironment();
		switch (fromHL + toHL)
		{
			case hlOffDim:
				::PenNormal();
				::PenMode(patXor);
				UseSelectionColor();
				::MacFrameRgn(pixelsHighlight);
				break;
			case hlOnDim:
			if (!::EmptyRgn(pixelsHighlight)) // <<< thanks, Klaus Halfmann
				{
					::InsetRgn(pixelsHighlight, 1, 1);
					::PenNormal();
					UseSelectionColor();
					::MacInvertRgn(pixelsHighlight);
				}
				break;
			case hlOffOn:
				::PenNormal();
				UseSelectionColor();
				::MacInvertRgn(pixelsHighlight);
				break;
		}
	}
}

//----------------------------------------------------------------------------------------
// TGridView::DoMenuCommand:
//----------------------------------------------------------------------------------------

void TGridView::DoMenuCommand(CommandNumber aCommandNumber)
{
	switch (aCommandNumber)
	{
		case cSelectAll:
		{
			for (CCellIterator iter(this); iter; ++iter)
				if (CanSelectCell(iter))
					SelectCell(iter, kExtend, kHighlight, kSelect);
			break;
		}

		default:
			TView::DoMenuCommand(aCommandNumber);
			break;
	}
}

//----------------------------------------------------------------------------------------
// TGridView::DoMouseCommand:
//----------------------------------------------------------------------------------------

void TGridView::DoMouseCommand(CViewPoint& theMouse, TToolboxEvent* event, CPoint_AC hysteresis)
{
	#pragma unused (hysteresis)
	GridCell aCell;

	if (IdentifyPoint(theMouse, aCell) != badChoice && CanSelectCell(aCell))
		PostCommand(TH_new TCellSelectCommand(this, theMouse, event->IsShiftKeyPressed(), event->IsCommandKeyPressed()));
}

//----------------------------------------------------------------------------------------
// TGridView::DoPostCreate
//----------------------------------------------------------------------------------------

void TGridView::DoPostCreate(TDocument* itsDocument)
{
	TView::DoPostCreate(itsDocument);

	// Cache the furthest row height and column width for future use.
	if (fNumOfRows)
		fDefaultRowHeight = GetRowHeight(fNumOfRows);
	if (fNumOfCols)
		fDefaultColWidth = GetColWidth(fNumOfCols);
}

//----------------------------------------------------------------------------------------
// TGridView::Draw:
//----------------------------------------------------------------------------------------

void TGridView::Draw(const CViewRect& area)
{
	CViewRect localArea(area);

	if ((fNumOfRows > 0) && (fNumOfCols > 0))
	{
		// make sure we have something to draw

		GridCell startCell(VPointToLastCell(area[topLeft]));
		if (fAdornCols)
			startCell.h = Max_AC(kMinCell, static_cast<GridCoordinate>(startCell.h - 1));
		if (fAdornRows)
			startCell.v = Max_AC(kMinCell, static_cast<GridCoordinate>(startCell.v - 1));
		GridCell stopCell(VPointToLastCell(area[botRight]));

		CViewRect aRect(CellToVRect(startCell));
		CViewRect bRect(CellToVRect(stopCell));
		bRect[topLeft] = aRect[topLeft];
		localArea = bRect;

		GridCell startCellToDraw(startCell);
		CViewRect cellsArea(localArea);
		if (area.top >= aRect.bottom - (fRowInset / 2))//((fRowInset) >> 1)
		{
			++startCellToDraw.v;
			cellsArea.top += aRect.GetLength(vSel);
		}

		DrawRangeOfCells(startCellToDraw, stopCell, cellsArea);

		if (fAdornCols)
		{
			ViewCoordinate colWidth = 0;
			aRect = localArea;

			bool constantWidth = fColWidths.GetSize() == 1;
			if (constantWidth)					// only one width
				colWidth = GetColWidth(1);

			for (long i = startCell.h; i <= stopCell.h; ++i)
			{
				if (constantWidth)
					aRect.right = aRect.left + colWidth;
				else
					aRect.right = aRect.left + GetColWidth(i);

				AdornCol(i, aRect);
				aRect.left = aRect.right;
			}
		}

		if (fAdornRows)
		{
			ViewCoordinate rowHeight = 0;
			aRect = localArea;

			bool constantHeight = fRowHeights.GetSize() == 1;
			if (constantHeight)					// only one height
				rowHeight = GetRowHeight(1);

			for (long i = startCell.v; i <= stopCell.v; ++i)
			{
				if (constantHeight)
					aRect.bottom = aRect.top + rowHeight;
				else
					aRect.bottom = aRect.top + GetRowHeight(i);

				AdornRow(i, aRect);
				aRect.top = aRect.bottom;
			}
		}
	}

	TView::Draw(localArea);
}

//----------------------------------------------------------------------------------------
// TGridView::DrawRangeOfCells:
//----------------------------------------------------------------------------------------

void TGridView::DrawRangeOfCells(const GridCell&	startCell,
								 const GridCell&	stopCell,
								 const CViewRect&	aRect)
{
	CTempRegion_AC drawableRegion;
	GetDrawableRegion(drawableRegion);

	CViewRect 	insetRect(fColInset / 2, fRowInset / 2,
					  -(fColInset / 2), -(fRowInset / 2));

	for (CCellIterator iter(this, startCell, stopCell, fDrawRowsForward, fDrawColsForward, fDrawRowMajor); iter; ++iter)
	{
		CViewRect localVRect(CellToVRect(iter));
		localVRect += insetRect;
		if (!CViewRect(localVRect & aRect).Empty() && ::RectInRgn(ViewToQD(localVRect), drawableRegion))
			DrawCell(iter, localVRect);
	}
}

//----------------------------------------------------------------------------------------
// TGridView::DrawCell:
//----------------------------------------------------------------------------------------

void TGridView::DrawCell(const GridCell& aCell, const CViewRect& aRect)
{
	#pragma unused (aCell, aRect)
}

//----------------------------------------------------------------------------------------
// TGridView::DelColAt:
//----------------------------------------------------------------------------------------

void TGridView::DelColAt(GridCoordinate aCol, GridCoordinate numOfCols)
// DelColAt deletes the specified column or columns and causes the remaining
// cells to be redrawn.
//
// aCol:		Specifies the index of the first column to be deleted. Columns are
// 				numbered from left to right; the leftmost column is number 1.
// numOfCols:	Specifies the number of columns to delete.
//
// Call?		As needed.
// Override?	Seldom.
{
	if (aCol < 1 || numOfCols < 1 || aCol + numOfCols - 1 > fNumOfCols)
	{
		if (numOfCols)
		{
#if qDebugMsg
			ProgramReport_AC("fNumOfCols == %1d   aCol == %1d\n", fNumOfCols, aCol);
			::ProgramBreak_AC("Range Check in DelColAt");
			return;
#endif

		}
	}
	else
	{
		CViewRect aVRect(ColToVRect(Max_AC(kMinCell, aCol), Max_AC(kMinCell, static_cast<GridCoordinate>(fNumOfCols - aCol + 1))));
		fColWidths.DeleteItems(aCol, numOfCols);
		fNumOfCols -= numOfCols;

		AdjustFrame();
		Invalidate(aVRect);
	}
}

//----------------------------------------------------------------------------------------
// TGridView::DelRowAt:
//----------------------------------------------------------------------------------------

void TGridView::DelRowAt(GridCoordinate aRow, GridCoordinate numOfRows)
// DelRowAt deletes the specified row or rows and causes the remaining cells
// to be redrawn.
//
// aRow:		Specifies the index of the first row to be deleted. Rows are numbered
// 				from top to bottom; the top row is number 1.
// numOfRows:	Specifies the number of rows to delete.
//
// Call?		As needed.
// Override?	Seldom.
{
	if (aRow < 1 || numOfRows < 1 || aRow + numOfRows - 1 > fNumOfRows)
	{
		if (numOfRows)
		{
#if qDebugMsg
			ProgramReport_AC("fNumOfRows == %1d  aRow == %1d\n", fNumOfRows, aRow);
			::ProgramBreak_AC("Range Check in DelRowAt");
			return;
#endif

		}
	}
	else
	{
		CViewRect aVRect(RowToVRect(Max_AC(kMinCell, aRow), Max_AC(kMinCell, static_cast<GridCoordinate>(fNumOfRows - aRow + 1))));
		fRowHeights.DeleteItems(aRow, numOfRows);
		fNumOfRows -= numOfRows;

		AdjustFrame();
		Invalidate(aVRect);
	}
}

//----------------------------------------------------------------------------------------
// TGridView::DelColFirst:
//----------------------------------------------------------------------------------------

void TGridView::DelColFirst(GridCoordinate numOfCols)
// DelColFirst deletes the specified column or columns, starting with the
// leftmost column, in a TGridView object.
//
// numOfCols:	Specifies the number of columns to delete.
//
// Call?		As needed.
// Override?	Seldom.
{
	DelColAt(1, numOfCols);
}

//----------------------------------------------------------------------------------------
// TGridView::DelRowFirst:
//----------------------------------------------------------------------------------------

void TGridView::DelRowFirst(GridCoordinate numOfRows)
// DelRowFirst deletes the first(that is, the topmost) row or rows in a TGridView
// object.
//
// numOfRows:	Specifies the number of rows to delete.
//
// Call?		As needed.
// Override?	Seldom.
{
	DelRowAt(1, numOfRows);
}

//----------------------------------------------------------------------------------------
// TGridView::DelColLast:
//----------------------------------------------------------------------------------------

void TGridView::DelColLast(GridCoordinate numOfCols)
// DelColLast deletes the specified number of columns, starting with the rightmost
// column, in a TGridView object.
//
// numOfCols:	Specifies the number of columns to delete.
//
// Call?		As needed.
// Override?	Seldom.
{
	DelColAt(fNumOfCols - numOfCols + 1, numOfCols);
}

//----------------------------------------------------------------------------------------
// TGridView::DelRowLast:
//----------------------------------------------------------------------------------------

void TGridView::DelRowLast(GridCoordinate numOfRows)
// DelRowLast deletes the last(that is, the bottom) row or rows in a TGridView
// object.
//
// numOfRows:	Specifies the number of rows to delete.
//
// Call?		As needed.
// Override?	Seldom.
{
	DelRowAt(fNumOfRows - numOfRows + 1, numOfRows);
}

//----------------------------------------------------------------------------------------
// TGridView::FirstSelectedCell:
//----------------------------------------------------------------------------------------

GridCell TGridView::FirstSelectedCell()
{
	return CSelectedCellIterator(this);
}

//----------------------------------------------------------------------------------------
// TGridView::GetColWidth:
//----------------------------------------------------------------------------------------

ViewCoordinate TGridView::GetColWidth(GridCoordinate aCol) const
{
#if qRangeCheck && qDebugMsg
	if ((aCol < 1) || (aCol > fNumOfCols))
	{
		ProgramReport_AC("fNumOfCols == &1d  aCol == %1d\n", fNumOfCols, aCol);
		::ProgramBreak_AC("Range Check in GetColWidth");
	}
#endif

	return aCol >= 1 && aCol <= fNumOfCols ? fColWidths.GetValue(aCol) : 0;
}

//----------------------------------------------------------------------------------------
// TGridView::GetRowHeight:
//----------------------------------------------------------------------------------------

ViewCoordinate TGridView::GetRowHeight(GridCoordinate aRow) const
{
#if qRangeCheck && qDebugMsg
	if ((aRow < 1) || (aRow > fNumOfRows))
	{
		ProgramReport_AC("fNumOfRows == &1d  aRow == %1d\n", fNumOfRows, aRow);
		::ProgramBreak_AC("Range Check in GetRowHeight");
	}
#endif

	return aRow >= 1 && aRow <= fNumOfRows ? fRowHeights.GetValue(aRow) : 0;
}

//----------------------------------------------------------------------------------------
// TGridView::InvalidateCell:
//----------------------------------------------------------------------------------------

void TGridView::InvalidateCell(const GridCell& aCell)
{
	Invalidate(CellToVRect(aCell));
}

//----------------------------------------------------------------------------------------
// TGridView::InvalidateSelection:
//----------------------------------------------------------------------------------------

void TGridView::InvalidateSelection()
{
	if (Focus())
	{
		CTempRegion_AC invalidateRegion;
		CellsToPixels(&fSelections, invalidateRegion);
		Invalidate(invalidateRegion);
	}
}

//----------------------------------------------------------------------------------------
// TGridView::IdentifyPoint:
//----------------------------------------------------------------------------------------

GridViewPart TGridView::IdentifyPoint(const CViewPoint& thePoint, GridCell& aCell)
{
	GridViewPart aGridViewPart = badChoice;		// default value

	aCell = VPointToCell(thePoint);

	if (aCell != gZeroPt)
	{
		CViewRect aVRect(CellToVRect(aCell));
		aVRect.Inset(fColInset / 2, fRowInset / 2);
		aGridViewPart = inCell;

		if (fColInset > 0)
		{
			if (thePoint.h < aVRect.left)
				aGridViewPart = inColumn;		// To the left of the cell
			else if (thePoint.h >= aVRect.right)// Remember PtInRgn will report a Point
			// as in a region only if the pixel to the
			// right and below the Point is contained
			// in the region.
			{
				aGridViewPart = inColumn;		// To the right of the cell
				if (aCell.h > fNumOfCols)
					aGridViewPart = badChoice;
				++aCell.h;						// ���  Moved from about if.
			}
		}

		if (fRowInset > 0)
		{
			if (thePoint.v < aVRect.top)
			{
				if (aGridViewPart == inColumn)
					aGridViewPart = inVertex;	// Click on both
				else
					aGridViewPart = inRow;		// Above the cell
			}
			else if (thePoint.v >= aVRect.bottom)// Remember PtInRgn will report a Point
			// as in a region only if the pixel to the
			// right and below the Point is contained
			// in the region.
			{
				if (aGridViewPart == inColumn)
					aGridViewPart = inVertex;	// Click on both
				else
					aGridViewPart = inRow;		// Above the cell
				if (aCell.v > fNumOfRows)
					aGridViewPart = badChoice;
				++aCell.v;						// ���  Moved from about if.
			}
		}
	}
	return aGridViewPart;
}

//----------------------------------------------------------------------------------------
// TGridView::InsColBefore:
//----------------------------------------------------------------------------------------

bool TGridView::InsColBefore(GridCoordinate aCol, GridCoordinate numOfCols, ViewCoordinate aWidth)
{
	bool returnVal = false;
	if (aCol < 1 || numOfCols < 1)
	{
		if (numOfCols)
		{
#if qDebugMsg && qRangeCheck
			ProgramReport_AC("fNumOfCols == %1d aCol == %1d\n", fNumOfCols, aCol);
			::ProgramBreak_AC("Range Check in InsColBefore");
#endif
		}
	}
	else
	{
		if ((unsigned long)fNumOfCols + (unsigned long)numOfCols > (unsigned long)LONG_MAX)
		{
#if qDebugMsg && qRangeCheck
			ProgramReport_AC("fNumOfCols == %1d aCol == %1d\n", fNumOfCols, aCol);
			::ProgramBreak_AC("Range Check in InsColBefore, insertion results in more than LONG_MAX columns");
#endif
		}
		else
		{
			fColWidths.InsertItems(aCol, numOfCols, aWidth);
			fNumOfCols += numOfCols;

			AdjustFrame();
			Invalidate(ColToVRect(Max_AC(kMinCell, aCol), Max_AC(kMinCell, static_cast<GridCoordinate>(fNumOfCols - aCol + 1))));
			returnVal = true;
		}
	}

	return returnVal;
}

//----------------------------------------------------------------------------------------
// TGridView::InsRowBefore:
//----------------------------------------------------------------------------------------

bool TGridView::InsRowBefore(GridCoordinate aRow, GridCoordinate numOfRows, ViewCoordinate aHeight)
{
	bool returnVal = false;
	if (aRow < 1 || numOfRows < 1)
	{
		if (numOfRows)
		{
#if qDebugMsg && qRangeCheck
			ProgramReport_AC("fNumOfRows == %1d aRow == %1d\n", fNumOfRows, aRow);
			::ProgramBreak_AC("Range Check in InsRowBefore");
#endif

		}
	}
	else
	{
		if ((unsigned long)fNumOfRows + (unsigned long)numOfRows > (unsigned long)LONG_MAX)
		{
#if qDebugMsg && qRangeCheck
			ProgramReport_AC("fNumOfRows == %1d aRow == %1d\n", fNumOfRows, aRow);
			::ProgramBreak_AC("Range Check in InsRowBefore, insertion results in more than LONG_MAX rows");
#endif
		}
		else
		{
			fRowHeights.InsertItems(aRow, numOfRows, aHeight);
			fNumOfRows += numOfRows;

			AdjustFrame();
			Invalidate(RowToVRect(Max_AC(kMinCell, aRow), Max_AC(kMinCell, static_cast<GridCoordinate>(fNumOfRows - aRow + 1))));
			returnVal = true;
		}
	}

	return returnVal;
}

//----------------------------------------------------------------------------------------
// TGridView::InsColLast:
//----------------------------------------------------------------------------------------

bool TGridView::InsColLast(GridCoordinate numOfCols, ViewCoordinate aWidth)
{
	return InsColBefore(fNumOfCols + 1, numOfCols, aWidth);
}

//----------------------------------------------------------------------------------------
// TGridView::InsRowLast:
//----------------------------------------------------------------------------------------

bool TGridView::InsRowLast(GridCoordinate numOfRows, ViewCoordinate aHeight)
{
	return InsRowBefore(fNumOfRows + 1, numOfRows, aHeight);
}

//----------------------------------------------------------------------------------------
// TGridView::InsColFirst:
//----------------------------------------------------------------------------------------

bool TGridView::InsColFirst(GridCoordinate numOfCols, ViewCoordinate aWidth)
{
	return InsColBefore(1, numOfCols, aWidth);
}

//----------------------------------------------------------------------------------------
// TGridView::InsRowFirst:
//----------------------------------------------------------------------------------------

bool TGridView::InsRowFirst(GridCoordinate numOfRows, ViewCoordinate aHeight)
{
	return InsRowBefore(1, numOfRows, aHeight);
}

//----------------------------------------------------------------------------------------
// TGridView::IsCellSelected:
//----------------------------------------------------------------------------------------

bool TGridView::IsCellSelected(const GridCell& aCell)
{
	return fSelections.Contains(aCell);
}

//----------------------------------------------------------------------------------------
// TGridView::IsAnyCellSelected:
//----------------------------------------------------------------------------------------

bool TGridView::IsAnyCellSelected()
{
	return !fSelections.IsEmpty();
}

//----------------------------------------------------------------------------------------
// TGridView::LastSelectedCell:
//----------------------------------------------------------------------------------------

GridCell TGridView::LastSelectedCell()
{
	return CSelectedCellIterator(this, false /* itsRowForward */, false /* itsColumnForward */, true /*itsRowMajor */);
}

//----------------------------------------------------------------------------------------
// TGridView::RowToVRect:
//----------------------------------------------------------------------------------------

CViewRect TGridView::RowToVRect(GridCoordinate aRow, GridCoordinate numOfRows) const
{
	CViewRect aRect;

	if ((aRow < 1) || (numOfRows < 1) || (aRow + numOfRows - 1 > fNumOfRows))
	{
#if qDebugMsg && qRangeCheck
		ProgramReport_AC("fNumOfRows == %1d aRow == %1d\n", fNumOfRows, aRow);
		::ProgramBreak_AC("Range Check in RowToVRect");
#endif
	}
	else										// all the params look OK
	{
		long height;
		long topEdge;

		if (fRowHeights.GetSize() == 1)	// only one row height
		{
			height = fRowHeights.GetValue(1);
			topEdge = height * (aRow - 1);
			height *= numOfRows;
		}
		else
		{
			topEdge = fRowHeights.SumValues(1, aRow - 1);
			height = fRowHeights.SumValues(aRow, numOfRows);
		}

		aRect.Set(0, topEdge, fColWidths.GetTotal(), topEdge + height);
	}

	return aRect;
}

//----------------------------------------------------------------------------------------
// TGridView::ScrollSelectionIntoView:
//----------------------------------------------------------------------------------------

void TGridView::ScrollSelectionIntoView(bool redraw)
{

	if (IsAnyCellSelected())
	{
		GridRect rgnBBox(fSelections.GetBounds());

		CViewRect topLeftRect(CellToVRect(rgnBBox[topLeft]));
		CViewRect botRightRect(CellToVRect(GridCell(rgnBBox.right - 1, rgnBBox.bottom - 1)));

		CViewRect selectionRect = topLeftRect | botRightRect;

		long hCoord = Max_AC(topLeftRect.GetLength(hSel), botRightRect.GetLength(hSel));
		CViewPoint minToSee(hCoord, Max_AC(topLeftRect.GetLength(vSel), botRightRect.GetLength(vSel)));

		RevealRect(selectionRect, minToSee, redraw);
	}
	else
		TView::ScrollSelectionIntoView(redraw);
}

//----------------------------------------------------------------------------------------
// TGridView::SetColWidth:
//----------------------------------------------------------------------------------------

void TGridView::SetColWidth(GridCoordinate aCol, GridCoordinate numOfCols, ViewCoordinate aWidth)
{
#if qDebugMsg
	if ((aCol < 1) || (numOfCols < 1) || (aCol + numOfCols - 1 > fNumOfCols))
	{
		ProgramReport_AC("fNumOfCols == %1d aCol == %1d\n", fNumOfCols, aCol);
		::ProgramBreak_AC("Range Check in SetColWidth");
	}
	else
#endif

	if ((fColWidths.GetSize() > 1) || (GetColWidth(1) != aWidth))
	{
		// invalidate the old screen area of the cols
		Invalidate(ColToVRect(Max_AC(kMinCell, aCol), Max_AC(kMinCell, static_cast<GridCoordinate>(fNumOfCols - aCol + 1))));

		// set the new col widths and adjust the view's frame
		if (fColWidths.GetSize() > 0)
			fColWidths.DeleteItems(aCol, numOfCols);
		fColWidths.InsertItems(aCol, numOfCols, aWidth);
		AdjustFrame();

		// invalidate the new screen area of the cols
		Invalidate(ColToVRect(Max_AC(kMinCell, aCol), Max_AC(kMinCell, static_cast<GridCoordinate>(fNumOfCols - aCol + 1))));
	}
}

//----------------------------------------------------------------------------------------
// TGridView::SetRowHeight:
//----------------------------------------------------------------------------------------

void TGridView::SetRowHeight(GridCoordinate aRow, GridCoordinate numOfRows, ViewCoordinate aHeight)
{
#if qDebugMsg
	if ((aRow < 1) || (numOfRows < 1) || (aRow + numOfRows - 1 > fNumOfRows))
	{
		ProgramReport_AC("fNumOfRows == %1d aRow == %1d\n", fNumOfRows, aRow);
		::ProgramBreak_AC("Range Check in SetRowHeight.");
	}
	else
#endif

	if ((fRowHeights.GetSize() != 1) || (GetRowHeight(1) != aHeight))
	{
		// invalidate the old screen area of the rows
		Invalidate(RowToVRect(Max_AC(kMinCell, aRow), Max_AC(kMinCell, static_cast<GridCoordinate>(fNumOfRows - aRow + 1))));

		// set the new row height and adjust the view's frame
		if (fRowHeights.GetSize() > 0)
			fRowHeights.DeleteItems(aRow, numOfRows);
		fRowHeights.InsertItems(aRow, numOfRows, aHeight);
		AdjustFrame();

		// invalidate the new screen area of the rows
		Invalidate(RowToVRect(Max_AC(kMinCell, aRow), Max_AC(kMinCell, static_cast<GridCoordinate>(fNumOfRows - aRow + 1))));
	}
}

//----------------------------------------------------------------------------------------
// TGridView::SelectCell:
//----------------------------------------------------------------------------------------

void TGridView::SelectCell(const GridCell&	theCell,
						   bool				extendSelection,
						   bool				highlight,
						   bool				select)
{
	SetSelectionRect(GridRect(theCell, theCell), extendSelection, highlight, select);
}

//----------------------------------------------------------------------------------------
// TGridView::SetEmptySelection:
//----------------------------------------------------------------------------------------

void TGridView::SetEmptySelection(bool highlight)
{
	TGridViewDesignator tempSelection;
	SetSelection(&tempSelection, kDontExtend, highlight, kSelect);
}

//----------------------------------------------------------------------------------------
// TGridView::SetNumberOfRows
//----------------------------------------------------------------------------------------

void TGridView::SetNumberOfRows(short numOfRows, ViewCoordinate rowHeight)
{
	if (rowHeight == 0)
		rowHeight = fDefaultRowHeight;
	GridCoordinate	delta = numOfRows - GetNumOfRows();
	if (delta > 0)
		InsRowLast(delta, rowHeight);
	else if (delta < 0)
		DelRowLast(-delta);
}

//----------------------------------------------------------------------------------------
// TGridView::SetNumberOfCols
//----------------------------------------------------------------------------------------

void TGridView::SetNumberOfCols(short numOfCols, ViewCoordinate colWidth)
{
	if (colWidth == 0)
		colWidth = fDefaultColWidth;
	GridCoordinate	delta = numOfCols - GetNumOfRows();
	if (delta > 0)
		InsColLast(delta, colWidth);
	else if (delta < 0)
		DelColLast(-delta);
}

//----------------------------------------------------------------------------------------
// TGridView::SetSelection:
//----------------------------------------------------------------------------------------

void TGridView::SetSelection(const TGridViewDesignator*	cellsToSelect,
							 bool						extendSelection,
							 bool						highlight,
							 bool						select)
{
#if qDebug
	GridRect bounds(cellsToSelect->GetBounds());

	if (fSingleSelection && ((bounds.GetLength(hSel) > 1) || (bounds.GetLength(vSel) > 1)))
		::ProgramBreak_AC("Attempt to select multiple cells when fSingleSelection is true");
	if (!const_cast<TGridViewDesignator*>(cellsToSelect)->IsEmpty())
		if ((bounds.left < 1) || (bounds.top < 1) || (bounds.right > fNumOfCols + 1) || (bounds.bottom > fNumOfRows + 1))
			::ProgramBreak_AC("Attempted selection is outside the range of cells");
#endif

	TGridViewDesignator previousSelection;
	if (highlight)
		previousSelection.Set(&fSelections);// save the old selection

	TGridViewDesignator tempRgn(GridRect(1, 1, fNumOfCols + 1, fNumOfRows + 1));
	tempRgn.Intersect(cellsToSelect);

	if (extendSelection && select)				// extend the selection
		fSelections.Append(&tempRgn);
	else if (select)							// reset the selection
		fSelections.Set(&tempRgn);
	else										// need to de-select the new selection
		fSelections.Remove(&tempRgn);

	UserSelectionChanged(this);					// so doc updates its designator

	fHLRegion.Set(&fSelections);

	if (highlight)
	{
		HLState currentHL = GetCurrentHL();

		// Turn the deselected cells off
		TGridViewDesignator differenceRegion(previousSelection);
		differenceRegion.Remove(&fSelections);
		HighlightCells(&differenceRegion, currentHL, hlOff);

		// Turn the newly selected cells on
		differenceRegion.Set(&fSelections);
		differenceRegion.Remove(&previousSelection);
		HighlightCells(&differenceRegion, hlOff, currentHL);
	}

#if qDrag
	if (GetDraggable())
		gDispatcher->InvalidateMouseRegions();
#endif

}

//----------------------------------------------------------------------------------------
// TGridView::SetSelectionRect:
//----------------------------------------------------------------------------------------

void TGridView::SetSelectionRect(const CViewRect&	selectionRect,
								 bool				extendSelection,
								 bool				highlight,
								 bool				select)
{
	TGridViewDesignator tempSelection;

	if (selectionRect != GridRect(gZeroRect)) //��� construct the gridrect so it works as short or long coords
		tempSelection.Set(GridRect(selectionRect.left, selectionRect.top, selectionRect.right + 1, selectionRect.bottom + 1));

	SetSelection(&tempSelection, extendSelection, highlight, select);
}

//----------------------------------------------------------------------------------------
// TGridView::SetSingleSelection:
//----------------------------------------------------------------------------------------

void TGridView::SetSingleSelection(bool theSetting)
{
	fSingleSelection = theSetting;
}

//----------------------------------------------------------------------------------------
// TGridView::VPointToCell:
//----------------------------------------------------------------------------------------

GridCell TGridView::VPointToCell(const CViewPoint& aPoint) const
{
	GridCell aCell(fColWidths.FindItem(aPoint.h), fRowHeights.FindItem(aPoint.v));

	return !aCell.h || !aCell.v ? GridCell(0, 0) : aCell;
}

//----------------------------------------------------------------------------------------
// TGridView::VPointToLastCell:
//----------------------------------------------------------------------------------------

GridCell TGridView::VPointToLastCell(const CViewPoint& aPoint) const
{
	GridCell aCell(fColWidths.FindItem(aPoint.h), fRowHeights.FindItem(aPoint.v));

	if (!aCell.h || aCell.h > fNumOfCols)		// If its invalid, return the last column
		aCell.h = fNumOfCols;

	if (!aCell.v || aCell.v > fNumOfRows)		// If its invalid, return the last row
		aCell.v = fNumOfRows;

	return aCell;
}

#if qDrag

//----------------------------------------------------------------------------------------
// TGridView::DoMakeDragCursorRegion:
//----------------------------------------------------------------------------------------

RgnHandle TGridView::DoMakeDragCursorRegion()
{
	RgnHandle dragCursorRegion = NULL;

	if (IsAnyCellSelected())
	{
		CTempRegion_AC drawableRgn;
		CTempRegion_AC cellRegion;

		dragCursorRegion = MakeNewRgn();

		for (CSelectedCellIterator iter(this); iter; ++iter)
		{
			::RectRgn(cellRegion, ViewToQD(CellToVRect(iter)));
			::MacUnionRgn(cellRegion, dragCursorRegion, dragCursorRegion);
		}

		GetDrawableRegion(drawableRgn);			// return the interesection of the selection
		SectRgn(dragCursorRegion, drawableRgn, dragCursorRegion);// and the view's drawable region
	}

	return dragCursorRegion;
}

//----------------------------------------------------------------------------------------
// TGridView::WillDrag:
//----------------------------------------------------------------------------------------

bool TGridView::WillDrag(const CViewPoint& localMouse, const RgnHandle dragCursorRegion)
{
	return !IsShiftKeyDown() && !IsCommandKeyDown() && TView::WillDrag(localMouse, dragCursorRegion);
}

//----------------------------------------------------------------------------------------
// TGridView::DoMakeDragTracker:
//----------------------------------------------------------------------------------------

TDragTracker* TGridView::DoMakeDragTracker(CommandNumber		itsCommandNumber,
										   const CViewPoint&	itsMouse,
										   const TToolboxEvent*	event)
{
	return TH_new TGridDragTracker(itsCommandNumber, this, itsMouse, event);
}

#endif // qDrag

#if qDrag

//========================================================================================
// CLASS TGridDragTracker
//========================================================================================

//----------------------------------------------------------------------------------------
// TGridDragTracker constructor
//----------------------------------------------------------------------------------------

TGridDragTracker::TGridDragTracker(CommandNumber			itsCommandNumber,
								   TGridView*				itsView,
								   const CViewPoint&		itsMouse,
								   const TToolboxEvent*		event)
	:	TDragTracker(itsCommandNumber, itsView, itsMouse, event),
		fGridView(itsView),
		fLastCaretTime(0L),
		fCaretIsShown(false)
{
}

//----------------------------------------------------------------------------------------
// TGridDragTracker destructor
//----------------------------------------------------------------------------------------

TGridDragTracker::~TGridDragTracker()
{
}

//----------------------------------------------------------------------------------------
// TGridDragTracker::DoDragEnter:
//----------------------------------------------------------------------------------------

void TGridDragTracker::DoDragEnter()
{
	fLastTargetCell.Clear();
	fLastCaretTime = 0L;
	fCaretIsShown = false;
}

//----------------------------------------------------------------------------------------
// TGridDragTracker::DoDragWithin:
//----------------------------------------------------------------------------------------

void TGridDragTracker::DoDragWithin(const CViewPoint& localMouse)
{
	unsigned long currentTime = TickCount();

	GridCell targetCell(fGridView->VPointToLastCell(localMouse));
	bool targetChanged = (fLastTargetCell != targetCell);

	if (targetChanged && fCaretIsShown)
		DrawCellCaret(fLastTargetCell);

	if (targetChanged || (currentTime - fLastCaretTime) > GetCaretTime())
	{
		DrawCellCaret(targetCell);
		fLastTargetCell = targetCell;
		fLastCaretTime = currentTime;
	}
}

//----------------------------------------------------------------------------------------
// TGridDragTracker::DoDragLeave:
//----------------------------------------------------------------------------------------

void TGridDragTracker::DoDragLeave()
{
	if (fCaretIsShown)
		DrawCellCaret(fLastTargetCell);
}

//----------------------------------------------------------------------------------------
// TGridDragTracker::DrawCellCaret:
//----------------------------------------------------------------------------------------

void TGridDragTracker::DrawCellCaret(const GridCell& targetCell)
{
	// don't allow a cell in the current selection to be targeted
	if (fGridView->CanSelectCell(targetCell) &&
		!((TDragDropSession::fgDragDropSession->GetCurrentDragSource() == fGridView) &&
		fGridView->IsCellSelected(targetCell)))
	{
		::PenNormal();
		CPattern_AC::SetPenPatToGray();
		::PenMode(notPatXor);
		::PenSize(2, 2);

		CViewRect cellRect(targetCell == gZeroPt ? fGridView->GetDrawableRect() : fGridView->CellToVRect(targetCell));
		::MacFrameRect(fGridView->ViewToQD(cellRect));

		::PenNormal();
	}

	fCaretIsShown = !fCaretIsShown;
}

#endif // qDrag

//========================================================================================
// CLASS TTextGridView
//========================================================================================

MA_DEFINE_CLASS(TTextGridView);

//----------------------------------------------------------------------------------------
// TTextGridView constructor
//----------------------------------------------------------------------------------------

TTextGridView::TTextGridView()
	:	TGridView(),
		fTextStyle(gSystemStyle),
		fTextStyleRsrcID(kNoResource),
		fJustification(teFlushDefault),
		fLineHeight(0),
		fLineAscent(0),
		fPreferOutline(kDontPreferOutline)
{
}

//----------------------------------------------------------------------------------------
// TTextGridView constructor
//----------------------------------------------------------------------------------------

TTextGridView::TTextGridView(const CViewPoint&		itsLocation,
							 const CViewPoint&		itsSize,
							 SizeDeterminer			itsHSizeDet,
							 SizeDeterminer			itsVSizeDet,
							 GridCoordinate			numOfRows,
							 GridCoordinate			numOfCols,
							 ViewCoordinate			rowHeight,
							 ViewCoordinate			colWidth,
							 bool					adornRows,
							 bool					adornCols,
							 ViewCoordinate			rowInset,
							 ViewCoordinate			colInset,
							 bool					singleSelection,
							 const CTextStyle_AC&	itsTextStyle)
	:	TGridView(itsLocation, itsSize, itsHSizeDet, itsVSizeDet, numOfRows, numOfCols, rowHeight, colWidth, adornRows, adornCols, rowInset, colInset, singleSelection),
		fTextStyle(itsTextStyle),
		fTextStyleRsrcID(kNoResource),
		fJustification(teFlushDefault),
		fLineHeight(0),
		fLineAscent(0),
		fPreferOutline(kDontPreferOutline)
{
	if (!rowHeight) // ���  this should be a function that returns rowheight
	{
		// Compute the rowHeight for call to TGridView based on the line height and the row inset.
		GrafPtr savedPort;
		GetPort(&savedPort);					// save the port
		SetPortWindowPort(gWorkPort);			// set port to the work port

		SetPortTextStyle(itsTextStyle);			// set the port's text style
		PenNormal();

		FontInfo theFontInfo;
		rowHeight = MAGetFontInfo(theFontInfo) + rowInset;

		::SetPort_AC(savedPort);				// restore port
	}

	SetUpFont();

	if ((fNumOfCols == 1) && (GetSizeDeterminer(hSel) != sizeFixed) && (GetColWidth(1) == 0) && fSuperView)
		SetColWidth(1, fNumOfCols, fSuperView->GetSize().h);
}

//----------------------------------------------------------------------------------------
// TTextGridView destructor
//----------------------------------------------------------------------------------------

TTextGridView::~TTextGridView()
{
}

//----------------------------------------------------------------------------------------
// TTextGridView::GetStandardSignature:
//----------------------------------------------------------------------------------------

IDType TTextGridView::GetStandardSignature() const
{
	return kStdTextGridView;
}

//----------------------------------------------------------------------------------------
// TTextGridView::ReadFields:
//----------------------------------------------------------------------------------------

void TTextGridView::ReadFields(CStream_AC* aStream)
{
	TGridView::ReadFields(aStream);

	fTextStyleRsrcID = aStream->ReadInteger();
	if (fTextStyleRsrcID != kNoResource)
		fTextStyle = MAGetTextStyle(fTextStyleRsrcID);

	fPreferOutline = aStream->ReadBoolean();

	SetUpFont();

	if (fNumOfRows > 0)
		if (!GetRowHeight(1))				// set row height from font
			SetRowHeight(1, fNumOfRows, fLineHeight + fRowInset);

	if (fNumOfCols == 1 && GetSizeDeterminer(hSel) != sizeFixed && !GetColWidth(1))
		SetColWidth(1, fNumOfCols, fSize.h);
}

//----------------------------------------------------------------------------------------
// TTextGridView::WriteFields:
//----------------------------------------------------------------------------------------

void TTextGridView::WriteFields(CStream_AC* aStream) const
{
	TGridView::WriteFields(aStream);

	aStream->WriteInteger(fTextStyleRsrcID);
	aStream->WriteBoolean(fPreferOutline);
}

//----------------------------------------------------------------------------------------
// TTextGridView::DrawCell:
//----------------------------------------------------------------------------------------

void TTextGridView::DrawCell(const GridCell& aCell, const CViewRect& aRect)
// DrawCell draws the text contained in a TGridView cell.
// MacApp uses this method as part of the process of drawing TTextGridView objects.
// !Call: Seldom.
// !Override: As needed.  If you want to change the way the text is drawn, you must
//           override this method.
// aCell: Specifies the cell whose text is to be drawn.
// aRect: Defines the rectangle, described in view coordinates, in which MacApp
//        draws the text.
{
	if (GetColWidth(aCell.h) > 0)
	{
		CStr255_AC theText(GetText(aCell));

		GrafPtr currentPort;
		::GetPort(&currentPort);

#if !qCarbon
		short txFace = currentPort->txFace;
#else
		short txFace = ::GetPortTextFace(currentPort);
#endif

		CRect_AC r(ViewToQD(aRect));

		if (::StringWidth(theText) > r.GetLength(hSel))
		{
			::TextFace(condense); // try to show as much as possible
			::TruncString(r.GetLength(hSel), theText, truncEnd); // and indicate if there is more
		}

		if(CanSelectCell(aCell))
			TextBox_AC(reinterpret_cast<char*>(&theText[1]),
			   theText.Length(),
			   r,
			   fJustification,
			   false,
			   nil,
			   false,
			   false,
			   fPreferOutline);
		else
		{
			// HOWEVER, disabled texts are often drawn dimmed with grayisTextOR and I quote from IM Text on TextMode:
			// "The grayishTextOr transfer mode draws dimmed text on the screen. You can use it for black-and-white
			// or color graphics ports. The grayishTextOr transfer mode is not considered a standard transfer mode
			// because currently it is not stored in pictures, and printing with it is undefined. (It does not pass
			// through the QuickDraw bottleneck routines.)"
			::PenState pState;
			::GetPenState(&pState);				// save pen state
#if !qCarbon
			short txMode = currentPort->txMode;
#else
			short txMode = ::GetPortTextMode(currentPort);
#endif

			if (!gPrinting)
				::TextMode(grayishTextOr);

			TextBox_AC(reinterpret_cast<char*>(&theText[1]),
			   theText.Length(),
			   r,
			   fJustification,
			   false,
			   nil,
			   false,
			   false,
			   fPreferOutline);

			if (gPrinting)
			{
				CPattern_AC::SetPenPatToGray();
				::PenMode(patBic);
				::PaintRect(r);
			}

			SetPenState(&pState);				// restore pen state
			::TextMode(txMode);
		}
		::TextFace(txFace);
	}
}

//----------------------------------------------------------------------------------------
// TTextGridView::Focus:
//----------------------------------------------------------------------------------------

bool TTextGridView::Focus()
{
	bool returnVal = TGridView::Focus();

	if (returnVal)
		SetPen();

	return returnVal;
}

//----------------------------------------------------------------------------------------
// TTextGridView::SetUpFont:
//----------------------------------------------------------------------------------------

void TTextGridView::SetUpFont()
{
	GrafPtr savedPort;

	// set port to the work port
	GetPort(&savedPort);
	SetPortWindowPort(gWorkPort);

	{											// block for CWhileOutlinePreferred (which has a constructor/destructor)
		CWhileOutlinePreferred_AC setOP(fPreferOutline);
		FontInfo theFontInfo;

		SetPen();
		fLineHeight = MAGetFontInfo(theFontInfo);// returns height of font
		fLineAscent = theFontInfo.ascent + (theFontInfo.leading / 2);
	}

	// restore port
	::SetPort_AC(savedPort);
}

//----------------------------------------------------------------------------------------
// TTextGridView::SetPen:
//----------------------------------------------------------------------------------------

void TTextGridView::SetPen()
{
	PenNormal();
	SetPortTextStyle(fTextStyle);
}

//----------------------------------------------------------------------------------------
// TTextGridView::GetText:
//----------------------------------------------------------------------------------------

CStr255_AC TTextGridView::GetText(const GridCell& aCell) const
{
	#pragma unused (aCell)
	return gEmptyString;
}

#if qDrag

//----------------------------------------------------------------------------------------
// TTextGridView::DoAddDragContent:
//----------------------------------------------------------------------------------------

void TTextGridView::DoAddDragContent()
{
	CFlavorFlags flags;
	TDragItem * dragItem = TDragDropSession::fgDragDropSession->AddDragItem(1);

	dragItem->PromiseFlavor(kTextType_AC, flags);
}

//----------------------------------------------------------------------------------------
// TTextGridView::DoFulfillPromise:
//----------------------------------------------------------------------------------------

void TTextGridView::DoFulfillPromise(TDragItem* promisedItem)
{
	switch (promisedItem->GetFlavorType())
	{
		case kTextType_AC:
			{
				CAutoPtr_AC<TStream> flavorStream(promisedItem->GetDataStream());

				for (CSelectedCellIterator iter(this); iter; )
				{
					GridCell currentCell = iter;
					CStr255_AC text(GetText(currentCell));
					flavorStream->WriteBytes(&text[1], text.Length());

					GridCell nextCell = ++iter;
					if (iter)
						flavorStream->WriteCharacter((nextCell.v > currentCell.v) ? '\n' : '\t');
				}
			}
			break;

		default:
			TGridView::DoFulfillPromise(promisedItem);
			break;
	}
}

#endif // qDrag

//========================================================================================
// CLASS TTextListView
//========================================================================================

MA_DEFINE_CLASS(TTextListView);

//----------------------------------------------------------------------------------------
// TTextListView destructor
//----------------------------------------------------------------------------------------

TTextListView::~TTextListView()
{
}

//----------------------------------------------------------------------------------------
// TTextListView::GetStandardSignature:
//----------------------------------------------------------------------------------------

IDType TTextListView::GetStandardSignature() const
{
	return kStdTextListView;
}

//----------------------------------------------------------------------------------------
// TTextListView::CanSelectCell:
//----------------------------------------------------------------------------------------

bool TTextListView::CanSelectCell(const GridCell& aCell)
{
	return TTextGridView::CanSelectCell(aCell) && CanSelectItem(aCell.v);
}

//----------------------------------------------------------------------------------------
// TTextListView::CanSelectItem:
//----------------------------------------------------------------------------------------

bool TTextListView::CanSelectItem(GridCoordinate anItem)
// CanSelectItem returns true if the specified item can be selected; that
// is, if the specified item is a valid row number in this object.
//
// anItem:	Specifies the item to be tested.
//
// Call?		As needed.
// Override?	As needed.
{
	return anItem >= 1 && anItem <= fNumOfRows;
}

//----------------------------------------------------------------------------------------
// TTextListView::DelItemAt:
//----------------------------------------------------------------------------------------

void TTextListView::DelItemAt(GridCoordinate anItem, GridCoordinate numOfItems)
// DelItemAt deletes the specified items in this object�s list of items.
//
// anItem:		Specifies the index of the first item to be deleted. Items in a
// 				TTextListView are numbered from the first item, beginning with 1.
// numOfItems:	Specifies the number of items to be deleted from the list.
//
// Call?		As needed.
// Override?	Seldom.
{
	DelRowAt(anItem, numOfItems);
}

//----------------------------------------------------------------------------------------
// TTextListView::DelItemFirst:
//----------------------------------------------------------------------------------------

void TTextListView::DelItemFirst(GridCoordinate numOfItems)
// DelItemFirst deletes a specified number of items, beginning with the first
// item, from this object�s list of items.
//
// numOfItems:	Specifies the number of items to be deleted from the list.
//
// Call?		As needed.
// Override?	Seldom.
{
	DelItemAt(1, numOfItems);
}

//----------------------------------------------------------------------------------------
// TTextListView::DelItemLast:
//----------------------------------------------------------------------------------------

void TTextListView::DelItemLast(GridCoordinate numOfItems)
// DelItemLast deletes the specified number of items, beginning with the last
// item, from this object�s list of items.
//
// numOfItems:	Specifies the number of items to be deleted from the list.
//
// Call?		As needed.
// Override?	Seldom.
{
	DelItemAt(fNumOfRows - numOfItems + 1, numOfItems);
}

//----------------------------------------------------------------------------------------
// TTextListView::DoKeySelection:
//----------------------------------------------------------------------------------------

void TTextListView::DoKeySelection(const CStr255_AC& selectionString)
{
	if (fNumOfRows)	// Do nothing if there are no rows.
	{
		GridCoordinate lastItemIndex = GetItemIndexOrdered(1);
		CStr255_AC upperCaseSelectionString(selectionString);
		UprStr255(upperCaseSelectionString);

		for (GridCoordinate i = 1; i <= fNumOfRows; ++i)
		{
			GridCoordinate itemIndex = GetItemIndexOrdered(i);

			CStr255_AC itemText(GetItemText(itemIndex));
			UprStr255(itemText);

			itemText.Delete(upperCaseSelectionString.Length() + 1, itemText.Length() - upperCaseSelectionString.Length());

			short compareResult = CPascalStr_AC::CPascalStrCompare(itemText, upperCaseSelectionString);
			if (compareResult > 0)
				break;				// the previous index is the closest match

			lastItemIndex = itemIndex;

			if (!compareResult)
				break;				// the current index is the closest match
		}

		SelectItem(lastItemIndex, false, true, true);
		ScrollSelectionIntoView(true);
	}
}

//----------------------------------------------------------------------------------------
// TTextListView::FirstSelectedItem:
//----------------------------------------------------------------------------------------

GridCoordinate TTextListView::FirstSelectedItem()
{
	return FirstSelectedCell().v;
}

//----------------------------------------------------------------------------------------
// TTextListView::GetItemHeight:
//----------------------------------------------------------------------------------------

ViewCoordinate TTextListView::GetItemHeight(GridCoordinate anItem)
{
	return GetRowHeight(anItem);
}

//----------------------------------------------------------------------------------------
// TTextListView::GetItemWidth:
//----------------------------------------------------------------------------------------

ViewCoordinate TTextListView::GetItemWidth()
{
	return GetColWidth(1);
}

//----------------------------------------------------------------------------------------
// TTextListView::GetItemText:
//----------------------------------------------------------------------------------------

CStr255_AC TTextListView::GetItemText(GridCoordinate) const
{
	return gEmptyString;
}

//----------------------------------------------------------------------------------------
// TTextListView::GetItemIndexOrdered:
//----------------------------------------------------------------------------------------

GridCoordinate TTextListView::GetItemIndexOrdered(GridCoordinate nthItem)
{
	return nthItem;
}

//----------------------------------------------------------------------------------------
// TTextListView::GetText:
//----------------------------------------------------------------------------------------

CStr255_AC TTextListView::GetText(const GridCell& aCell) const
{
	return GetItemText(aCell.v);
}

//----------------------------------------------------------------------------------------
// TTextListView::InsItemBefore:
//----------------------------------------------------------------------------------------

bool TTextListView::InsItemBefore(GridCoordinate anItem, GridCoordinate numOfItems)
{
	return InsRowBefore(anItem, numOfItems, fLineHeight + fRowInset);
}

//----------------------------------------------------------------------------------------
// TTextListView::InsItemFirst:
//----------------------------------------------------------------------------------------

bool TTextListView::InsItemFirst(GridCoordinate numOfItems)
{
	return InsItemBefore(1, numOfItems);
}

//----------------------------------------------------------------------------------------
// TTextListView::InsItemLast:
//----------------------------------------------------------------------------------------

bool TTextListView::InsItemLast(GridCoordinate numOfItems)
{
	return InsItemBefore(fNumOfRows + 1, numOfItems);
}

//----------------------------------------------------------------------------------------
// TTextListView::InvalidateItem:
//----------------------------------------------------------------------------------------

void TTextListView::InvalidateItem(GridCoordinate anItem)
{
	InvalidateCell(GridCell(1, anItem));
}

//----------------------------------------------------------------------------------------
// TTextListView::IsItemSelected:
//----------------------------------------------------------------------------------------

bool TTextListView::IsItemSelected(GridCoordinate anItem)
{
	return IsCellSelected(GridCell(1, anItem));
}

//----------------------------------------------------------------------------------------
// TTextListView::LastSelectedItem:
//----------------------------------------------------------------------------------------

GridCoordinate TTextListView::LastSelectedItem()
{
	return LastSelectedCell().v;
}

//----------------------------------------------------------------------------------------
// TTextListView::SetFrame:
//----------------------------------------------------------------------------------------

void TTextListView::SetFrame(const CViewRect& newFrame, bool invalidate)
{
	CViewPoint oldSize(fSize);

	TTextGridView::SetFrame(newFrame, invalidate);

	if (fNumOfCols == 1 && fSize != oldSize)
	{
		fColWidths.SetTotal(fColWidths.GetTotal() + fSize.h - fColWidths.ChunkAt(0).value);
		fColWidths.ChunkAt(0).value = fSize.h;
	}
}

//----------------------------------------------------------------------------------------
// TTextListView::SelectCell:
//----------------------------------------------------------------------------------------

void TTextListView::SelectCell(const GridCell&	theCell,
							   bool				extendSelection,
							   bool				highlight,
							   bool				select)
{
	SelectItem(theCell.v, extendSelection, highlight, select);
}

//----------------------------------------------------------------------------------------
// TTextListView::SelectItem:
//----------------------------------------------------------------------------------------

void TTextListView::SelectItem(GridCoordinate	anItem,
							   bool				extendSelection,
							   bool				highlight,
							   bool				select)
{
	TTextGridView::SelectCell(GridCell(Min_AC(kMinCell, anItem), anItem), extendSelection, highlight, select);
}

//----------------------------------------------------------------------------------------
// TTextListView::SetItemHeight:
//----------------------------------------------------------------------------------------

void TTextListView::SetItemHeight(GridCoordinate	anItem,
								  GridCoordinate	numOfItems,
								  ViewCoordinate	aHeight)
{
	SetRowHeight(anItem, numOfItems, aHeight);
}

//----------------------------------------------------------------------------------------
// TTextListView::SetItemWidth:
//----------------------------------------------------------------------------------------

void TTextListView::SetItemWidth(ViewCoordinate aWidth)
{
	SetColWidth(1, 1, aWidth);
}

//========================================================================================
// CLASS TCellSelectCommand
//========================================================================================

//----------------------------------------------------------------------------------------
// TCellSelectCommand constructor
//----------------------------------------------------------------------------------------

TCellSelectCommand::TCellSelectCommand(TGridView*			itsView,
									   const CViewPoint&	itsMouse,
									   bool					theShiftKey,
									   bool					theCommandKey)
	:	TTracker(cNoCommand, itsView, kCantUndo, kDoesNotCauseChange, NULL, itsView, itsView->GetScroller(kAnySuperView), itsMouse),
		fPreviousSelection(*itsView->GetSelections()),
		fGridView(itsView),
		fThisSelection(itsView->GetHLRegion()),
		fPreviousCell(-1, -1),
		fShiftKey(theShiftKey),
		fCommandKey(theCommandKey),
		fDeselecting(false)
{
	fThisSelection->Set();
	fViewConstrain = false;
}

//----------------------------------------------------------------------------------------
// TCellSelectCommand::Free:
//----------------------------------------------------------------------------------------

TCellSelectCommand::~TCellSelectCommand()
{
}

//----------------------------------------------------------------------------------------
// TCellSelectCommand::ComputeAnchorCell:
//----------------------------------------------------------------------------------------

void TCellSelectCommand::ComputeAnchorCell(const GridCell& clickedCell)
// See TCellSelectCommand.
{
	fAnchorCell = clickedCell;

	// ���  added !GetSingleSelection.
	if (fShiftKey && !fGridView->GetSingleSelection() && !fPreviousSelection.IsEmpty())
	{
		const CViewRect bounds(fPreviousSelection.GetBounds());

		if (fAnchorCell.h >= bounds.left)
			fAnchorCell.h = bounds.left;
		else
			fAnchorCell.h = bounds.right - 1;
		if (fAnchorCell.v >= bounds.top)
			fAnchorCell.v = bounds.top;
		else
			fAnchorCell.v = bounds.bottom - 1;
	}
}

//----------------------------------------------------------------------------------------
// TCellSelectCommand::ComputeNewSelection:
//----------------------------------------------------------------------------------------

void TCellSelectCommand::ComputeNewSelection(const GridCell& clickedCell)
// See TCellSelectCommand.
{
	if (fGridView->CanSelectCell(clickedCell))
	{
		GridRect r;

		if (fGridView->GetSingleSelection() || (!fShiftKey))
			r = GridRect(clickedCell, clickedCell + GridCell(1, 1));
		else
		{
			r = GridRect(fAnchorCell, clickedCell);
			r.Validate();
			++r[botRight];
		}

		fThisSelection->Set(r);

		//
		// Remove unselectable cells
		//
		TGridViewDesignator cantSelectCell;
    	for (CCellInRegionIterator iter(fGridView, fThisSelection); iter; ++iter)
			if (!fGridView->CanSelectCell(iter))
			{
				GridCell unSelCell(iter);

				cantSelectCell.Set(GridRect(unSelCell.h, unSelCell.v, unSelCell.h + 1, unSelCell.v + 1));
				fThisSelection->Remove(&cantSelectCell);
			}

		//
		// Combine the selection if necessary
		//
		if (fCommandKey && !fGridView->GetSingleSelection())
			if (fDeselecting)
			{
				TGridViewDesignator saveThisSelection(*fThisSelection);
				fThisSelection->Set(&fPreviousSelection);
				fThisSelection->Remove(&saveThisSelection);
			}
			else
				fThisSelection->Append(&fPreviousSelection);
	}
}

//----------------------------------------------------------------------------------------
// TCellSelectCommand::HighlightNewSelection:
//----------------------------------------------------------------------------------------

void TCellSelectCommand::HighlightNewSelection()
{
	// Turn off previously selected cells
	HLState	currentHL = fGridView->GetCurrentHL();
	TGridViewDesignator difference(fPreviousSelection);
	difference.Remove(fThisSelection);
	fGridView->HighlightCells(&difference, currentHL, hlOff);

	// Turn on newly selected cells
	difference.Set(fThisSelection);
	difference.Remove(&fPreviousSelection);
	fGridView->HighlightCells(&difference, hlOff, currentHL);
}

//----------------------------------------------------------------------------------------
// TCellSelectCommand::TrackFeedback:
//----------------------------------------------------------------------------------------

void TCellSelectCommand::TrackFeedback(TrackPhase			aTrackPhase,
									   const CViewPoint&	anchorPoint,
									   const CViewPoint&	previousPoint,
									   const CViewPoint&	nextPoint,
									   bool					mouseDidMove,
									   bool					turnItOn)
{
	#pragma unused (aTrackPhase, anchorPoint, previousPoint, nextPoint, mouseDidMove, turnItOn)
}

//----------------------------------------------------------------------------------------
// TCellSelectCommand::TrackMouse:
//----------------------------------------------------------------------------------------

TTracker* TCellSelectCommand::TrackMouse(TrackPhase		aTrackPhase,
										 CViewPoint&	anchorPoint,
										 CViewPoint&	previousPoint,
										 CViewPoint&	nextPoint,
										 bool			mouseDidMove)
{
	#pragma unused (anchorPoint, previousPoint)

	if (mouseDidMove)
	{
		CViewPoint clippedPoint(nextPoint);
		CViewRect clippingRect(fGridView->GetVisibleRect());
		clippingRect.bottom -= 1;	// Don't select cells whose only visible portion is their border.
		clippingRect.right -= 1;

		clippedPoint.ConstrainTo(clippingRect);
		GridCell clickedCell = fGridView->VPointToCell(clippedPoint);
		if (aTrackPhase == trackBegin)
		{
			ComputeAnchorCell(clickedCell);
			if (fCommandKey)
				fDeselecting = fGridView->GetSelections()->Contains(fAnchorCell);
		}

		if (clickedCell != fPreviousCell)
		{
			ComputeNewSelection(clickedCell);
			HighlightNewSelection();

			fPreviousSelection.Set(fThisSelection);
			fPreviousCell = clickedCell;
		}
	}

	return this;
}

//----------------------------------------------------------------------------------------
// TCellSelectCommand::DoIt:
//----------------------------------------------------------------------------------------

void TCellSelectCommand::DoIt()
{
	if (fGridView->GetSingleSelection())
		fGridView->SelectCell(fThisSelection->GetBounds()[topLeft], kDontExtend, kDontHighlight, kSelect);
	else
		fGridView->SetSelection(fThisSelection, kDontExtend, kDontHighlight, kSelect);

	fGridView->HandleEvent (mListItemHit, fGridView, NULL);
}

//========================================================================================
// CLASS TRCSelectCommand
//========================================================================================

//----------------------------------------------------------------------------------------
// TRCSelectCommand destructor
//----------------------------------------------------------------------------------------

TRCSelectCommand::~TRCSelectCommand()
{
}

//----------------------------------------------------------------------------------------
// TRCSelectCommand::ComputeNewSelection:
//----------------------------------------------------------------------------------------

void TRCSelectCommand::ComputeNewSelection(const GridCell& clickedCell)
{
	if (fGridView->CanSelectCell(clickedCell))
	{
		GridRect r;

		// ���  testing removal of this.  RCSelect needs multiple cell selection even with single selection marked.
		//if (fGridView->GetSingleSelection())
		//	r = GridRect(clickedCell, clickedCell + GridCell(1, 1));
		//else
		//{
			r = GridRect(fAnchorCell, clickedCell);
			r.Validate();
			++r[botRight];
		//}
		fThisSelection->Set(r);

		//
		// Remove unselectable cells
		//
		TGridViewDesignator cantSelectCell;
    	for (CCellInRegionIterator iter(fGridView, fThisSelection); iter; ++iter)
			if (!fGridView->CanSelectCell(iter))
			{
				GridCell unSelCell(iter);

				cantSelectCell.Set(GridRect(unSelCell.h, unSelCell.v, unSelCell.h + 1, unSelCell.v + 1));
				fThisSelection->Remove(&cantSelectCell);
			}

		//
		// Combine the selection if necessary
		//
		if (fCommandKey && (!fGridView->GetSingleSelection()))
			if (fDeselecting)
			{
				TGridViewDesignator saveThisSelection(*fThisSelection);
				fThisSelection->Set(&fPreviousSelection);
				fThisSelection->Remove(&saveThisSelection);
			}
			else
				fThisSelection->Append(&fPreviousSelection);
	}
}

//----------------------------------------------------------------------------------------
// TRCSelectCommand::TrackMouse:
//----------------------------------------------------------------------------------------

TTracker* TRCSelectCommand::TrackMouse(TrackPhase	aTrackPhase,
									   CViewPoint&	anchorPoint,
									   CViewPoint&	previousPoint,
									   CViewPoint&	nextPoint,
									   bool			mouseDidMove)
{
	#pragma unused (anchorPoint, previousPoint)

	if (mouseDidMove)
	{
		CViewPoint clippedPoint(nextPoint);
		CViewRect clippingRect(fGridView->GetVisibleRect());
		clippingRect.bottom -= 1;	// Don't select cells whose only visible portion is their border.
		clippingRect.right -= 1;

		clippedPoint.ConstrainTo(clippingRect);
		GridCell clickedCell = fGridView->VPointToCell(clippedPoint);
		if (aTrackPhase == trackBegin)
		{
			ComputeAnchorCell(clickedCell);
			if (fCommandKey)
				fDeselecting = fGridView->GetSelections()->Contains(fAnchorCell);
		}

		if (clickedCell != fPreviousCell)
		{
			if (!fShiftKey && (aTrackPhase != trackBegin))
			{
				ComputeAnchorCell(clickedCell);
				if (fCommandKey)
					fDeselecting = fGridView->GetSelections()->Contains(fAnchorCell);
			}
			ComputeNewSelection(clickedCell);
			HighlightNewSelection();

			fPreviousSelection.Set(fThisSelection);
			fPreviousCell = clickedCell;
		}
	}

	return this;
}

//========================================================================================
// CLASS TRowSelectCommand
//========================================================================================

//----------------------------------------------------------------------------------------
// TRowSelectCommand destructor
//----------------------------------------------------------------------------------------

TRowSelectCommand::~TRowSelectCommand()
{
}

//----------------------------------------------------------------------------------------
// TRowSelectCommand::ComputeAnchorCell:
//----------------------------------------------------------------------------------------

void TRowSelectCommand::ComputeAnchorCell(const GridCell& clickedCell)
{
	TRCSelectCommand::ComputeAnchorCell(clickedCell);
	fAnchorCell.h = 1;
}

//----------------------------------------------------------------------------------------
// TRowSelectCommand::ComputeNewSelection:
//----------------------------------------------------------------------------------------

void TRowSelectCommand::ComputeNewSelection(const GridCell& clickedCell)
{
	GridCell newClickedCell(clickedCell);
	newClickedCell.h = fGridView->GetNumOfCols();

	TRCSelectCommand::ComputeNewSelection(newClickedCell);
}

//========================================================================================
// CLASS TColumnSelectCommand
//========================================================================================

//----------------------------------------------------------------------------------------
// TColumnSelectCommand destructor
//----------------------------------------------------------------------------------------

TColumnSelectCommand::~TColumnSelectCommand()
{
}

//----------------------------------------------------------------------------------------
// TColumnSelectCommand::ComputeAnchorCell:
//----------------------------------------------------------------------------------------

void TColumnSelectCommand::ComputeAnchorCell(const GridCell& clickedCell)
{
	TRCSelectCommand::ComputeAnchorCell(clickedCell);

	fAnchorCell.v = 1;
}

//----------------------------------------------------------------------------------------
// TColumnSelectCommand::ComputeNewSelection:
//----------------------------------------------------------------------------------------

void TColumnSelectCommand::ComputeNewSelection(const GridCell& clickedCell)
{
	GridCell newClickedCell(clickedCell);
	newClickedCell.v = fGridView->GetNumOfRows();

	TRCSelectCommand::ComputeNewSelection(newClickedCell);
}

//========================================================================================
// CLASS CRowIterator
//========================================================================================

//----------------------------------------------------------------------------------------
// CRowIterator::CRowIterator:
//----------------------------------------------------------------------------------------

CRowIterator::CRowIterator(const TGridView* itsGridView, bool itsForward)
// CRowIterator is a constructor that initializes an instance for iteration
// over rows.
//
// itsGridView:		Specifies the instance of TGridView or one of its subclasses
// 					over whose rows you want to iterate.
// startRow:		Specifies the first row for iteration. If the constructor does
// 					not use this parameter, the first row is the first row in the TGridView object.
// stopRow:			Specifies the last row for iteration. If the constructor does
// 					not use this parameter, the last row is the last row in the TGridView object.
// itsForward:		Specifies the direction of iteration over the columns of the
// 					TGridView object: true for forward iteration and false for backward
// 					iteration. If the constructor does not use this parameter, iteration is forward.
//
// Call?		As needed. You typically define an instance with
//				these parameters when you want to specify the boundary for iteration over
// 				elements in the dynamic array. If you subclass CRowIterator, you must
// 				call this constructor from the subclass constructor.
{
	IRowIterator(itsGridView, 1, itsGridView->GetNumOfRows(), itsForward);
}

//----------------------------------------------------------------------------------------
// CRowIterator::CRowIterator:
//----------------------------------------------------------------------------------------

CRowIterator::CRowIterator(const TGridView* itsGridView)
{
	IRowIterator(itsGridView, 1, itsGridView->GetNumOfRows(), kIterateForward_AC);
}

//----------------------------------------------------------------------------------------
// CRowIterator::IRowIterator:
//----------------------------------------------------------------------------------------

void CRowIterator::IRowIterator(const TGridView*	itsGridView,
								GridCoordinate		startRow,
								GridCoordinate		stopRow,
								bool				itsForward)
{
	if (itsGridView)
	{
		fFirstRow = Max_AC(kMinCell, startRow);
		fLastRow = Min_AC(itsGridView->GetNumOfRows(), stopRow);
		fIterateForward = itsForward;
	}
	else
	{
		fFirstRow = 0;
		fLastRow = 0;
		fIterateForward = kIterateForward_AC;
	}

	First();								// this sets it to the beginning
}

//----------------------------------------------------------------------------------------
// CRowIterator::First:
//----------------------------------------------------------------------------------------

GridCoordinate CRowIterator::First()
{
	return fCurrent = fFirstRow <= fLastRow ? (fIterateForward ? fFirstRow : fLastRow) : 0;
}

//----------------------------------------------------------------------------------------
// CRowIterator::Next:
//----------------------------------------------------------------------------------------

GridCoordinate CRowIterator::Next()
{
	if (fCurrent)
		if (fIterateForward)
			fCurrent = (fCurrent < fLastRow) ? fCurrent + 1 : 0;
		else
			fCurrent = (fCurrent > fFirstRow) ? fCurrent - 1 : 0;

	return fCurrent;
}

//========================================================================================
// CLASS CColumnIterator
//========================================================================================

//----------------------------------------------------------------------------------------
// CColumnIterator::CColumnIterator:
//----------------------------------------------------------------------------------------

CColumnIterator::CColumnIterator(const TGridView* itsGridView, bool itsForward)
// CColumnIterator is a constructor that initializes an instance for iteration
// over columns.
//
// itsGridView:		specifies the instance of TGridView or one of its subclasses
// 					over whose columns you want to iterate.
// startColumn:		specifies the first column for iteration. If the constructor
// 					does not use this parameter, the first column is the first
//					column in the TGridView object.
// stopColumn:		specifies the last column for iteration. If the constructor
// 					does not use this parameter, the last column is the last column
// 					in the TGridView object.
// itsForward:		specifies the direction of iteration over the columns of the TGridView
// 					object: TRUE for forward iteration and FALSE for backward iteration. If
// 					the constructor does not use this parameter, iteration is forward.
//
// Call?		As needed. You typically define an instance with
//				these parameters when you want to specify the boundary for iteration
// 				over elements in the dynamic array. If you subclass CColumnIterator,
// 				you must call this constructor from the subclass constructor.
{
	IColumnIterator(itsGridView, 1, itsGridView->GetNumOfCols(), itsForward);
}

//----------------------------------------------------------------------------------------
// CColumnIterator::CColumnIterator:
//----------------------------------------------------------------------------------------

CColumnIterator::CColumnIterator(const TGridView* itsGridView)
{
	IColumnIterator(itsGridView, 1, itsGridView->GetNumOfCols(), kIterateForward_AC);
}

//----------------------------------------------------------------------------------------
// CColumnIterator::IColumnIterator:
//----------------------------------------------------------------------------------------

void CColumnIterator::IColumnIterator(const TGridView*	itsGridView,
									  GridCoordinate	startColumn,
									  GridCoordinate	stopColumn,
									  bool				itsForward)
{
	if (itsGridView)
	{
		fFirstColumn = Max_AC(kMinCell, startColumn);
		fLastColumn = Min_AC(itsGridView->GetNumOfCols(), stopColumn);
		fIterateForward = itsForward;
	}
	else
	{
		fFirstColumn = 0;
		fLastColumn = 0;
		fIterateForward = kIterateForward_AC;
	}

	First();								// this sets it to the beginning
}

//----------------------------------------------------------------------------------------
// CColumnIterator::First:
//----------------------------------------------------------------------------------------

GridCoordinate CColumnIterator::First()
{
	return fCurrent = fFirstColumn <= fLastColumn ? (fIterateForward ? fFirstColumn : fLastColumn) : 0;
}

//----------------------------------------------------------------------------------------
// CColumnIterator::Next:
//----------------------------------------------------------------------------------------

GridCoordinate CColumnIterator::Next()
{
	if (fCurrent)
		if (fIterateForward)
			fCurrent = (fCurrent < fLastColumn) ? fCurrent + 1 : 0;
		else
			fCurrent = (fCurrent > fFirstColumn) ? fCurrent - 1 : 0;

	return fCurrent;
}

//========================================================================================
// CLASS CCellIterator
//========================================================================================

const GridCell CCellIterator::kNullCell;
const bool CCellIterator::kIterateRowMajor = true;

//----------------------------------------------------------------------------------------
// CCellIterator::CCellIterator:
//----------------------------------------------------------------------------------------

CCellIterator::CCellIterator(const TGridView*	itsGridView,
							 const GridCell&	startCell,
							 const GridCell&	stopCell,
							 bool				itsRowForward,
							 bool				itsColumnForward,
							 bool				itsRowMajor)
	// initialize the Row and Column Iterators first!
	:	fRowIterator(itsGridView, startCell.v, stopCell.v, itsRowForward),
		fColumnIterator(itsGridView, startCell.h, stopCell.h, itsColumnForward)
// CCellIterator is a constructor that initializes an instance for iteration
// over cells.
//
// itsGridView:			specifies the instance of TGridView or one of its subclasses
// 						over whose cells you want to iterate.
// startCell:			specifies the first cell for iteration. If the constructor does
// 						not use this parameter, the first cell is the first cell in the TGridView object.
// stopCell:			specifies the last cell for iteration. If the constructor does
// 						not use this parameter, the last cell is the last cell in the TGridView object.
// itsRowForward: 		specifies:	the direction of iteration over the rows of the TGridView object:
// 						TRUE for forward iteration and FALSE for backward iteration. If the constructor
// 						does not use this parameter, iteration is forward.
// itsColumnForward:	specifies the direction of iteration over the columns of the TGridView
// 						object: true for forward iteration and false for backward iteration. If
// 						the constructor does not use this parameter, iteration is forward.
// itsRowMajor:			specifies whether the rows or columns will be iterated over
// 						first. true specifies that the cells in the row will be iterated over
//						first(left-to-right or right-to-left, depending upon the itsRowForward
// 						parameter); false specifies that the cells in the columns will be iterated
// 						over first(top-to-bottom or bottom-to-top, depending upon the itsColumnForward
// 						parameter). If the constructor does not use this parameter, the iteration first
// 						proceeds over the cells in the row.
//
// Call?		As needed. You typically define an instance with these parameters when you want to
//				specify the boundary for iteration over elements in the dynamic array. If you
// 				subclass CCellIterator, you must call this constructor from the subclass constructor.
{
	fIterateRowMajor = itsRowMajor;				// don't worry about whether or not
	// itsGridView is valid -- let the Row and
	// Column Iterators worry about it.

	First();
}

//----------------------------------------------------------------------------------------
// CCellIterator::CCellIterator:
//----------------------------------------------------------------------------------------

CCellIterator::CCellIterator(const TGridView*	itsGridView,
							 bool				itsRowForward,
							 bool				itsColumnForward,
							 bool				itsRowMajor)
	// initialize the Row and Column Iterators first!
	:	fRowIterator(itsGridView, itsRowForward),
		fColumnIterator(itsGridView, itsColumnForward)
{
	fIterateRowMajor = itsRowMajor;				// don't worry about whether or not
	// itsGridView is valid -- let the Row and
	// Column Iterators worry about it.

	First();
}

//----------------------------------------------------------------------------------------
// CCellIterator::CCellIterator:
//----------------------------------------------------------------------------------------

CCellIterator::CCellIterator(const TGridView* itsGridView)
	// initialize the Row and Column Iterators first!
	:	fRowIterator(itsGridView),
		fColumnIterator(itsGridView)
{
	fIterateRowMajor = kIterateRowMajor;		// don't worry about whether or not
	// itsGridView is valid -- let the Row and
	// Column Iterators worry about it.

	First();
}

//----------------------------------------------------------------------------------------
// CCellIterator::First:
//----------------------------------------------------------------------------------------

GridCell CCellIterator::First()
{
	return fCurrent = GridCell(fColumnIterator.First(), fRowIterator.First());
}

//----------------------------------------------------------------------------------------
// CCellIterator::Next:
//----------------------------------------------------------------------------------------

GridCell CCellIterator::Next()
{
	if (fIterateRowMajor)
	{
		fCurrent.h = fColumnIterator.Next();
		if (!fCurrent.h)
		{
			fCurrent.v = fRowIterator.Next();
			if (fCurrent.v)			//must go through the columns again
				fCurrent.h = fColumnIterator.First();
		}
	}
	else
	{
		fCurrent.v = fRowIterator.Next();
		if (!fCurrent.v)
		{
			fCurrent.h = fColumnIterator.Next();
			if (fCurrent.h)			//must go through the rows again
				fCurrent.v = fRowIterator.First();
		}
	}

	return fCurrent;
}

//========================================================================================
// CLASS CCellInRegionIterator
//========================================================================================

//----------------------------------------------------------------------------------------
// CCellInRegionIterator::CCellInRegionIterator: an iterator class designed to replace the
// EachInRegion method of TGridView. APW 7-15
//----------------------------------------------------------------------------------------

CCellInRegionIterator::CCellInRegionIterator(const TGridView*			itsGridView,
											 const TGridViewDesignator*	aRegion,
											 bool						itsRowForward,
											 bool						itsColumnForward,
											 bool						itsRowMajor)
	:	CCellIterator(itsGridView,
					  aRegion->GetBounds()[topLeft],
					  aRegion->GetBounds()[botRight] - GridCell(1, 1),
					  itsRowForward,
					  itsColumnForward,
					  itsRowMajor),
		fRegion(aRegion)
// CCellInRegionIterator is a constructor that initializes an instance for
// iteration over cells in a specified region.
//
// itsGridView:			specifies the instance of TGridView or one of its subclasses
// 						over whose cells you want to iterate.
// aRegion:				specifies the region over whose cells you want to iterate.
// itsRowForward:		specifies the direction of iteration over the rows of the TGridView object:
// 						TRUE for forward iteration and FALSE for backward iteration. If the
// 						constructor does not use this parameter, iteration is forward.
// itsColumnForward: 	specifies the direction of iteration over the columns of the TGridView
// 						object: true for forward iteration and false for backward iteration. If
// 						the constructor does not use this parameter, iteration is forward.
// itsRowMajor:			specifies the whether rows or columns will be iterated over
// 						first. true specifies that the cells in the row will be iterated
// 						over first(left-to-right or right-to-left, depending upon the
// 						itsRowForward parameter); false specifies that the cells in the columns
// 						will be iterated over first(top-to-bottom or bottom-to-top, depending upon
// 						the itsColumnForward parameter). If the constructor does not use this
// 						parameter, iteration first proceeds over the cells in the row.
//
// Call?		As needed. You typically define an instance with
//				these parameters when you want to specify the boundary for iteration over elements in the dynamic array. If you subclass CCellInRegionIterator, you must call this constructor from the subclass constructor.
{
	First();
}

//----------------------------------------------------------------------------------------
// CCellInRegionIterator::CCellInRegionIterator:
//----------------------------------------------------------------------------------------

CCellInRegionIterator::CCellInRegionIterator(const TGridView* itsGridView,
											 const TGridViewDesignator* aRegion)
	:	CCellIterator(itsGridView, aRegion->GetBounds()[topLeft], aRegion->GetBounds()[botRight] - GridCell(1, 1), kIterateForward_AC, kIterateForward_AC, kIterateRowMajor),
		fRegion(aRegion)
{
	First();
}

//----------------------------------------------------------------------------------------
// CCellInRegionIterator::First:
//----------------------------------------------------------------------------------------

GridCell CCellInRegionIterator::First()
{
	CCellIterator::First();

	// It doesn't, so we'll get the next  one, which is guaranteed to either meet the criteria, or be NULL
	if (!CellIsInRegion())
		Next();

	return fCurrent;
}

//----------------------------------------------------------------------------------------
// CCellInRegionIterator::Next:
//----------------------------------------------------------------------------------------

GridCell CCellInRegionIterator::Next()
{
	CCellIterator::Next();					//first advance

	while (*this && !CellIsInRegion())
		CCellIterator::Next();
		// run out or find one.

	return fCurrent;
}

//----------------------------------------------------------------------------------------
// CCellInRegionIterator::CellIsInRegion:
//----------------------------------------------------------------------------------------

bool CCellInRegionIterator::CellIsInRegion()
{
	return *this ? fRegion->Contains(Current()) : false;
}

//========================================================================================
// CLASS CSelectedCellIterator
//========================================================================================

//----------------------------------------------------------------------------------------
// CSelectedCellIterator::CSelectedCellIterator: an iterator class designed to replace the
// EachSelectedCellDo method of TGridView. APW 7-15
//----------------------------------------------------------------------------------------

CSelectedCellIterator::CSelectedCellIterator(const TGridView*	itsGridView,
											 bool				itsRowForward,
											 bool				itsColumnForward,
											 bool				itsRowMajor)
	:	CCellInRegionIterator(itsGridView,
							  itsGridView->GetSelections(),
							  itsRowForward,
							  itsColumnForward,
							  itsRowMajor)
// CSelectedCellIterator is a constructor that initializes an instance for
// iteration over the currently selected cells in a TGridView object.
//
// itsGridView:			Specifies the instance of TGridView or one of its subclasses
// 						over whose cells you want to iterate.
// itsRowForward: 		Specifies the direction of iteration over the rows of the TGridView object:
// 						true for forward iteration and false for backward iteration. If the
// 						constructor does not use this parameter, iteration is forward.
// itsColumnForward: 	Specifies the direction of iteration over the columns of the TGridView
// 						object: true for forward iteration and false for backward iteration. If
// 						the constructor does not use this parameter, iteration is forward.
// itsRowMajor:			Specifies the whether rows or columns will be iterated over
// 						first. true specifies that the cells in the row will be iterated over
// 						first(left-to-right or right-to-left, depending upon the itsRowForward parameter);
// 						false specifies that the cells in the columns will be iterated over first
// 						(top-to-bottom or bottom-to-top, depending upon the itsColumnForward
// 						parameter). If the constructor does not use this parameter, iteration first
// 						proceeds over the cells in the row.
//
// Call?		As needed. You typically define an instance with these parameters
//				when you want to specify the boundary for iteration over elements in
// 				the dynamic array. If you subclass CSelectedCellIterator, you must
// 				call this constructor from the subclass constructor.
{
	First();
}

//----------------------------------------------------------------------------------------
// CSelectedCellIterator::CSelectedCellIterator:
//----------------------------------------------------------------------------------------

CSelectedCellIterator::CSelectedCellIterator(const TGridView* itsGridView)
	:	CCellInRegionIterator(itsGridView, itsGridView->GetSelections())
{
	First();
}

//----------------------------------------------------------------------------------------
// End of UGridView.cpp

/*
	Historical Change Record:
		----- R11 -----
		06/27/96	Make conditional tests implicit as in if(x) instead of if(x != 0).
		06/26/96	Changed nil back to NULL.
		06/26/96	Install release marker.  Scope many globals.  Change TRUE/FALSE/NULL.
		 6/25/96	Fix compile bug in TTextGridView::DoFulfillPromise with SCpp.
		 6/25/96	[1336165] (Views, GridViews) TTextGridView::DoFulfillPromise.
		 6/20/96	[1234410] Add DoEvent call to TCellSelectCommand::DoIt.
		 6/20/96	[1296414] Constrain selection processing to visible rect rather than view extent.
		 5/17/96	Fix a bug I had introduced where a single cell selection was considered a null selecton.
		 					Begin Preparing TRunArray to be split out into a separate file.
		 5/08/96	Cleanup CRGBColor_AC and add new class CTextStyle_AC
		 4/26/96	Made C/CViewPoint/Rect default constructors set the point/rect to a cleared value. Made
		 					clearing very fast/compact. Eliminated the now unnecessary hand clearing of C/CViewPoint/Rects.
		04/25/96	More use of CTempxxx classes instead of Failure handling where poss.
		04/25/96	Added MINIMAL support for >32k views. Made several methods take const GridCell&
							instead of copies of GridCells in order to facilitate the difference
		04/24/96	Use PRE-Increment/Decrement operators whenever possible for eff.
		04/24/96	In TGridView::DrawRangeOfCells use an iterator to control the drawing and
							initialize it with TGridView::fDrawRowsForward/fDrawColsForward/fDrawRowMajor
							to allow easy control of the drawing order
		04/23/96	Use CTempObject/Handle/Region/Ptr, etc.
		04/23/96	Update iterators to be OD stylish.
		04/18/96	More Use post-increment with iterators in while loops
		04/18/96	Use post-increment with iterators in while loops
		----- R10 -----
		04/01/96	Fix two bugs in TTextListView::DoKeySelection. First, since string comparisons
							are case sensitive by default now, we were failing to get matches. Second, the
							iteration would proceed until the displayed text was greater than or equal to the
							selection to match against. This would cause the wrong item to be selected.w
		03/29/96	TRunArray uses CDynamicArray_AC
		03/28/96	CalcMinFrame now returns a CViewRect, Cell/Col/RowToVRect returns a CViewRect
		03/26/96	Cleanup Iterator::More/Reset to use selection operators
		03/26/96	CStr255_AC to char* conversion now requires const
		03/21/96	[1330950] Made sure last caret is erased on drag.
		 3/18/96	Made better use of TView calls that return CRect_AC/CViewPoint/CViewRect
		03/14/96	Use CPascalStr_AC::Empty.
		03/11/96	Add empty override of CSelectedCellIterator::Reset in order to have
							a "key function" that inhibits the generation of extraneous VTables
							all over the place wherever the .h file or dump file are included.
		 1/23/95	[114616] Many minor bugs in MacApp 3.3 final.
		 12/8/95	Include UDispatcher instead of UApplication.
		----- 3.3 -----
		 11/1/95	Fixed grayishTextOr drawing of disabled text.
		 11/1/95	Make drag cursor and script idle code resident.
		10/19/95	Use MoveToPt, LineToPt.
		----- 3.3b1 -----
		 5/17/95	WindowRef.
		 5/17/95	Don't call TView::DoAddDragContent.
		 4/23/95	Fix endif qDrag to get past picky compilers.
		  4/6/95	Really fixed conditional compile of qDrag.
		  4/4/95	Fixed conditional compile of qDrag.
		 3/30/95	Fix incorrect tab/newline delimiting in TTextGridView.
		 					Change AddDragContent to DoAddDragContent.
		 					Change FulfillPromise to DoFulfillPromise.
		 					Change DragEnter to DoDragEnter.
		 					Change DragWithin to DoDragWithin.
		 					Change DragLeave to DoDragLeave.
		 					Change MakeDragCursorRegion to DoMakeDragCursorRegion.
		 3/28/95	TGridView is draggable/droppable.
		 3/17/95	MAVolatile.
		 3/13/95	Change Free methods to destructors.
		  3/9/95	Went back to the real version of Ken's fix for computing startCell.
							Our version was adjusting it too late.
		 2/28/95	Use MA_REGISTER_SIGNATURE instead of macroDontDeadStrip
							and RegisterStdType.
		 2/19/95	Undid previous change.
		 2/13/95	make "p" (private) globals static
		  2/3/95	In TGridView::Draw, if fAdornCols or fAdornRows is true,
							start drawing from one column or row further back to the
							left or the top.
		11/15/94	Ken's fixes to Draw caused "long assigned to
							short" warnings in CFront.  Added casts to prevent
							warnings.
		11/13/94	Remove DragFeedback and DrawCaret.
							Ken Ryall fixed a couple of small
							bugs in Draw where startCell was
							being miscalculated.
		 9/12/94	Added TGridView::DragFeedback and
							TGridView::DrawCaret per Eric Hanig's
							MADrag additions.
*/