//----------------------------------------------------------------------------------------
// UTearOffMenu.cpp
// Copyright © 1988-2001 by Apple Computer, Inc. All rights reserved.
//----------------------------------------------------------------------------------------

/*
	Change History
		01/02/01	Update copyright.
		11/15/00	The menu view now provides a specific hook for tear off menus. 
		11/09/00	[PB] Change initialization order to match declaration. 
		11/01/00	[PB] Include MacErrors instead of Errors. 
		03/29/99	Rename Patterns_AC to CPattern_AC to avoid confusion with the
					include file. 
		03/24/99	Update copyright notice.
		03/23/99	Go back to native Toolbox region calls.
		03/23/99	Renamed SetPenPatToGray_AC to Patterns_AC::SetPenPatToGray.
		02/11/99	[C] Call Bounds instead of accessing rgnBBox directly.
		11/06/98	CarbonSeed110398 - change GetWindowStructureRegion to GetWindowRegion(w, kWindowStructureRgn, rgn);
		11/05/98	Carbon - use SetPenPatToGray_AC
		10/29/98	[W] It is no longer necessary to include QTMLMapNames.h.  Use
					FrameRgn_AC, OffsetRgn_AC.  Include ImagingUtils_AC.h.
		10/27/98	Carbonize
*/

#ifndef __UTEAROFFMENUVIEW__
#include "UTearOffMenuView.h"
#endif

// MacApp

#ifndef __UDISPATCHER__
#include "UDispatcher.h"
#endif

#ifndef __UGEOMETRY__
#include "UGeometry.h"
#endif

#ifndef __UMACAPPGLOBALS__
#include "UMacAppGlobals.h"
#endif

#ifndef __UMACAPPUTILITIES__
#include "UMacAppUtilities.h"
#endif

#ifndef __UPATCH__
#include "UPatch.h"
#endif

#ifndef __PLATFORMMEMORY__
#include "PlatformMemory.h"
#endif

#ifndef __UPOINTEROBJECT__
#include "UPointerObject.h"
#endif

#ifndef __UWINDOW__
#include "UWindow.h"
#endif

// ACS

#ifndef __CRegion_AC__
#include "CRegion_AC.h"
#endif

#ifndef __ImagingUtils_AC__
#include "ImagingUtils_AC.h"
#endif

// Toolbox

#ifndef __DIALOGS__
#include <Dialogs.h>
#endif

#ifndef __LOWMEM__
#include <LowMem.h>
#endif

#ifndef __MACERRORS__
#include <MacErrors.h>
#endif

#ifndef __TEXTEDIT__
#include <TextEdit.h>
#endif

#ifndef __TOOLUTILS__
#include <ToolUtils.h>
#endif

//========================================================================================
// CLASS TShowTearOffWindowCommand
//========================================================================================
#undef Inherited
#define Inherited TCommand

//----------------------------------------------------------------------------------------
// TShowTearOffWindowCommand constructor
//----------------------------------------------------------------------------------------

TShowTearOffWindowCommand::TShowTearOffWindowCommand(TWindow* tearOffWindow,
														 CPoint_AC where) :
	TCommand(cNoCommand, NULL, kCantUndo, kDoesNotCauseChange, NULL),
	fWhere(where),
	fTearOffWindow(tearOffWindow)
{
}

//----------------------------------------------------------------------------------------
// TShowTearOffWindowCommand destructor
//----------------------------------------------------------------------------------------

TShowTearOffWindowCommand::~TShowTearOffWindowCommand()
{
}

//----------------------------------------------------------------------------------------
// TShowTearOffWindowCommand::DoIt: 
//----------------------------------------------------------------------------------------

void TShowTearOffWindowCommand::DoIt()	// override 
{
	if (fTearOffWindow)
	{
		fTearOffWindow->Show(false, false);			// Hide the window so that Open will call
		fTearOffWindow->SetMustForceOnScreen(true);	// ForceOnScreen before showing
		fTearOffWindow->SetForcedOnScreen(false);
		
		fTearOffWindow->Locate(fWhere, kDontInvalidate);
		
		fTearOffWindow->Open();						// show the torn-off window 
		
		fTearOffWindow->Select();					// select the torn-off window 
	}
}

//========================================================================================
// CLASS TTearOffMenuViewTracker
//========================================================================================
#undef Inherited
#define Inherited TTracker

//----------------------------------------------------------------------------------------
// TTearOffMenuViewTracker destructor
//----------------------------------------------------------------------------------------

TTearOffMenuViewTracker::~TTearOffMenuViewTracker()
{
}

//----------------------------------------------------------------------------------------
// TTearOffMenuViewTracker::IsReadyToPost: 
//----------------------------------------------------------------------------------------

bool TTearOffMenuViewTracker::IsReadyToPost()	// override
{
	gDispatcher->SetEventLevel(gDispatcher->GetEventLevel() + 1);
	Process();				// perform this right away
	gDispatcher->SetEventLevel(gDispatcher->GetEventLevel() - 1);

	return false;
}


//========================================================================================
// CLASS TTearOffTracker
//========================================================================================
#undef Inherited
#define Inherited TTearOffMenuViewTracker

//----------------------------------------------------------------------------------------
// TTearOffTracker constructor
//----------------------------------------------------------------------------------------

TTearOffTracker::TTearOffTracker(CPoint_AC hitPt, TTearOffMenuView* tearOffMenu) :
	TTearOffMenuViewTracker(cNoCommand, NULL, kCantUndo, kDoesNotCauseChange, NULL,
					NULL, NULL, CViewPoint(hitPt)),

	fTearOffWindowOutline(MakeNewRgn()),
	fTearOffMenu(tearOffMenu),
	fExitTracking(false)
{
	fFreeOnCompletion = false;
}

//----------------------------------------------------------------------------------------
// TTearOffTracker::Free: 
//----------------------------------------------------------------------------------------

TTearOffTracker::~TTearOffTracker()
{
}

//----------------------------------------------------------------------------------------
// TTearOffTracker::DoIt: 
//----------------------------------------------------------------------------------------

void TTearOffTracker::DoIt()
{
	if (!fExitTracking)					// ensure that we didn't exit the tracking loop
	{
		TWindow * aTearOffWindow = fTearOffMenu->fTearOffWindow;

		CPoint_AC where = fTearOffWindowOutline.Bounds()[topLeft] + aTearOffWindow->GetContentRegionInset();

		if (aTearOffWindow)
			fTearOffMenu->PostCommand(TH_new TShowTearOffWindowCommand(aTearOffWindow, where));
			// NOTE: we can't just move and show the tear off window here because the menu
            // that we want to tear off is currently displayed on the screen and the menu
            // manager has cached the bits underneath the currently displayed menu and we
            // might be moving our floating window into that territory thus invalidating
            // the menu manager's cache (which the menu manager will blit back in place
            // momentarily). To work-around this "feature" we'll simply post a command
            // which will do the work later. Isn't MacApp wonderful!
	}
}

//----------------------------------------------------------------------------------------
// TTearOffTracker::TrackFeedback: 
//----------------------------------------------------------------------------------------

void TTearOffTracker::TrackFeedback(TrackPhase /* aTrackPhase */,
									const CViewPoint& /* anchorPoint */,
									const CViewPoint& /* previousPoint */,
									const CViewPoint& /* nextPoint */,
									bool mouseDidMove,
									bool /* turnItOn */)
{
	if (mouseDidMove && !EmptyRgn(fTearOffWindowOutline))
	{
		CPattern_AC::SetPenPatToGray();
		::MacFrameRgn(fTearOffWindowOutline);		// draw/erase 
	}
}

//----------------------------------------------------------------------------------------
// TTearOffTracker::TrackMouse: 
//----------------------------------------------------------------------------------------

TTracker* TTearOffTracker::TrackMouse(TrackPhase aTrackPhase,
									  CViewPoint& ,
									  CViewPoint& previousPoint,
									  CViewPoint& nextPoint,
									  bool)
{
	TWindow * aTearOffWindow;
	short verticalOffset;
	short horizontalOffset;
	bool rgnsWereBuilt;

	CPoint_AC qdPt = nextPoint.ToPoint();
	fExitTracking =!PtInRgn(qdPt, fTearOffMenu->fTearOffTrackingRegion);

	if (aTrackPhase == trackBegin)
	{
		aTearOffWindow = fTearOffMenu->fTearOffWindow;
		if (aTearOffWindow)
		{
			rgnsWereBuilt = aTearOffWindow->BuildWindowRegions(kBuild);
#if !qCarbon
			GetWindowStructureRgn(aTearOffWindow->GetWindowRef(), fTearOffWindowOutline);
#else
			GetWindowRegion(aTearOffWindow->GetWindowRef(), kWindowStructureRgn, fTearOffWindowOutline);
#endif
			aTearOffWindow->BuildWindowRegions(rgnsWereBuilt);

			// move the outline to the topleft of the window mgr graf port 
			::MacOffsetRgn(fTearOffWindowOutline, -(fTearOffWindowOutline.Bounds().left), -(fTearOffWindowOutline.Bounds().top));

			// move the outline so that it's centered at the mouse 
			verticalOffset = fTearOffWindowOutline.Bounds().GetLength(vSel) / 2;
			horizontalOffset = fTearOffWindowOutline.Bounds().GetLength(hSel) / 2;
			::MacOffsetRgn(fTearOffWindowOutline, static_cast<short>(previousPoint.h - horizontalOffset), static_cast<short>(previousPoint.v - verticalOffset));
		}
	}
	else
		::MacOffsetRgn(fTearOffWindowOutline, static_cast<short>(nextPoint.h - previousPoint.h), static_cast<short>(nextPoint.v - previousPoint.v));
	return this;
}

//----------------------------------------------------------------------------------------
// TTearOffTracker::IsDoneTracking: 
//----------------------------------------------------------------------------------------

bool TTearOffTracker::IsDoneTracking()	// override 
{
	return ((!StillDown()) || fExitTracking);
}

//========================================================================================
// CLASS TTearOffMenuView
//========================================================================================
#undef Inherited
#define Inherited TMenuView

MA_DEFINE_CLASS(TTearOffMenuView);

//----------------------------------------------------------------------------------------
// TTearOffMenuView constructor
//----------------------------------------------------------------------------------------

TTearOffMenuView::TTearOffMenuView(ResNumber rsrcID,
								   short menuWidth,
								   short menuHeight,
								   TWindow* tearOffWindow) :
	TMenuView(rsrcID, menuWidth, menuHeight),
	fTearOffTrackingRegion(MakeNewRgn()),
	fTearOffWindow(tearOffWindow)
{
	InstallTearOffTracker();
}

//----------------------------------------------------------------------------------------
// TTearOffMenuView::InstallTearOffTracker: For the sake of efficiency when tracking a
// tear-off, we'll create the tear-off tracker and keep it with us, so we don't need to
// allocate a new tracker every time we tear off a menu. If you want a different tracker
// in your subclass of TTearOffMenuView, then override this method.
//----------------------------------------------------------------------------------------

void TTearOffMenuView::InstallTearOffTracker()
{
	fTearOffTracker = TH_new TTearOffTracker(gZeroPt, this);
}

//----------------------------------------------------------------------------------------
// TTearOffMenuView::Free: 
//----------------------------------------------------------------------------------------

TTearOffMenuView::~TTearOffMenuView()
{
}

//----------------------------------------------------------------------------------------
// TTearOffMenuView::HandleTearOff: 
//----------------------------------------------------------------------------------------

void TTearOffMenuView::HandleTearOff(MenuRef /*theMenu*/,
									 CRect_AC& menuRect,
									 CPoint_AC hitPt) // override
{
	::LocalToGlobal(hitPt);
	if (PtInRgn(hitPt, GetTearOffTrackingRegion(menuRect)))
	{
		fTearOffTracker->fInitialPt = hitPt;
		PostCommand(fTearOffTracker);
	}
}

//----------------------------------------------------------------------------------------
// TTearOffMenuView::GetTearOffTrackingRegion: This function returns
// fTearOffTrackingRegion
//----------------------------------------------------------------------------------------

RgnHandle TTearOffMenuView::GetTearOffTrackingRegion(const CRect_AC& menuRect)
{
	if (::EmptyRgn(fTearOffTrackingRegion))
	{
		CRect_AC rgnRect(menuRect);
		
		// calculate the tracking region for the tearoff image
		::LocalToGlobal(rgnRect[topLeft]);
		::LocalToGlobal(rgnRect[botRight]);
		rgnRect.Inset(-kTearOffMargin, -kTearOffMargin);

		CTempRegion_AC tempRgn;

		::RectRgn(tempRgn, rgnRect);
		::DiffRgn(GetGrayRgn(), tempRgn, fTearOffTrackingRegion);
		::InsetRgn(fTearOffTrackingRegion, 4, 4);
	}
	return fTearOffTrackingRegion;
}

//----------------------------------------------------------------------------------------
// End of UTearOffMenuView.cp



/*
	Historical Change Record:
		----- R11 -----
		06/26/96	Changed nil back to NULL.
		06/26/96	Install release marker.  Scope many globals.  Change TRUE/FALSE/NULL.
		06/26/96	==/!=NULL to implicit tests, except in the case of assignment to or passing/returning as bool/bool.
		06/12/96	Started the release process, removing triple-•, initials,
							inappropriate comments.
		 4/26/96	Made C/CViewPoint/Rect default constructors set the point/rect to a cleared value. Made
		 					clearing very fast/compact. Eliminated the now unnecessary hand clearing of C/CViewPoint/Rects.
		04/23/96	Use CTempObject/Handle/Region/Ptr, etc.
		 4/15/96	Made objectToNotify an MDependable_AC 
		----- R10 -----
		 3/18/96	Made better use of TView calls that return CRect_AC/CViewPoint/CViewRect
		12/12/95	Register torn off window with CALib. Include CALib.h
							and UContainer.h.
		 12/8/95	Split up includes for modular MacApp. 
		----- 3.3 -----
		----- 3.3b1 -----
		 7/31/95	Don't need to specify kDragOrClick for HandleMouseDown. 
		 7/31/95	ClickThrough: HandleMouseDown takes EMouseDownType param.
		 5/17/95	Use WindowRef accessors. 
		 5/16/95	WindowRef
		 3/13/95	Change Free methods to destructors. 
*/