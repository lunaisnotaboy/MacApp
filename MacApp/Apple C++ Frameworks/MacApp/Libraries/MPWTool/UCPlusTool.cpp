//----------------------------------------------------------------------------------------
// UCPlusTool.cpp
// Copyright © 1988-1999 by Apple Computer, Inc. All rights reserved.
//----------------------------------------------------------------------------------------

/*
	Change History
		12/27/99	Minor cosmetic cleanup.
		12/08/99	Fixed file name in banner.  Made many other changes such as to use
					string and keyword map.  Include iostream.
		03/24/99	Update copyright notice.
*/

#ifndef __UCPLUSTOOL__
#include "UCPlusTool.h"
#endif

#if !qCarbon

// MacApp

#ifndef __UCOREGLOBALS__
#include "UCoreGlobals.h"
#endif

#ifndef __UCOREUTILITIES__
#include "UCoreUtilities.h"
#endif

#ifndef __UNIVERSALSTARTUP__
#include "UniversalStartup.h"
#endif

// Toolbox

#ifndef __CURSORCTL__
#include <CursorCtl.h>
#endif

#ifndef __ERRMGR__
#include <ErrMgr.h>
#endif

#ifndef __FONTS__
#include <Fonts.h>
#endif

#ifndef __RESOURCES__
#include <Resources.h>
#endif

// ANSI

#ifndef __SIGNAL__
#include <signal.h>
#endif

#ifndef __STDIO__
#include <stdio.h>
#endif

#ifndef __STDLIB__
#include <stdlib.h>
#endif

#include <iostream>

//========================================================================================
// GLOBAL Variables
//========================================================================================

#if !defined(__MWERKS__)
QDGlobals qd;
#endif

// Global variables defined so that storage is allocated:
const char* gCPlusToolVersion = "1.0";
const char* kErrorMarker = "### ";
TCPlusTool* TCPlusTool::fgCPlusTool;

//========================================================================================
// GLOBAL Procedures
//========================================================================================
extern "C" void Intr(int);

//----------------------------------------------------------------------------------------
// InitUCPlusTool:
//----------------------------------------------------------------------------------------
void InitUCPlusTool()
{
	// Do Tool related initialization 
	InitGraf(&qd.thePort);
	SetFScaleDisable(true);							// per chapter in MPW guide on tools 

	InitCursorCtl(NULL);
	RotateCursor(0);

	InitErrMgr("", "", false);

	// -1 == 0xFFFFFFFF, the largest 32 bit address. Our routine StripLong uses a
	// pre-stripped address gStrippedAddress to avoid the yucky MPW glue. 

	gStrippedAddress = StripAddress((Ptr) -1);

	// Find out just what kind of environment we're dealing with here 
	if (!ValidateProcessor())
		; // do something
	if (!ValidateConfiguration())
		; // do something

	// The refnum where the application's resources should be found 
	gApplicationRefNum = CurResFile_AC();

	gToolBoxInitialized = true;
}

//----------------------------------------------------------------------------------------
// Intr:
//----------------------------------------------------------------------------------------
void Intr(int)
{
	TCPlusTool::fgCPlusTool->SetInterrupted();					// we test this switch periodically
}

//========================================================================================
// CLASS TCPlusTool
//========================================================================================
//----------------------------------------------------------------------------------------
// TCPlusTool::Stop:
//----------------------------------------------------------------------------------------
void TCPlusTool::Stop(const string& msg)
{
	cout<<flush;

	if (msg.length() > 0)
		cerr<<endl<<msg<<endl;

	if (fInterrupted)
		fRetCode = RC_Interrupted;

#if qDebugMsg
	ProgramBreak_AC(("About to stop tool:" + msg).c_str());
#endif
	throw CException_AC();
}

//----------------------------------------------------------------------------------------
// TCPlusTool::SyntaxError:
//----------------------------------------------------------------------------------------
void TCPlusTool::SyntaxError(const string& suffix)
{
	cerr << kErrorMarker << " Bad Parameter: " << suffix << "\n";
	cerr << kErrorMarker << fProgName << "<invalid option>" << endl;
	Stop("");
}

//----------------------------------------------------------------------------------------
// TCPlusTool::DoShowUsage:
//----------------------------------------------------------------------------------------
void TCPlusTool::DoShowUsage()
{
	cerr << "# Usage: " << fProgName << " [-p]" << endl;
}

//----------------------------------------------------------------------------------------
// TCPlusTool::GetNextArg:
//----------------------------------------------------------------------------------------
const string TCPlusTool::GetNextArg()
{
	if (++fArgvIndex > fArgc)
		Stop(" 		Not enough arguments ");
	return fArgv[fArgvIndex];
}

//----------------------------------------------------------------------------------------
// TCPlusTool::InstallKeyWords:
//----------------------------------------------------------------------------------------
void TCPlusTool::InstallKeyWords()
{
	KeyWordStruct keywords [] =
	{
		{"Help", kwHelp},
		{"P", kwP},				{"NoP", kwNoP},
		{"T", kwT},				{"NoT", kwNoT}
	};
	
	for (short i = 0; i < sizeof(keywords) / sizeof(KeyWordStruct); ++i)
		InstallKeyWord(keywords[i].keyword, keywords[i].keyvalue);
}

//----------------------------------------------------------------------------------------
// TCPlusTool::InstallKeyWord:
//----------------------------------------------------------------------------------------
void TCPlusTool::InstallKeyWord(const string&	keyword,
								short			kw)
{
	fKeyWordList[toupper(keyword)] = kw;
}

//----------------------------------------------------------------------------------------
// TCPlusTool::LookupKeyword:
//----------------------------------------------------------------------------------------
bool TCPlusTool::LookupKeyword(const string& keyword, short& kw)
{
	bool returnVal = false;

	string upperKeyWord = toupper(keyword);

	tKeyWordMap::const_iterator itr2 = fKeyWordList.find(upperKeyWord);
	
	if (itr2 != fKeyWordList.end())
	{
		kw = (*itr2).second;
		returnVal = true;
	}
#if qDebugMsg
	else
	{
		cerr << kErrorMarker << " TCPlusTool::LookupKeyword: could not find upperKeyWord(" << upperKeyWord 
			<< ") in fKeyWordList(" << fKeyWordList.size() << " entries)\n\n";

		int i = 0;
		for(tKeyWordMap::const_iterator itr3 = fKeyWordList.begin(); itr3 != fKeyWordList.end(); ++itr3 )
		{
			tKeyWordMap::value_type entry = (*itr3);
			cerr << "fKeyWordList[" << i++ << "]\t= ( '" << entry.first << ",\t" << entry.second << "\t)\n";
		}
		cerr << endl;
	}
#endif

	return returnVal;
}

//----------------------------------------------------------------------------------------
// TCPlusTool::ProcessArg:
//----------------------------------------------------------------------------------------
void TCPlusTool::ProcessArg(const string& arg)
{
	if (arg[0] != '-')
		DoProcessFileArg(arg);
	else
	{
		short akw;
		string realArg(arg);

		realArg.erase(0,1);					// delete the '-'
		if (LookupKeyword(realArg, akw))
			DoProcessOptionArg(akw);
		else
			SyntaxError(arg + " < invalid option > ");
	}
}

//----------------------------------------------------------------------------------------
// TCPlusTool::DoProcessFileArg:
//----------------------------------------------------------------------------------------
void TCPlusTool::DoProcessFileArg(const string& arg)
{
	SyntaxError(arg + " < invalid parameter > ");
}

//----------------------------------------------------------------------------------------
// TCPlusTool::DoProcessOptionArg:
//----------------------------------------------------------------------------------------
void TCPlusTool::DoProcessOptionArg(short kw)
{
	switch (kw)
	{
		case kwP:
			fProgress = true;
			break;
		case kwNoP:
			fProgress = false;
			break;
		case kwT:
			fTime = true;
			break;
		case kwNoT:
			fTime = false;
			break;
		case kwHelp:
			DoShowUsage();
			fRetCode = RC_Normal;
			Stop("");
			break;
		default:
			cerr << kErrorMarker << " Ignored Parameter: " << fArgv[fArgvIndex] << " < obsolete option > " << endl;
	}
}

//----------------------------------------------------------------------------------------
// TCPlusTool::DoStartProgress:
//----------------------------------------------------------------------------------------
void TCPlusTool::DoStartProgress()
{
	cout << "\n" << fProgName << " (Ver " << gCPlusToolVersion << ")\n\n" << flush;
}

//----------------------------------------------------------------------------------------
// TCPlusTool::DoToolAction
//----------------------------------------------------------------------------------------
void TCPlusTool::DoToolAction()
{
	SubClassResponsibility();
}

//----------------------------------------------------------------------------------------
// TCPlusTool destructor
//----------------------------------------------------------------------------------------
TCPlusTool::~TCPlusTool()
{
}

//----------------------------------------------------------------------------------------
// TCPlusTool::TCPlusTool:
//----------------------------------------------------------------------------------------
TCPlusTool::TCPlusTool(int argc, char** argv) :
	fArgc(argc),
	fArgv(argv),
	fArgvIndex(0),
	fCursorCount(0),							// prepare to spin that cursor
	fInterrupted(false),						// becomes true when interrupted
#if qDebugMsg
	fProgress(true),
#else
	fProgress(false),
#endif
	fRetCode(RC_ParmErrs),
	fStartDateTime(0),							// Date/Time at start of tool 
	fProgName(argv[0]),
	fStartTicks(::TickCount()),							// tickcount at start of tool 
	fTime(false)
{
	fgCPlusTool = this;

	unsigned long theDateTime;
	GetDateTime(&theDateTime);
	fStartDateTime = theDateTime;

	SpinCursor(1);
	signal(SIGINT, &Intr);

	if (fInterrupted)
		Stop("");
}

//----------------------------------------------------------------------------------------
// TCPlusTool::Run:
//----------------------------------------------------------------------------------------
int TCPlusTool::Run()
{
	try
	{
		InstallKeyWords();					// Can be overridden.
		
		while (++fArgvIndex < fArgc)		// fArgc is the number of args plus one
		{
			RotateCursor(++fCursorCount);
			ProcessArg(fArgv[fArgvIndex]);
		}

		fRetCode = RC_Normal;

		if (fProgress)
			DoStartProgress();

		DoToolAction();

		cout << flush;
	
		if (fTime)
		{
			long currentTicks = ::TickCount();
			long elapsedTicks = currentTicks - fStartTicks;
			long double elapsedSecs = (double)elapsedTicks / 60.0;
			cerr.flags(ios_base::showpoint|ios_base::fixed);
			cerr.precision(2);
			cerr << "# Elapsed time: " << elapsedSecs << " seconds\n" << endl;
		}
	}
	catch(CException_AC& caughtException)
	{
		OSErr theErr = caughtException.GetError();
		char theText[256];
		cout << flush;

		if (theErr != noErr)
		{
			GetSysErrText(theErr, theText);
			cerr << kErrorMarker << " " << fProgName << " " << theText << "\n";
			fRetCode = RC_Abort;
		}
	}

	cerr << flush;
	
	return fRetCode;
}

#endif // !qCarbon
//----------------------------------------------------------------------------------------
// End of UCPlusTool.cp

/*
	Historical Change Record:
		----- R11 -----
		06/26/96	Changed nil back to NULL.
		06/26/96	Install release marker.  Scope many globals.  Change TRUE/FALSE/NULL.
		05/09/96	Adjust the Failure Handling macros to allow for easy switching to native exceptions.
		04/30/96	Make all constructors use initialization lists if they weren't already
							doing do. Switch several more empty constructors to inlines.
		04/24/96	Use PRE-Increment/Decrement operators whenever possible for eff.
		04/23/96	Use CTempObject/Handle/Region/Ptr, etc.
		----- R10 -----
		04/02/96	Replaced gEmptyString with "".
		03/30/96	pass long double to elapsed time string
		03/26/96	Cleanup references to gEmptyString and ""
		03/26/96	CStr255_AC to char* conversion now requires const
		 3/23/96	Made InstallKeywords match MABuildTool style. 
		 3/22/96	Added initialization values for gSizeObjectHeap, gSizeHeapIncrement. 
		12/13/95	Define qd globals here. They still are defined in UMacAppGlobals,
							but we're only using UCoreGlobals. 
		10/31/95	Add CurResFile_AC, Fix UseResFile_AC to avoid unnecessary UseResFile calls.
		10/26/95	Change argc from short to int. 
		----- 3.3b1 -----
		 7/28/95	Add configuration functions to use instead of gConfiguration. 
		 5/15/95	Include UniversalStartup. 
		  4/8/95	Consolidate processor dependent initialization code. 
		 3/13/95	Change Free methods to destructors. 
		02/13/95	Remove unnecessary initialization of static variables. See ARM ¤8.4 
		02/07/95	Create missing prototypes for static functions used internally. 
		11/11/94	Comment out unnecessary includes. 
		10/27/94	Compile with ETO 15 prerelease headers. 
		 6/27/94	Move definition of kErrorMarker to .cp file. 
							Problem reported by John McEnerney. 
*/