//----------------------------------------------------------------------------------------
// USection.cpp
// Copyright © 1984-2001 by Apple Computer, Inc. All rights reserved.
//----------------------------------------------------------------------------------------

/*
	Change History
		01/11/01	Use CString_AC instead of CStr255_AC and CStr63_AC.  Some
					functions made const.
		01/02/01	Update copyright.
		11/10/00	Cosmetic.
		11/01/00	[PB] Include MacErrors instead of Errors.
		09/08/00	Added embedded documentation.
		06/14/00	Eliminate unnecessary GetRegionCode calls.  Call
					CMultiLocale_AC::AddResource instead of MAAddResource.
		12/08/99	Explicitly instantiate ~CRefCountingPtr_AC for SCpp.
		03/24/99	Update copyright notice.
*/

#ifndef __USECTION__
#include "USection.h"
#endif

// ACS

#ifndef __CDependencies_AC__
#include "CDependencies_AC.h"
#endif

#ifndef __CList_AC__
#include "CList_AC.h"
#endif

#ifndef __CMultiLocal_AC__
#include "CMultiLocal_AC.h"
#endif

#include "CBuffer_AC.h"
#include "CStreamContext_AC.h"
#include "CLinkedList_AC.h"

// MacApp

#ifndef __UADORNERS__
#include "UAdorners.h"
#endif

#ifndef __UCOMMAND__
#include "UCommand.h"
#endif

#ifndef __UDESIGNATOR__
#include "UDesignator.h"
#endif

#ifndef __UDISPATCHER__
#include "UDispatcher.h"
#endif

#ifndef __UDOCUMENT__
#include "UDocument.h"
#endif

#ifndef __UEDITIONDOCUMENT__
#include "UEditionDocument.h"
#endif

#ifndef __UEVENTHANDLER__
#include "UEventHandler.h"
#endif

#ifndef __UEVENT__
#include "UEvent.h"
#endif

#ifndef __UFILEBASEDDOCUMENT__
#include "UFileBasedDocument.h"
#endif

#ifndef __UFILE__
#include "UFile.h"
#endif

#ifndef __UMACAPPGLOBALS__
#include "UMacAppGlobals.h"
#endif

#ifndef __UMACAPPUTILITIES__
#include "UMacAppUtilities.h"
#endif

#ifndef __UMEMORY__
#include "UMemory.h"
#endif

#ifndef __UPATCH__
#include "UPatch.h"
#endif

#ifndef __USTREAM__
#include "UStream.h"
#endif

#ifndef __UVIEW__
#include "UView.h"
#endif

// Toolbox

#ifndef __ALIASES__
#include <Aliases.h>
#endif

#ifndef __APPLEEVENTS__
#include <AppleEvents.h>
#endif

#ifndef __BALLOONS__
#include <Balloons.h>
#endif

#ifndef __DIALOGS__
#include <Dialogs.h>
#endif

#ifndef __MACERRORS__
#include <MacErrors.h>
#endif

#ifndef __RESOURCES__
#include <Resources.h>
#endif

#ifndef __TEXTEDIT__
#include <TextEdit.h>
#endif

#if defined(__SC__) && !FIXED_MPW_BUG
// Explicitly instantiate this dtor which SCpp forgets to do for its exception handling.
template CRefCountingPtr_AC<CStreamRep_AC>::~CRefCountingPtr_AC();
#endif

//----------------------------------------------------------------------------------------
// class TSectionStreamRep
//----------------------------------------------------------------------------------------

class TSectionStreamRep : public CRandomAccessStreamRep_AC
{

public:
	TSectionStreamRep(EditionRefNum itsEditionRefNum, OSType itsEditionOSType);

	virtual ~TSectionStreamRep();

	virtual void Reset(OSType itsEditionOSType, long itsSize);
		// Resets fPosition to 0, fEditionOSType to itsEditionOSType, and fSize to
        // itsSize.

	virtual long GetPosition() const;
		// Returns fPosition.

	virtual void SetPosition(long newPosition);
		// Sets fPosition.

	virtual long GetSize() const;
		// Returns fSize.

	virtual void SetSize(long newSize);
		// Sets fSize.

	virtual void ReadBytes(void* p, long count);
		// Reads bytes from the Edition Container File.

	virtual void WriteBytes(const void* p, long count);
		// Write bytes to the Edition Container File.

protected:
	EditionRefNum fEditionRefNum;				// refnum of EditionContainerFile
	OSType fEditionOSType;						// OSType to write to EditionContainerFile
	long fPosition;								// offset into the EditionContainerFile
	long fSize;									// size of the fEditionOSType
};

//========================================================================================
// CLASS TSection
//========================================================================================

MA_DEFINE_CLONE(TSection);

//----------------------------------------------------------------------------------------
// TSection::TSection:
//----------------------------------------------------------------------------------------

TSection::TSection(TEditionDocument*	itsDocument,
				   TDesignator*			itsDesignator,
				   SectionHandle		itsSectionHandle,
				   short				itsRsrcID)
	:	fDesignator(itsDesignator),
		fDocument(itsDocument),
		fSectionHandle(itsSectionHandle),
		fRsrcID(itsRsrcID),
		fCanceled(kDontCancel),
		fFound(kEditionFound),
		fNewSection(true)
{
	fLastEditionInfo.crDate = 0;
	fLastEditionInfo.mdDate = 0;
	fLastEditionInfo.fdCreator = kAllQuestionsType_AC;
	fLastEditionInfo.fdType = kAllQuestionsType_AC;
}

//----------------------------------------------------------------------------------------
// TSection::Associate:
//----------------------------------------------------------------------------------------

void TSection::Associate(TFile* aFile)
// Associate associates the specified TFile objectÕs file with this section
// and marks the section as having changed.
//
// aFile:	Specifies the file.
//
// Call?		As needed.
// Override?	Seldom.
{
#if qDebug
	if (!fSectionHandle)
		::ProgramBreak_AC("###fSectionHandle is nil");
#endif

	// get the CFSSpec_AC for the file in question and associate this section object with the CFSSpec_AC
	OSErr err = AssociateSection(fSectionHandle, &aFile->GetFileSpec());

	// Allow fnfErr if we're a subscriber. This accounts for the situation in which the
    // user has canceled the publisher so that its edition container file is no longer
    // there. Should this be done in an override, e.g. TSubscriber::Associate() ???
	if (GetSectionType() == stSubscriber)
	{
		if ((err != noErr) && (err != fnfErr))
			::ThrowIfOSErr_AC(err);
	}
	else
		::ThrowIfOSErr_AC(err);

	// assume it's changed
	MarkAsChanged();
}

//----------------------------------------------------------------------------------------
// TSection::AttachSectionHandle:
//----------------------------------------------------------------------------------------

void TSection::AttachSectionHandle(SectionHandle itsSectionHandle)
// AttachSectionHandle attaches the specified section record for this edition
// to this section.
//
// itsSectionHandle:	Specifies the section record.
//
// Call?		As needed.
// Override?	Seldom.
{
#if qDebug
	if (fSectionHandle)
		::ProgramBreak_AC("###about to overwrite fSectionHandle");
#endif

	fSectionHandle = itsSectionHandle;
}

//----------------------------------------------------------------------------------------
// TSection::DoNeedDiskSpace:
//----------------------------------------------------------------------------------------

void TSection::DoNeedDiskSpace(long& aLong, long& rsrcForkBytes) const
{
	#pragma unused (aLong)

	if (fSectionHandle)
	{
		EditionInfoRecord editionInfo;

		::ThrowIfOSErr_AC(GetEditionInfo(fSectionHandle, &editionInfo));
		CStr255_AC rsrcName(editionInfo.container.theFile.name);
		rsrcForkBytes += (3 * (rsrcName.Length() + kLengthByte));

		rsrcForkBytes += kRsrcOverhead + GetHandleSize((Handle)fSectionHandle);
		rsrcForkBytes += kRsrcOverhead + GetHandleSize((Handle)(*fSectionHandle)->alias);

		TCountingStream aStream;

		aStream.WriteStreamObject(fDesignator, kStandardObject);
		rsrcForkBytes += kRsrcOverhead + aStream.GetSize();
	}
}

//----------------------------------------------------------------------------------------
// TSection::Free:
//----------------------------------------------------------------------------------------

TSection::~TSection()
{
	fDocument->RemoveSection(this);

	UnRegister();
	fSectionHandle = DisposeIfSectionHandle(fSectionHandle);
}

//----------------------------------------------------------------------------------------
// TSection::GetEditionName:
//----------------------------------------------------------------------------------------

CString_AC TSection::GetEditionName() const
{
	UpdateEditionInfo();
	return CString_AC(&fLastEditionInfo.container.theFile.name[1],
					  fLastEditionInfo.container.theFile.name[0]);
}

//----------------------------------------------------------------------------------------
// TSection::GetFileHandler:
//----------------------------------------------------------------------------------------

//----------------------------------------------------------------------------------------
// TSection::GetSectionType:
//----------------------------------------------------------------------------------------

SectionType TSection::GetSectionType()
{
	return fSectionHandle ? (*fSectionHandle)->kind : (SectionType) - 1;
}

//----------------------------------------------------------------------------------------
// TSection::GetUpdateMode:
//----------------------------------------------------------------------------------------

UpdateMode TSection::GetUpdateMode()
{
	return fSectionHandle ? (*fSectionHandle)->mode : (UpdateMode) - 1;
}

//----------------------------------------------------------------------------------------
// TSection::DoRead:
//----------------------------------------------------------------------------------------

void TSection::DoRead(TFile* aFile)
{
	if (!aFile->IsRsrcForkOpen())
	{
#if qDebug
		::ProgramBreak_AC("###resource fork isn't open");
#endif
	}
	else
	{
		fSectionHandle = NULL;
		fDesignator = NULL;

		CTempUseResFile_AC tempUseResFile(aFile->GetRsrcRefNum());	// set the current ResFile

		try
		{
			// read in the section handle from a rSectionType resource
			Handle aHandle = CMultiLocale_AC::Get1Resource(rSectionType, fRsrcID);
			::ThrowIfNULLResource_AC(aHandle);
			DetachResource(aHandle);
			::ThrowIfResError_AC();
			fSectionHandle = (SectionHandle)aHandle;
			(*fSectionHandle)->alias = NULL;	// so failure handler works

			// read in the alias handle from a rAliasType resource
			aHandle = CMultiLocale_AC::Get1Resource(rAliasType, fRsrcID);
			::ThrowIfNULLResource_AC(aHandle);
			DetachResource(aHandle);
			::ThrowIfResError_AC();
			(*fSectionHandle)->alias = (AliasHandle)aHandle;

			// read in the associated designator
			TResourceStream aResourceStream(kDesignatorResType, fRsrcID);

			try
			{
				bool wasValid;
				TDesignator* aDesignator = dynamic_cast_AC(TDesignator*,aResourceStream.ReadStreamObject(wasValid));
				if (wasValid && aDesignator)
					fDesignator = aDesignator;
#if qDebugMsg
				else
					::ProgramBreak_AC("###Unknown TDesignator in TSection::DoRead.");
#endif
			}
			catch(CException_AC& theException)
			{
				DoCatchMessage_AC(theException);
				fSectionHandle = DisposeIfSectionHandle(fSectionHandle);
				// We don't need to free aDesignator here because it would have previously been freed
				throw;
			}

		}
		catch(CException_AC& theException)
		{
			DoCatchMessage_AC(theException);
			fSectionHandle = DisposeIfSectionHandle(fSectionHandle);

			throw;						// Optional. Omit to continue.
		}

		// register the section
		fNewSection = false;					// no it is not new
		OSErr err = Register();
		fFound = (err == containerNotFoundWrn) ? kEditionNotFound : kEditionFound;
		if ((err != containerNotFoundWrn) && (err != notThePublisherWrn) && (err != multiplePublisherWrn))
			::ThrowIfOSErr_AC(err);

		// associate the section correctly
		Associate(aFile);
	}
}

//----------------------------------------------------------------------------------------
// TSection::DoWrite:
//----------------------------------------------------------------------------------------

void TSection::DoWrite(TFile* aFile, bool makingCopy)
{
	#pragma unused (makingCopy)

	if (fSectionHandle && aFile->IsRsrcForkOpen())
	{
		CTempUseResFile_AC tempUseResFile(aFile->GetRsrcRefNum());

		// associate with the correct current file
		TFile* currentFile = GetCurrentFile(aFile);
		Associate(currentFile);

		// prepare to write out our section resources
		EditionInfoRecord editionInfo;
		::ThrowIfOSErr_AC(GetEditionInfo(fSectionHandle, &editionInfo));
		CStr255_AC rsrcName = editionInfo.container.theFile.name;

		// add the alias handle as an rAliasType resource
		CTempHandle_AC tempHandle(PermCopyHandle((Handle)(*fSectionHandle)->alias));

		CMultiLocale_AC::AddResource(tempHandle, rAliasType, fRsrcID, rsrcName);
		::ThrowIfResError_AC();
		tempHandle.release();

		// add the section handle as an rSectionType resource
		CTempHandle_AC tempHandle2(PermCopyHandle((Handle)fSectionHandle));

		CMultiLocale_AC::AddResource(tempHandle2, rSectionType, fRsrcID, rsrcName);
		::ThrowIfResError_AC();
		tempHandle2.release();

		// ask the designator to write its specification to a TResourceStream
		CTempHandle_AC desigHandle = NewPermHandle(2);

		CMultiLocale_AC::AddResource(desigHandle, kDesignatorResType, fRsrcID, rsrcName);
		::ThrowIfResError_AC();

		WriteResource(desigHandle);
		ReleaseResource(desigHandle.release());

		// write the designator to a resource (using a stream)
		TResourceStream aResourceStream(kDesignatorResType, fRsrcID);
		aResourceStream.WriteStreamObject(fDesignator, kStandardObject);

		fNewSection = false;				// no it is not new
	}
#if qDebug
	else
	{
		if (!fSectionHandle)
			::ProgramBreak_AC("###TSection::DoWrite: fSectionHandle is nil");

		if (!aFile->IsRsrcForkOpen())
			::ProgramBreak_AC("###TSection::DoWrite: resource fork isn't open");
	}
#endif
}

//----------------------------------------------------------------------------------------
// TSection::Delete:
//----------------------------------------------------------------------------------------

void TSection::Delete()
// Delete is intended to remove a section from a documentÕs file. TSection::Delete
// must be overridden to perform this action.
//
// Call?		Seldom.
// Override?	Seldom.
{
}

//----------------------------------------------------------------------------------------
// TSection::IsCanceled:
//----------------------------------------------------------------------------------------

bool TSection::IsCanceled()
{
	return fCanceled;
}

//----------------------------------------------------------------------------------------
// TSection::IsChanged: this method is never called: it is overridden for both TPublisher
// & TSubscriber
//----------------------------------------------------------------------------------------

bool TSection::IsChanged()
{
	return false;
}

//----------------------------------------------------------------------------------------
// TSection::MarkAsChanged: this method is never called: it is overridden for both
// TPublisher & TSubscriber
//----------------------------------------------------------------------------------------

void TSection::MarkAsChanged()
{
}

//----------------------------------------------------------------------------------------
// TSection::IsRegistered:
//----------------------------------------------------------------------------------------

bool TSection::IsRegistered() const
{
	// it's registered if the Edition Manager thinks it's registered
	return fSectionHandle ? IsRegisteredSection(fSectionHandle) == noErr : false;
}

//----------------------------------------------------------------------------------------
// TSection::Register:
//----------------------------------------------------------------------------------------

OSErr TSection::Register()
{
	OSErr err = noErr;

	if (!IsRegistered())
	{
		TFile* aFile = fDocument ? fDocument->GetFile() : NULL;
		if (aFile)
		{
			Boolean aliasWasUpdated;
			err = RegisterSection(&aFile->GetFileSpec(), fSectionHandle, &aliasWasUpdated);

			// if aliasWasUpdated, mark section as changed so that user saves changed edition
			if (aliasWasUpdated)
				MarkAsChanged();

			// if RegisterSection was successful, update edition info
			if (err == noErr)
				UpdateEditionInfo();
		}
		else
		{
			err = fnfErr;
#if qDebug
			::ProgramBreak_AC("how to call RegisterSection if there isn't a TFile???");
#endif
		}
	}

	return err;
}

//----------------------------------------------------------------------------------------
// TSection::UnRegister:
//----------------------------------------------------------------------------------------

void TSection::UnRegister()
{
	if (IsRegistered())
		::ThrowIfOSErr_AC(UnRegisterSection(fSectionHandle));
}

//----------------------------------------------------------------------------------------
// TSection::UpdateEditionInfo:
//----------------------------------------------------------------------------------------

void TSection::UpdateEditionInfo() const
{
	EditionInfoRecord editionInfo;

	if (IsRegistered() && (GetEditionInfo(fSectionHandle, &editionInfo) == noErr))
		fLastEditionInfo = editionInfo;
}

//----------------------------------------------------------------------------------------
// TSection::CancelSection:
//----------------------------------------------------------------------------------------

void TSection::CancelSection(bool cancel)
// CancelSection registers or unregisters this section with the Edition Manager.
//
// cancel:		kCancel(true) if unregistering the section with the Edition Manager;
// 				kDontCancel(false) if registering the section.
//
// Call?		As needed. You can also call your edition documentÕs
//				CancelSection method.
// Override?	Seldom.
{
	OSErr err;

	if (cancel != fCanceled)
		if (cancel == kCancel)
		{
			UpdateEditionInfo();			// We will be able to delete it later.
			UnRegister();
			fCanceled = kCancel;				// it IS canceled
		}
		else
		{
			err = Register();
			if ((err != containerNotFoundWrn) && (err != notThePublisherWrn) && (err != multiplePublisherWrn))
				::ThrowIfOSErr_AC(err);
			fCanceled = kDontCancel;			// it IS !canceled
		}
}

//----------------------------------------------------------------------------------------
// TSection::GetCurrentFile:
//----------------------------------------------------------------------------------------

TFile* TSection::GetCurrentFile(TFile* aFile)
{
	// This looks strange but it should be correct. The idea is to associate the
	// section with the correct disk file. If it's a newly saved document, associate
	// with the file that is passed in, this will be the temporary file; if it's not a
	// new save, associate it with the current file that the file handler owns.

	return fDocument && fDocument->FileExists() ? fDocument->GetFile() : aFile;
}

//========================================================================================
// CLASS TPublisher
//========================================================================================

MA_DEFINE_CLONE(TPublisher);

//----------------------------------------------------------------------------------------
// TPublisher destructor
//----------------------------------------------------------------------------------------

TPublisher::~TPublisher()
{
}

//----------------------------------------------------------------------------------------
// TPublisher::DoUpdate:
//----------------------------------------------------------------------------------------

void TPublisher::DoUpdate(ChangeID_AC			theChange,
						  MDependable_AC*		changedObject,
						  void*					changeData,
						  CDependencySpace_AC*	dependencySpace)
{
	if (theChange != kNoChange_AC)
		MarkAsChanged();

	TSection::DoUpdate(theChange, changedObject, changeData,dependencySpace);
}

//----------------------------------------------------------------------------------------
// TPublisher::Publish:
//----------------------------------------------------------------------------------------

void TPublisher::Publish(TFile* aFile)
{
	CFSSpec_AC aFSSpec;
	FSSpecPtr aFSSpecPtr = NULL;
	if (aFile && aFile->HasValidFileSpec())
	{
		aFSSpec = aFile->GetFileSpec();
		aFSSpecPtr = &aFSSpec;
	}

	EditionRefNum refNum;
	OSErr err = OpenNewEdition(fSectionHandle, gDispatcher->GetCreator(), aFSSpecPtr, &refNum);
	if (err == noErr)					// DON'T signal failure if the OpenNewEdition
										// fails, just continue without publishing.
	{
		try
		{
			// Create a section stream to write the published data to, and publish the
            // document's private type first:
            { // Extra block to destroy temp objects before Success
				TSectionStream aSectionStream(refNum, fDocument->GetScrapType());

				fDocument->DoWriteData(fDocument->GetScrapType(), fDesignator, &aSectionStream);

				// Publish the rest of the data types. The order in which the application
				// publishes to the edition container file indicates to the client application
				// the preferred order for subscribers! So, publish the TEXT or PICT or kSoundType_AC
				// (at least one is required) in the order prefered.

				// N.B.: The Edition Manager will set the edition container file's file type
				// according to which type was published first: 'edtp' if PICT was published
				// first, 'edtt' if TEXT was published first, and 'edts' if kSoundType_AC was
				// published first.

				if (fDocument->GetPublishPreference() == kPictType_AC)
				{
					aSectionStream.Reset(kPictType_AC, 0);
					fDocument->DoWriteData(kPictType_AC, fDesignator, &aSectionStream);
					aSectionStream.Reset(kTextType_AC, 0);
					fDocument->DoWriteData(kTextType_AC, fDesignator, &aSectionStream);
					aSectionStream.Reset(kSoundType_AC, 0);
					fDocument->DoWriteData(kSoundType_AC, fDesignator, &aSectionStream);
				}
				else if (fDocument->GetPublishPreference() == kTextType_AC)
				{
					aSectionStream.Reset(kTextType_AC, 0);
					fDocument->DoWriteData(kTextType_AC, fDesignator, &aSectionStream);
					aSectionStream.Reset(kPictType_AC, 0);
					fDocument->DoWriteData(kPictType_AC, fDesignator, &aSectionStream);
					aSectionStream.Reset(kSoundType_AC, 0);
					fDocument->DoWriteData(kSoundType_AC, fDesignator, &aSectionStream);
				}
				else if (fDocument->GetPublishPreference() == kSoundType_AC)
				{
					aSectionStream.Reset(kSoundType_AC, 0);
					fDocument->DoWriteData(kSoundType_AC, fDesignator, &aSectionStream);
					aSectionStream.Reset(kTextType_AC, 0);
					fDocument->DoWriteData(kTextType_AC, fDesignator, &aSectionStream);
					aSectionStream.Reset(kPictType_AC, 0);
					fDocument->DoWriteData(kPictType_AC, fDesignator, &aSectionStream);
				}
			}
		}
		catch(CException_AC& theException)
		{
			DoCatchMessage_AC(theException);
			// If there is a failure during publishing close the edition file without
            // saving the changes (pass false for successful). This ensures that the
            // publisher will get a shot at publishing again later.
			err = CloseEdition(refNum, false);

			throw;						// Optional. Omit to continue.
		}

		// close the edition file, passing true for the successful parameter
		::ThrowIfOSErr_AC(CloseEdition(refNum, true));
	}
}

//----------------------------------------------------------------------------------------
// TPublisher::DoWrite:
//----------------------------------------------------------------------------------------

void TPublisher::DoWrite(TFile* aFile, bool makingCopy)
{
	TSection::DoWrite(aFile, makingCopy);

	if ((!fDocument->GetStopAllEditions()) && fSectionHandle && (GetUpdateMode() == pumOnSave) && IsChanged())
	{
		TFile* currentFile = GetCurrentFile(aFile);
		if (currentFile)
			Publish(currentFile);
		else
			Publish(aFile);
	}
}

//----------------------------------------------------------------------------------------
// TPublisher::Delete:
//----------------------------------------------------------------------------------------

void TPublisher::Delete()
{
	DeleteEditionFile();

	TSection::Delete();
}

//----------------------------------------------------------------------------------------
// TPublisher::DeleteEditionFile:
//----------------------------------------------------------------------------------------

void TPublisher::DeleteEditionFile()
// DeleteEditionFile deletes the publisherÕs edition container file and cancels
// the publisher.
//
// Call?		Seldom.
// Override?	Seldom.
{
	// get the edition container file's CFSSpec_AC - from updated fLastEditionInfo
	UpdateEditionInfo();
	CFSSpec_AC theFile(fLastEditionInfo.container.theFile);

	// cancel the section - this unregisters the section
	CancelSection(kCancel);

	// delete the edition container file
	OSErr err = DeleteEditionContainerFile(&theFile);
	if ((err != noErr) && (err != fnfErr))		// allow file-not-found error
		::ThrowIfOSErr_AC(err);
}

//----------------------------------------------------------------------------------------
// TPublisher::IsChanged:
//----------------------------------------------------------------------------------------

bool TPublisher::IsChanged()
{
	bool returnVal = false;

	EditionInfoRecord editionInfo;

	if (fSectionHandle)
	{
		::ThrowIfOSErr_AC(GetEditionInfo(fSectionHandle, &editionInfo));
		returnVal = editionInfo.mdDate != (*fSectionHandle)->mdDate;
	}

	return returnVal;
}

//----------------------------------------------------------------------------------------
// TPublisher::MarkAsChanged:
//----------------------------------------------------------------------------------------

void TPublisher::MarkAsChanged()
{
	if (fSectionHandle)
	{
		unsigned long secs;

		// mark this publisher as changed
		GetDateTime(&secs);
		(*fSectionHandle)->mdDate = secs;
	}
}

//========================================================================================
// CLASS TSubscriber
//========================================================================================

MA_DEFINE_CLONE(TSubscriber);

//----------------------------------------------------------------------------------------
// TSubscriber destructor
//----------------------------------------------------------------------------------------

TSubscriber::~TSubscriber()
{
}

//----------------------------------------------------------------------------------------
// TSubscriber::ISubscriber:
//----------------------------------------------------------------------------------------

TSubscriber::TSubscriber(TEditionDocument*	itsDocument,
						 TDesignator*		itsDesignator,
						 SectionHandle		itsSectionHandle,
						 short				itsRsrcID)
	:	TSection(itsDocument, itsDesignator, itsSectionHandle, itsRsrcID),
		fChanged(false)
{
	// ensure that the document is notified of any and all changes to the subscriber
	AddDependent(itsDocument);
}

//----------------------------------------------------------------------------------------
// TSubscriber::SubscribeIfNewer:
//----------------------------------------------------------------------------------------

void TSubscriber::SubscribeIfNewer()
{
	if ((!fDocument->GetStopAllEditions()) && fSectionHandle && (GetUpdateMode() == sumAutomatic) && IsNewerEditionAvailable())
		Subscribe();
}

//----------------------------------------------------------------------------------------
// TSubscriber::Subscribe:
//----------------------------------------------------------------------------------------

void TSubscriber::Subscribe()
{
	EditionRefNum refNum;
	::ThrowIfOSErr_AC(OpenEdition(fSectionHandle, &refNum));

	try
	{
		{ // Extra block to destroy temp objects before Success
			// Create a section stream to read the published data from.
			TSectionStream aSectionStream(refNum, kNoIdentifier);

			// Top priority: subscribe to private types.
			Size formatSize;
			OSErr err = EditionHasFormat(refNum, fDocument->GetScrapType(), &formatSize);
			if ((err == noErr) && (formatSize > 0))
			{
				aSectionStream.Reset(fDocument->GetScrapType(), formatSize);
				fDocument->DoReadData(fDocument->GetScrapType(), fDesignator, &aSectionStream, formatSize);
			}
			else
			{
				// subscribe to one or more of the required data types
				OSErr err = EditionHasFormat(refNum, kPictType_AC, &formatSize);
				if ((err == noErr) && (formatSize > 0))
				{
					aSectionStream.Reset(kPictType_AC, formatSize);
					fDocument->DoReadData(kPictType_AC, fDesignator, &aSectionStream, formatSize);
				}
				err = EditionHasFormat(refNum, kTextType_AC, &formatSize);
				if ((err == noErr) && (formatSize > 0))
				{
					aSectionStream.Reset(kTextType_AC, formatSize);
					fDocument->DoReadData(kTextType_AC, fDesignator, &aSectionStream, formatSize);
				}
				err = EditionHasFormat(refNum, kSoundType_AC, &formatSize);
				if ((err == noErr) && (formatSize > 0))
				{
					aSectionStream.Reset(kSoundType_AC, formatSize);
					fDocument->DoReadData(kSoundType_AC, fDesignator, &aSectionStream, formatSize);
				}
			}
		}
	}
	catch(CException_AC& theException)
	{
		DoCatchMessage_AC(theException);
		// If there is a failure during subscribing, close the edition file without saving
        // the changes (pass false for successful). This ensures that the subscriber will
        // get a shot at subscribing again later.
		CloseEdition(refNum, false);

		throw;							// Optional. Omit to continue.
	}

	// close the edition file
	::ThrowIfOSErr_AC(CloseEdition(refNum, true));

	// adjust this guy's border
	fDocument->DoAdjustBorder(this);

	Changed(cSubscriberChanged, this);	// notify dependents
}

//----------------------------------------------------------------------------------------
// TSubscriber::IsNewerEditionAvailable:
//----------------------------------------------------------------------------------------

bool TSubscriber::IsNewerEditionAvailable()
{
	bool returnVal = false;

	if (fSectionHandle)
	{
		EditionInfoRecord editionInfo;

		::ThrowIfOSErr_AC(GetEditionInfo(fSectionHandle, &editionInfo));
		returnVal = (editionInfo.mdDate != (*fSectionHandle)->mdDate);
	}

	return returnVal;
}

//----------------------------------------------------------------------------------------
// TSubscriber::OpenPublisher:
//----------------------------------------------------------------------------------------

void TSubscriber::OpenPublisher()
{
	EditionInfoRecord editionInfo;

	::ThrowIfOSErr_AC(GetEditionInfo(fSectionHandle, &editionInfo));
	::ThrowIfOSErr_AC(GoToPublisherSection(&(editionInfo.container)));
}

//----------------------------------------------------------------------------------------
// TSubscriber::IsChanged:
//----------------------------------------------------------------------------------------

bool TSubscriber::IsChanged()
{
	return fChanged;
}

//----------------------------------------------------------------------------------------
// TSubscriber::MarkAsChanged:
//----------------------------------------------------------------------------------------

void TSubscriber::MarkAsChanged()
{
	fChanged = true;
}

//========================================================================================
// CLASS TSectionStream
//========================================================================================

MA_DEFINE_CLONE(TSectionStream);

//----------------------------------------------------------------------------------------
// TSectionStream constructor
//----------------------------------------------------------------------------------------

TSectionStreamRep::TSectionStreamRep(EditionRefNum itsEditionRefNum, OSType itsEditionOSType)
	:	fEditionRefNum(itsEditionRefNum),
		fEditionOSType(itsEditionOSType),
		fPosition(0),
		fSize(0)
{
}

//----------------------------------------------------------------------------------------
// TSectionStreamRep destructor
//----------------------------------------------------------------------------------------

TSectionStreamRep::~TSectionStreamRep()
{
}

//----------------------------------------------------------------------------------------
// TSectionStreamRep::Reset:
//----------------------------------------------------------------------------------------

void TSectionStreamRep::Reset(OSType itsEditionOSType, long itsSize)
{
	SetPosition(0);
	fEditionOSType = itsEditionOSType;
	fSize = itsSize;
}

//----------------------------------------------------------------------------------------
// TSectionStreamRep::GetPosition:
//----------------------------------------------------------------------------------------

long TSectionStreamRep::GetPosition() const
{
	return fPosition;
}

//----------------------------------------------------------------------------------------
// TSectionStreamRep::SetPosition:
//----------------------------------------------------------------------------------------

void TSectionStreamRep::SetPosition(long newPosition)
{
	fPosition = newPosition;

	if (fPosition > fSize)						// Adjust the size if necessary.
		fSize = fPosition;
}

//----------------------------------------------------------------------------------------
// TSectionStreamRep::GetSize:
//----------------------------------------------------------------------------------------

long TSectionStreamRep::GetSize() const
{
	return fSize;
}

//----------------------------------------------------------------------------------------
// TSectionStreamRep::SetSize:
//----------------------------------------------------------------------------------------

void TSectionStreamRep::SetSize(long newSize)
{
	fSize = newSize;

	if (newSize < fPosition)					// If we shrunk the size, then we have to adjust the position.
		fPosition = newSize;
}

//----------------------------------------------------------------------------------------
// TSectionStreamRep::WriteBytes:
//----------------------------------------------------------------------------------------

void TSectionStreamRep::WriteBytes(const void* p, long count)
{
	::ThrowIfOSErr_AC(SetEditionFormatMark(fEditionRefNum, fEditionOSType, GetPosition()));
	::ThrowIfOSErr_AC(WriteEdition(fEditionRefNum, fEditionOSType, p, count));

	SetPosition(fPosition + count);		// Advance the position.
}

//----------------------------------------------------------------------------------------
// TSectionStreamRep::ReadBytes:
//----------------------------------------------------------------------------------------

void TSectionStreamRep::ReadBytes(void* p, long count)
{
	::ThrowIfOSErr_AC(SetEditionFormatMark(fEditionRefNum, fEditionOSType, GetPosition()));
	::ThrowIfOSErr_AC(ReadEdition(fEditionRefNum, fEditionOSType, p, &count));

	SetPosition(fPosition + count);		// Advance the position.
}

//========================================================================================
// CLASS TSectionStream
//========================================================================================

//----------------------------------------------------------------------------------------
// TSectionStream constructor
//----------------------------------------------------------------------------------------

TSectionStream::TSectionStream(EditionRefNum itsEditionRefNum, OSType itsEditionOSType)
	: CRandomAccessStream_AC(TH_new TSectionStreamRep(itsEditionRefNum, itsEditionOSType))
{
}

//----------------------------------------------------------------------------------------
// TSectionStream destructor
//----------------------------------------------------------------------------------------

TSectionStream::~TSectionStream()
{
}

//----------------------------------------------------------------------------------------
// TSectionStrea:Reset
//----------------------------------------------------------------------------------------

void TSectionStream::Reset(OSType itsEditionOSType, long itsSize)
{
	TSectionStreamRep* streamRep = dynamic_cast_or_throw_AC(TSectionStreamRep*,GetStreamRep());
	streamRep->Reset(itsEditionOSType, itsSize);
}

//========================================================================================
// CLASS TSectionList
//========================================================================================

MA_DEFINE_CLASS(TSectionList);

//----------------------------------------------------------------------------------------
// TSectionList destructor
//----------------------------------------------------------------------------------------

TSectionList::~TSectionList()
{
}

//----------------------------------------------------------------------------------------
// TSectionList::Compare:
//----------------------------------------------------------------------------------------

CompareResult_AC TSectionList::Compare(const TSection* section1,
								   const TSection* section2) const
{
	CompareResult_AC returnVal = kItem1EqualItem2_AC;

	if ((*section1->GetSectionHandle())->controlBlock < (*section2->GetSectionHandle())->controlBlock)
		returnVal = kItem1LessThanItem2_AC;
	else if ((*section1->GetSectionHandle())->controlBlock > (*section2->GetSectionHandle())->controlBlock)
		returnVal = kItem1GreaterThanItem2_AC;

	return returnVal;
}

//========================================================================================
// CLASS CSectionIterator
//========================================================================================

//----------------------------------------------------------------------------------------
// CSectionIterator::CSectionIterator:
//----------------------------------------------------------------------------------------

CSectionIterator::CSectionIterator(const TEditionDocument*	itsDocument,
								   ArrayIndex_AC			itsLowBound,
								   ArrayIndex_AC			itsHighBound,
								   bool						itsForward)
	:	Iterator(itsDocument
				 ? itsDocument->GetSectionList()
				 : NULL, itsLowBound, itsHighBound, itsForward)
// CSectionIterator is a constructor that initializes an instance for iteration
// over TSection objects.
//
/// CSectionIterator(TEditionDocument* itsDocument, Boolean itsForward);
// CSectionIterator(TEditionDocument* itsDocument);
// CSectionIterator(TSectionList* itsSectionList);
//
// itsDocument:		Specifies the document object that has the section list over
// 					which this object iterates. If the value of itsDocument is nonzero,
// 					the value of the fSectionList field of the specified application is
// 					passed as the first argument to the CSectionIterator constructor;
// 					otherwise, NULL is passed.
// itsLowBound:		Specifies the lowest position in the section list that can
// 					be accessed during this iteration.
// itsHighBound:	Specifies the highest position in the section list that can
// 					be accessed during this iteration.
// itsForward:		Specifies the direction in which iteration is to proceed; true
//					indicates forward iteration.
// itsSectionList:	Specifies the section list over which this object iterates.
//
// Call?		As needed.
// Override?	Seldom.
{
}

//----------------------------------------------------------------------------------------
// CSectionIterator::CSectionIterator:
//----------------------------------------------------------------------------------------

CSectionIterator::CSectionIterator(const TEditionDocument* itsDocument,
								   bool itsForward)
	:	Iterator(itsDocument ? itsDocument->GetSectionList() : NULL, itsForward)
{
}

//----------------------------------------------------------------------------------------
// CSectionIterator::CSectionIterator:
//----------------------------------------------------------------------------------------

CSectionIterator::CSectionIterator(const TEditionDocument* itsDocument)
	:	Iterator(itsDocument ? itsDocument->GetSectionList() : NULL, kIterateForward_AC)
{
}

//----------------------------------------------------------------------------------------
// CSectionIterator::CSectionIterator:
//----------------------------------------------------------------------------------------

CSectionIterator::CSectionIterator(const TSectionList* itsSectionList)
	:	Iterator(itsSectionList, kIterateForward_AC)
{
}

//----------------------------------------------------------------------------------------
// End of USection.cpp

/*
	Historical Change Record:
		----- R11 -----
		06/26/96	Changed nil back to NULL.
		06/26/96	Install release marker.  Scope many globals.  Change TRUE/FALSE/NULL.
		06/09/96	Removed UStreamable to a separate file from UObject
		05/09/96	Adjust the Failure Handling macros to allow for easy switching to native exceptions.
		 5/09/96	Added CopyHandle_AC: a better HandToHand replacement. And created
		 					PermCopyHandle a better PermHandToHand.
		 5/08/96	Create and use CFSSpec_AC. You should search/replace in your code to switch to
		 					CFSSpec_AC.
		05/02/95	Call FreeIfObject, don't call Free directly since it will eventually be removed.
		04/30/96	Make all constructors use initialization lists if they weren't already
							doing do. Switch several more empty constructors to inlines.
		04/25/96	More use of CTempxxx classes instead of Failure handling where poss.
		04/23/96	Use CTempObject/Handle/Region/Ptr, etc.
		 4/15/96	Made TSection an MDependable_AC
		----- R10 -----
		  1/4/96	Get rid of TFileHandler.
		 12/8/95	Split up includes for modular MacApp.
		----- 3.3 -----
		----- 3.3b1 -----
		10/31/95	Add CurResFile_AC, Fix UseResFile_AC to avoid unnecessary UseResFile calls.
		 4/12/95	Use #if instead of if qDebug.
		 3/21/95	ARM 8.4.3 x& cannot be initialized with volatile x.
		 3/17/95	MAVolatile.
		 3/13/95	Change Free methods to destructors.
		 2/17/95	Use MAAddResource.
*/