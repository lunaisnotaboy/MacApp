//----------------------------------------------------------------------------------------
// UBusyCursor.cpp 
// Copyright � 1985-2001 by Apple Computer, Inc. All rights reserved.
//----------------------------------------------------------------------------------------

/*
	Change History
		07/24/01	Use Lock_AC.  Cast to handle using reinterpret_cast.
		01/02/00	No longer need to cast procptrs when creating UPPs. 
		01/02/01	Update copyright.
		12/06/00	Cast around new type safe interfaces that are incorrect for
					functions with register based parameters on classic 68K. 
		11/22/00	StripLong breaks type safety, and we don't need it anyway. 
		11/03/00	[C] Don�t include Traps.h.
		10/20/00	[C] Disable QElemWithBusyCursor.
		09/20/00	Conditionalized for qMSWindows.  Cosmetic cleanup.
		09/05/00	Added embedded documentation.
		06/14/00	Do not pass smSystemScript.
		11/03/99	GENERATINGCFM now TARGET_RT_MAC_CFM (3.2 and 3.3 compatible).
		09/24/99	SetCursoror now MacSetCursor, GetCursor now MacGetCursor.
		03/24/99	Update copyright notice.
		02/03/99	[C] Added a couple of #pragma unused.
		11/05/98	Carbon - call GetQDGlobalsArrow to get qd.arrow
		10/29/98	No longer necessary to include QTMLMapNames.h.
		10/26/98	Carbonize - no trap patching, no VBL tasks
*/

#ifndef __UBUSYCURSOR__
#include "UBusyCursor.h"
#endif

// MacApp

#ifndef __UCOREUTILITIES__
#include "UCoreUtilities.h"
#endif

#ifndef __UMEMORY__
#include "UMemory.h"
#endif

#if !qMSWindows
	#ifndef __UPATCH__
	#include "UPatch.h"
	#endif
#endif

#ifndef __UStreamable__
#include "UStreamable.h"
#endif

// ACS

#ifndef __CMultiLocal_AC__
#include "CMultiLocal_AC.h"
#endif

// Toolbox

#ifndef __LOWMEM__
#include <LowMem.h>
#endif

#ifndef __RESOURCES__
#include <Resources.h>
#endif

#ifndef __TOOLUTILS__
#include <ToolUtils.h>
#endif

#if !qCarbon
	#ifndef __TRAPS__
	#include <Traps.h>
	#endif
#endif

//----------------------------------------------------------------------------------------

#ifndef qPatchEventAvail
#define qPatchEventAvail	0
#endif

//----------------------------------------------------------------------------------------
const ResNumber kAcurRsrcID = 256;

//----------------------------------------------------------------------------------------
// static data members
//----------------------------------------------------------------------------------------

CAutoPtr_AC<TBusyCursor> TBusyCursor::fgBusyCursor;
bool TBusyCursor::pBusyCursorVBLInstalled;		// used for proper failure handling

// ���  Trap-patching and VBL tasks are verboten under Carbon
#if !qCarbon && !qMSWindows

#if qPatchEventAvail

//========================================================================================
// CLASS PatchEventAvail
//========================================================================================

typedef pascal Boolean (*EventAvailType)(short eventMask, EventRecord* theEvent);

#if TARGET_RT_MAC_CFM
typedef UniversalProcPtr EventAvailUPP;
#else
typedef ProcPtr EventAvailUPP;
#endif
	
enum
{
	uppEventAvailProcInfo = kPascalStackBased
		 | RESULT_SIZE(SIZE_CODE(sizeof(Boolean)))
		 | STACK_ROUTINE_PARAMETER(1, SIZE_CODE(sizeof(short)))
		 | STACK_ROUTINE_PARAMETER(2, SIZE_CODE(sizeof(EventRecord*)))
};

#if TARGET_RT_MAC_CFM
#define NewEventAvailProc(userRoutine)  \
		(EventAvailUPP) NewRoutineDescriptor((ProcPtr)(userRoutine), uppEventAvailProcInfo, GetCurrentISA())
#else
#define NewEventAvailProc(userRoutine)		\
		((EventAvailUPP) (userRoutine))
#endif
	
#if TARGET_RT_MAC_CFM
#define CallEventAvailProc(userRoutine, eventMask, theEvent)		\
		CallUniversalProc((UniversalProcPtr)(userRoutine), uppEventAvailProcInfo, (eventMask), (theEvent))
#else
#define CallEventAvailProc(userRoutine, eventMask, theEvent)		\
		(*(userRoutine))((eventMask), (theEvent))
#endif
	
//========================================================================================

class PatchEventAvail : public TrapPatch
{
  public:
	void Install(EventAvailType routine);
	bool CallInherited(short eventMask, EventRecord* theEvent);
};

//--------------------------------------------------------------------------------------------------

void PatchEventAvail::Install(EventAvailType routine)
{
	patchRoutine = NewEventAvailProc(StripLong(routine));
	::ThrowIfNULL_AC(patchRoutine);
	PatchTrap(_EventAvail, patchRoutine);
}

//--------------------------------------------------------------------------------------------------

bool PatchEventAvail::CallInherited(short eventMask, EventRecord* theEvent)
{
	return CallEventAvailProc((EventAvailType) oldTrapAddr, eventMask, theEvent);
}

#endif // qPatchEventAvail

//========================================================================================
// CLASS PatchGetNextEvent
//========================================================================================

typedef pascal Boolean (*GetNextEventType)(short eventMask, EventRecord* theEvent);

#if TARGET_RT_MAC_CFM
typedef UniversalProcPtr GetNextEventUPP;
#else
typedef ProcPtr GetNextEventUPP;
#endif
	
enum
{
	uppGetNextEventProcInfo = kPascalStackBased
		 | RESULT_SIZE(SIZE_CODE(sizeof(Boolean)))
		 | STACK_ROUTINE_PARAMETER(1, SIZE_CODE(sizeof(short)))
		 | STACK_ROUTINE_PARAMETER(2, SIZE_CODE(sizeof(EventRecord*)))
};

#if TARGET_RT_MAC_CFM
#define NewGetNextEventProc(userRoutine)  \
		(GetNextEventUPP) NewRoutineDescriptor((ProcPtr)(userRoutine), uppGetNextEventProcInfo, GetCurrentISA())
#else
#define NewGetNextEventProc(userRoutine)		\
		((GetNextEventUPP) (userRoutine))
#endif
	
#if TARGET_RT_MAC_CFM
#define CallGetNextEventProc(userRoutine, eventMask, theEvent)		\
		CallUniversalProc((UniversalProcPtr)(userRoutine), uppGetNextEventProcInfo, (eventMask), (theEvent))
#else
#define CallGetNextEventProc(userRoutine, eventMask, theEvent)		\
		(*(userRoutine))((eventMask), (theEvent))
#endif
	
class PatchGetNextEvent : public TrapPatch
{
  public:
	void Install(GetNextEventType routine);
	bool CallInherited(short eventMask, EventRecord* theEvent);
};

//--------------------------------------------------------------------------------------------------

void PatchGetNextEvent::Install(GetNextEventType routine)
{
	patchRoutine = NewGetNextEventProc(StripLong(routine));
	::ThrowIfNULL_AC(patchRoutine);
	PatchTrap(_GetNextEvent, patchRoutine);
}

//--------------------------------------------------------------------------------------------------

bool PatchGetNextEvent::CallInherited(short eventMask, EventRecord* theEvent)
{
	return CallGetNextEventProc((GetNextEventType) oldTrapAddr, eventMask, theEvent);
}

//========================================================================================
// CLASS PatchInitCursor
//========================================================================================

typedef pascal void (*InitCursorType)();

#if TARGET_RT_MAC_CFM
typedef UniversalProcPtr InitCursorUPP;
#else
typedef ProcPtr InitCursorUPP;
#endif
	
enum
{
	uppInitCursorProcInfo = kPascalStackBased
};

#if TARGET_RT_MAC_CFM
#define NewInitCursorProc(userRoutine)  \
		(InitCursorUPP) NewRoutineDescriptor((ProcPtr)(userRoutine), uppInitCursorProcInfo, GetCurrentISA())
#else
#define NewInitCursorProc(userRoutine)		\
		((InitCursorUPP) (userRoutine))
#endif

#if TARGET_RT_MAC_CFM
#define CallInitCursorProc(userRoutine)		\
		CallUniversalProc((UniversalProcPtr)(userRoutine), uppInitCursorProcInfo)
#else
#define CallInitCursorProc(userRoutine)		\
		(*(userRoutine))()
#endif
	
class PatchInitCursor : public TrapPatch
{
  public:
	void Install(InitCursorType routine);
	void CallInherited();
};

//--------------------------------------------------------------------------------------------------

void PatchInitCursor::Install(InitCursorType routine)
{
	patchRoutine = NewInitCursorProc(StripLong(routine));
	::ThrowIfNULL_AC(patchRoutine);
	PatchTrap(_InitCursor, patchRoutine);
}

//--------------------------------------------------------------------------------------------------

void PatchInitCursor::CallInherited()
{
	CallInitCursorProc((InitCursorType) oldTrapAddr);
}

//========================================================================================
// CLASS PatchSetCCursor
//========================================================================================

typedef pascal void (*SetCCursorType)(CCrsrHandle cCrsr);

#if TARGET_RT_MAC_CFM
typedef UniversalProcPtr SetCCursorUPP;
#else
typedef ProcPtr SetCCursorUPP;
#endif
	
enum
{
	uppSetCCursorProcInfo = kPascalStackBased
		 | STACK_ROUTINE_PARAMETER(1, SIZE_CODE(sizeof(CCrsrHandle)))
};

#if TARGET_RT_MAC_CFM
#define NewSetCCursorProc(userRoutine)  \
		(SetCCursorUPP) NewRoutineDescriptor((ProcPtr)(userRoutine), uppSetCCursorProcInfo, GetCurrentISA())
#else
#define NewSetCCursorProc(userRoutine)		\
		((SetCCursorUPP) (userRoutine))
#endif
	
#if TARGET_RT_MAC_CFM
#define CallSetCCursorProc(userRoutine, cCrsr)		\
		CallUniversalProc((UniversalProcPtr)(userRoutine), uppSetCCursorProcInfo, (cCrsr))
#else
#define CallSetCCursorProc(userRoutine, cCrsr)		\
		(*(userRoutine))((cCrsr))
#endif
	
class PatchSetCCursor : public TrapPatch
{
  public:
	void Install(SetCCursorType routine);
	void CallInherited(CCrsrHandle cCrsr);
};

//--------------------------------------------------------------------------------------------------

void PatchSetCCursor::Install(SetCCursorType routine)
{
	patchRoutine = NewSetCCursorProc(StripLong(routine));
	::ThrowIfNULL_AC(patchRoutine);
	PatchTrap(_SetCCursor, patchRoutine);
}

//--------------------------------------------------------------------------------------------------

void PatchSetCCursor::CallInherited(CCrsrHandle cCrsr)
{
	CallSetCCursorProc((SetCCursorType) oldTrapAddr, cCrsr);
}

//========================================================================================
// CLASS PatchSetCursor
//========================================================================================

typedef pascal void (*SetCursorType)(const Cursor *crsr);

#if TARGET_RT_MAC_CFM
typedef UniversalProcPtr SetCursorUPP;
#else
typedef ProcPtr SetCursorUPP;
#endif
	
enum
{
	uppSetCursorProcInfo = kPascalStackBased
		 | STACK_ROUTINE_PARAMETER(1, SIZE_CODE(sizeof(Cursor *)))
};

#if TARGET_RT_MAC_CFM
#define NewSetCursorProc(userRoutine)  \
		(SetCursorUPP) NewRoutineDescriptor((ProcPtr)(userRoutine), uppSetCursorProcInfo, GetCurrentISA())
#else
#define NewSetCursorProc(userRoutine)		\
		((SetCursorUPP) (userRoutine))
#endif
	
#if TARGET_RT_MAC_CFM
#define CallSetCursorProc(userRoutine, crsr)		\
		CallUniversalProc((UniversalProcPtr)(userRoutine), uppSetCursorProcInfo, (crsr))
#else
#define CallSetCursorProc(userRoutine, crsr)		\
		(*(userRoutine))(crsr)
#endif
	
class PatchSetCursor : public TrapPatch
{
  public:
	void Install(SetCursorType routine);
	void CallInherited(const Cursor *crsr);
};

//--------------------------------------------------------------------------------------------------

void PatchSetCursor::Install(SetCursorType routine)
{
	patchRoutine = NewSetCursorProc(StripLong(routine));
	::ThrowIfNULL_AC(patchRoutine);
	PatchTrap(_SetCursor, patchRoutine);
}

//--------------------------------------------------------------------------------------------------

void PatchSetCursor::CallInherited(const Cursor *crsr)
{
	CallSetCursorProc((SetCursorType) oldTrapAddr, crsr);
}

//========================================================================================
// CLASS PatchStillDown
//========================================================================================

typedef pascal Boolean (*StillDownType)();

#if TARGET_RT_MAC_CFM
typedef UniversalProcPtr StillDownUPP;
#else
typedef ProcPtr StillDownUPP;
#endif
	
enum
{
	uppStillDownProcInfo = kPascalStackBased
		 | RESULT_SIZE(SIZE_CODE(sizeof(Boolean)))
};

#if TARGET_RT_MAC_CFM
#define NewStillDownProc(userRoutine)  \
		(StillDownUPP) NewRoutineDescriptor((ProcPtr)(userRoutine), uppStillDownProcInfo, GetCurrentISA())
#else
#define NewStillDownProc(userRoutine)		\
		((StillDownUPP) (userRoutine))
#endif
	
#if TARGET_RT_MAC_CFM
#define CallStillDownProc(userRoutine)		\
		CallUniversalProc((UniversalProcPtr)(userRoutine), uppStillDownProcInfo)
#else
#define CallStillDownProc(userRoutine)		\
		(*(userRoutine))()
#endif
	
class PatchStillDown : public TrapPatch
{
  public:
	void Install(StillDownType routine);
	bool CallInherited();
};

//--------------------------------------------------------------------------------------------------

void PatchStillDown::Install(StillDownType routine)
{
	patchRoutine = NewStillDownProc(StripLong(routine));
	::ThrowIfNULL_AC(patchRoutine);
	PatchTrap(_StillDown, patchRoutine);
}

//--------------------------------------------------------------------------------------------------

bool PatchStillDown::CallInherited()
{
	return CallStillDownProc((StillDownType) oldTrapAddr);
}

//========================================================================================
// CLASS PatchWaitMouseUp
//========================================================================================

typedef pascal Boolean (*WaitMouseUpType)();

#if TARGET_RT_MAC_CFM
typedef UniversalProcPtr WaitMouseUpUPP;
#else
typedef ProcPtr WaitMouseUpUPP;
#endif
	
enum
{
	uppWaitMouseUpProcInfo = kPascalStackBased
		 | RESULT_SIZE(SIZE_CODE(sizeof(Boolean)))
};

#if TARGET_RT_MAC_CFM
#define NewWaitMouseUpProc(userRoutine)  \
		(WaitMouseUpUPP) NewRoutineDescriptor((ProcPtr)(userRoutine), uppWaitMouseUpProcInfo, GetCurrentISA())
#else
#define NewWaitMouseUpProc(userRoutine)		\
		((WaitMouseUpUPP) (userRoutine))
#endif
	
#if TARGET_RT_MAC_CFM
#define CallWaitMouseUpProc(userRoutine)		\
		CallUniversalProc((UniversalProcPtr)(userRoutine), uppWaitMouseUpProcInfo)
#else
#define CallWaitMouseUpProc(userRoutine)		\
		(*(userRoutine))()
#endif
	
class PatchWaitMouseUp : public TrapPatch
{
  public:
	void Install(WaitMouseUpType routine);
	bool CallInherited();
};

//--------------------------------------------------------------------------------------------------

void PatchWaitMouseUp::Install(WaitMouseUpType routine)
{
	patchRoutine = NewWaitMouseUpProc(StripLong(routine));
	::ThrowIfNULL_AC(patchRoutine);
	PatchTrap(_WaitMouseUp, patchRoutine);
}

//--------------------------------------------------------------------------------------------------

bool PatchWaitMouseUp::CallInherited()
{
	return CallWaitMouseUpProc((WaitMouseUpType) oldTrapAddr);
}

//========================================================================================

#if qPatchEventAvail
static PatchEventAvail		pEAPatch;					// patch for EventAvail 
#endif
static PatchGetNextEvent	pGNEPatch;					// patch for GetNextEvent 
static PatchInitCursor		pICPatch;					// patch for InitCursor 
static PatchSetCCursor		pSCCPatch;					// patch for SetCCursor 
static PatchSetCursor		pSCPatch;					// patch for SetCursor 
static PatchStillDown		pSDPatch;					// patch for StillDown under A/UX or PowerPC
static PatchWaitMouseUp		pWMUPatch;					// patch for WaitMouseUp under A/UX 

//========================================================================================
// GLOBAL Procedures
//========================================================================================

#if qPatchEventAvail
static pascal Boolean ResetBusyEventAvail(short eventMask, EventRecord* theEvent);
#endif
static pascal Boolean ResetBusyGetNextEvent(short eventMask, EventRecord* theEvent);
static pascal Boolean ResetBusyStillDown();
static pascal Boolean ResetBusyWaitMouseUp();

#if q68K
static pascal void ABusyTask();
#else
static pascal void ABusyTask(VBLTaskPtr vblTaskPtr);
#endif

#endif	// non-Carbon code

//----------------------------------------------------------------------------------------
// ResetBusyCursor:
//----------------------------------------------------------------------------------------

void TBusyCursor::ResetBusyCursor()
{
	if (fgBusyCursor)
		fgBusyCursor->Reset(fgBusyCursor->fBusyDelay);
}

#if !qCarbon && !qMSWindows

#if qPatchEventAvail
pascal Boolean ResetBusyEventAvail(short eventMask, EventRecord* theEvent)
{
	long OldA5 = SetCurrentA5();				// ***** Called from trap patches *****
	
	TBusyCursor::ResetBusyCursor();
	bool avail = pEAPatch.CallInherited(eventMask, theEvent);
	
	SetA5(OldA5);
	
	return avail;
}
#endif

pascal Boolean ResetBusyGetNextEvent(short eventMask, EventRecord* theEvent)
{
	long OldA5 = SetCurrentA5();				// ***** Called from trap patches *****
	
	TBusyCursor::ResetBusyCursor();
	bool avail = pGNEPatch.CallInherited(eventMask, theEvent);
	
	SetA5(OldA5);
	
	return avail;
}

pascal Boolean ResetBusyStillDown()
{
	long OldA5 = SetCurrentA5();				// ***** Called from trap patches *****
	
	TBusyCursor::ResetBusyCursor();
	bool isStillDown = pSDPatch.CallInherited();
	
	SetA5(OldA5);
	
	return isStillDown;
}

pascal Boolean ResetBusyWaitMouseUp()
{
	long OldA5 = SetCurrentA5();				// ***** Called from trap patches *****
	
	TBusyCursor::ResetBusyCursor();
	bool isStillDown = pWMUPatch.CallInherited();
	
	SetA5(OldA5);
	
	return isStillDown;
}

#endif	// non-Carbon code

//----------------------------------------------------------------------------------------
// SetCMacAppCursor: The SetCCursor patch, used to remember
// the color cursor being set. Installed as a "Head" patch, meaning the original
// SetCCursor trap is called after this code has completed.
//----------------------------------------------------------------------------------------

pascal void TBusyCursor::SetCMacAppCursorPatch(CCrsrHandle theCCursor)
{
#if qCarbon || qMSWindows
	#pragma unused (theCCursor)
#else
	long OldA5 = SetCurrentA5();				// ***** Called from trap patches *****
	
	if (fgBusyCursor)
		fgBusyCursor->SetCMacAppCursor(theCCursor);
	
	pSCCPatch.CallInherited(theCCursor);
	
	SetA5(OldA5);
#endif	// non-Carbon code
}

pascal void TBusyCursor::SetMacAppCursorPatch(const Cursor* theCursor)
{
#if qCarbon || qMSWindows
	#pragma unused (theCursor)
#else
	long OldA5 = SetCurrentA5();				// ***** Called from trap patches *****

	if (fgBusyCursor)	
		fgBusyCursor->SetMacAppCursor(theCursor);
	
	pSCPatch.CallInherited(theCursor);
	
	SetA5(OldA5);
#endif	// non-Carbon code
}

//----------------------------------------------------------------------------------------
// InitUBusyCursor:
//----------------------------------------------------------------------------------------

void TBusyCursor::InitUBusyCursor()
{
	fgBusyCursor = TH_new TBusyCursor;				// Create the BusyCursor mechanism 
}

//----------------------------------------------------------------------------------------
// InitMacAppCursor: Called when the InitCursor trap is executed. After completion, we
// jump to the ROM InitCursor.
//----------------------------------------------------------------------------------------

pascal void TBusyCursor::InitMacAppCursor()
{
#if !qCarbon && !qMSWindows
	long OldA5 = SetCurrentA5();				// ***** Called from trap patches *****
	
	if (fgBusyCursor)	
		fgBusyCursor->SetMacAppCursor(&qd.arrow);
	
	pICPatch.CallInherited();
	
	SetA5(OldA5);
#endif	// non-Carbon code
}

//----------------------------------------------------------------------------------------
// NextAnimatedCursor:
//----------------------------------------------------------------------------------------

CursHandle TBusyCursor::NextAnimatedCursor(AcurRsrcHandle acurRsrc)
{
	AcurRsrcRecord& whichAcurRsrc = **acurRsrc;	// OK: it's locked down in InitializeAnimatedCursor

	if (++whichAcurRsrc.whichCursor >= whichAcurRsrc.noOfCursors)
		whichAcurRsrc.whichCursor = 0;

	return whichAcurRsrc.cursors[whichAcurRsrc.whichCursor].Memory.h;
}

//----------------------------------------------------------------------------------------
// ABusyTask:
//----------------------------------------------------------------------------------------

#ifdef __SC__
#pragma trace off		// Never generate function preambles and postambles for the interrupt time routine
#endif

#if !qCarbon && !qMSWindows

pascal void ABusyTask(
#if !q68K
						VBLTaskPtr vblTaskPtr
#endif
												)
{
	// if we are running native PowerPC, the runtime architecture passes us a pointer to our
	// VBLTask as a parameter� othewise we have to retrieve it.
#if q68K
	VBLTaskPtr vblTaskPtr = (VBLTaskPtr)GetParmBlockPtr();
#endif
		
	TBusyCursor* theBusyCursor = ((QElemWithBusyCursor*)vblTaskPtr)->fBusyCursor;
	if (theBusyCursor)
	{
		long OldA5 = SetA5(theBusyCursor->fA5);
	
		theBusyCursor->BusyTask();

		SetA5(OldA5);
	}
}

#endif	// non-Carbon code

//========================================================================================
// CLASS TBusyCursor
//========================================================================================

//----------------------------------------------------------------------------------------
// TBusyCursor::TBusyCursor:
//----------------------------------------------------------------------------------------

TBusyCursor::TBusyCursor()
	:	fCursorState(NULL),
		fACUR(kNoResource),
		fOrigCCursor(NULL),
		fTicksBeforeTimeout(kTicksBeforeTimeout),
		fBusyStartedTicks(0),
		fAnimationStartedTicks(0),
		fA5(SetCurrentA5()),		// make the A5 world available to the VBL task
									// note: this was previously done with GetA5, but it
									// should be safe for us to use the PowerPC-compatible
									// SetCurrentA5 instead at this point�
		fBusyDelay(kBusyDelay),
		fAnimateDelay(kAnimateDelay),
		fInColor(false),
		fInControl(true),			// we are in control during initialization 
		fChangeToBusy(true),
		fIgnoreReset(false),
		fBusyOn(false)
{
	// Setup the pCursorInfo record 
#if !qCarbon && !qMSWindows
	fOrigCursor = qd.arrow;
#else
	::GetQDGlobalsArrow(&fOrigCursor);
#endif

	SetAnimatedCursor(kAcurRsrcID, kAnimateDelay);// init the animated cursor routine

#if !qCarbon && !qMSWindows

	// Setup the VBL task 
	fQElemWithBusyCursor.q.qType = vType;
#ifdef CALLBACK_API_REGISTER68K
	::ThrowIfNULL_AC(fQElemWithBusyCursor.q.vblAddr = NewVBLUPP(ABusyTask));
#else
	::ThrowIfNULL_AC(fQElemWithBusyCursor.q.vblAddr = NewVBLUPP(reinterpret_cast<VBLProcPtr>(ABusyTask)));
#endif
	fQElemWithBusyCursor.q.vblCount = kBusyDelay;
	fQElemWithBusyCursor.q.vblPhase = 0;
	fQElemWithBusyCursor.fBusyCursor = this;

	// Patch the necessary traps 
	pSCPatch.Install(SetMacAppCursorPatch);
	pICPatch.Install(InitMacAppCursor);
	pSCCPatch.Install(SetCMacAppCursorPatch);

	// Install the VBL task 
	::ThrowIfOSErr_AC(VInstall((QElemPtr) & fQElemWithBusyCursor.q));
	pBusyCursorVBLInstalled = true;

	// Patch the traps applicable 
	pGNEPatch.Install(ResetBusyGetNextEvent);
	pSDPatch.Install(ResetBusyStillDown);
#if qPatchEventAvail
	pEAPatch.Install(ResetBusyEventAvail);
#endif
	if (HasAUX_AC())
		pWMUPatch.Install(ResetBusyWaitMouseUp);

#endif	// non-Carbon code

	// Set busy delay 
	SetDelay(kBusyDelay);
}

//----------------------------------------------------------------------------------------
// TBusyCursor::Free:
//----------------------------------------------------------------------------------------

TBusyCursor::~TBusyCursor()
{
	Reset(1);									// Restore the non-busy cursor 

#if !qCarbon && !qMSWindows
	if (pBusyCursorVBLInstalled)
		VRemove((QElemPtr) & fQElemWithBusyCursor.q);	// Remove the VBL task 
#endif	// non-Carbon code

	ReleaseAnimatedCursor();

#if !qCarbon && !qMSWindows
	// Unpatch the patches 
	pICPatch.UnpatchTrap();
	pSCPatch.UnpatchTrap();
	pSCCPatch.UnpatchTrap();

	pGNEPatch.UnpatchTrap();
	pSDPatch.UnpatchTrap();
#if qPatchEventAvail
	pEAPatch.UnpatchTrap();
#endif
	if (HasAUX_AC())
		pWMUPatch.UnpatchTrap();
#endif	// non-Carbon code
}

//----------------------------------------------------------------------------------------
// TBusyCursor::Reset:
//----------------------------------------------------------------------------------------

void TBusyCursor::Reset(unsigned short delayTicks)
{
	if (fInControl && fChangeToBusy && !fIgnoreReset)
	{
		if (fBusyOn)
			if (fInColor)
				SetCCursor(fOrigCCursor);
			else
				MacSetCursor(&(fOrigCursor));
#if !qCarbon
		fQElemWithBusyCursor.q.vblCount = delayTicks;
#else
#pragma unused (delayTicks)
#endif
	}
}

//----------------------------------------------------------------------------------------
// TBusyCursor::Activate:
//----------------------------------------------------------------------------------------

bool TBusyCursor::Activate(bool entering)
// Activate restores the cursor to its original state and turns the busy-cursor 
// mechanism on or off depending on the value specified for the entering parameter. This method returns true if the busy-cursor mechanism was active, or false if the busy-cursor mechanism was inactive.
//
// entering:	If true, this method enables the busy-cursor mechanism. If false, 
// this method disables the busy-cursor mechanism.
//
// Call?		Seldom. MacApp uses this method when the application�s 
//				functions are temporarily unavailable to the user; for example, during a context switch under MultiFinder, or during the completion of a system request.
// Override?	Seldom.
{
	return InControl(entering, true);
}

//----------------------------------------------------------------------------------------
// TBusyCursor::InControl:
//----------------------------------------------------------------------------------------

bool TBusyCursor::InControl(bool entering, bool reset)
{
	if (reset)
		Reset(fBusyDelay);
 
	bool returnVal = fInControl;
	fInControl = entering;
 
	return returnVal;
}
 
//----------------------------------------------------------------------------------------
// TBusyCursor::SetDelay:
//----------------------------------------------------------------------------------------

void TBusyCursor::SetDelay(unsigned short newDelay)
{
	if (newDelay > 0)							// save new delay time 
	{
		fBusyDelay = newDelay;
		Reset(newDelay);						// reset timer 
	}
}

//----------------------------------------------------------------------------------------
// TBusyCursor::ForceBusy: set the cursor to the busy cursor
//----------------------------------------------------------------------------------------

void TBusyCursor::ForceBusy()
{
#if !qCarbon && !qMSWindows
// ��� MEB LMGetCrsrBusy not available in Carbon
	bool wasInControl = fInControl;
	bool toolBoxWasBusy = LMGetCrsrBusy();

	if (!toolBoxWasBusy && wasInControl && fChangeToBusy)
	{
		fInControl = false; // so the vbl doesn't whack us!

		unsigned long currentTicks = TickCount();
		if (!fBusyOn)
			fBusyStartedTicks = currentTicks;

		bool needSetCursor = !fBusyOn;
		if (fCursorState)			// if we have an animated cursor 
		{
			if (currentTicks >= fAnimationStartedTicks + fAnimateDelay
			&& currentTicks < fBusyStartedTicks + fTicksBeforeTimeout)
			{
				fCurrentCursor = **NextAnimatedCursor(fCursorState);
				fAnimationStartedTicks = currentTicks;
				needSetCursor = true;
			}
		}

		if (needSetCursor)
			SetCursor(&fCurrentCursor);

		fInControl = wasInControl; // so the vbl doesn't whack us!
	}

	// always Reset the vblCount
	short newCount = fBusyDelay;
	if (fCursorState && fBusyOn)
		newCount = fAnimateDelay;
	else if (toolBoxWasBusy)
		newCount = 1;
	fQElemWithBusyCursor.q.vblCount = newCount;
#endif	// non-Carbon code
}

//----------------------------------------------------------------------------------------
// TBusyCursor::TurnOff: This is called from InitMacAppCursor, SetMacAppCursor and
// SetCMacAppCursor. It sets pCursorInfo fields to indicate that the cursor is not the
// busy cursor.
//----------------------------------------------------------------------------------------

void TBusyCursor::TurnOff()
{
	if (fInControl && fChangeToBusy)
	{
		fBusyOn = false;				// anyone that sets the busy cursor should set this true explicitly
#if !qCarbon
		fQElemWithBusyCursor.q.vblCount = fBusyDelay;
#endif
	}
}

//----------------------------------------------------------------------------------------
// TBusyCursor::InitializeAnimatedCursor:
//----------------------------------------------------------------------------------------

AcurRsrcHandle TBusyCursor::InitializeAnimatedCursor(ResNumber acurRsrcId)
{
	ReserveMem(sizeof(AcurRsrcRecord)); // so it will load low
	AcurRsrcHandle	acurRsrc = (AcurRsrcHandle)CMultiLocale_AC::GetResource('acur', acurRsrcId);

	if (acurRsrc)
	{
		fACUR = acurRsrcId;
		::DetachResource(reinterpret_cast<Handle>(acurRsrc)); // cause we do bookkeeping in it. Don't want to dirty orig.
		::HNoPurge(reinterpret_cast<Handle>(acurRsrc));
		::Lock_AC(reinterpret_cast<Handle>(acurRsrc));
		(*acurRsrc)->whichCursor = 0;

		// Load each cursor in the sequence and lock them in memory 
		for (short i = 0; i < (*acurRsrc)->noOfCursors; ++i)
		{
			::ReserveMem(sizeof(Cursor)); // so it will load low
			CursHandle theCursor = MacGetCursor((*acurRsrc)->cursors[i].Disk.rsrcId);// Get the cursor from the disk
			::ThrowIfNULLResource_AC(reinterpret_cast<Handle>(theCursor));
			(*acurRsrc)->cursors[i].Memory.h = theCursor;	// remember the cursor
			::HNoPurge(reinterpret_cast<Handle>(theCursor));
			::Lock_AC(reinterpret_cast<Handle>(theCursor));			// Make sure it is locked
		}
	}

	return acurRsrc;
}

//----------------------------------------------------------------------------------------
// TBusyCursor::Animate:
//----------------------------------------------------------------------------------------

void TBusyCursor::Animate()
// Animate causes the cursor to spin.
//
// Call?		As needed. You can call this method during a lengthy 
//				operation to prevent cursor animation from timing out.
// Override?	Seldom.
{
	fBusyStartedTicks = TickCount();			// prevent timeout for another while
}

//----------------------------------------------------------------------------------------
// TBusyCursor::SetTimeout:
//----------------------------------------------------------------------------------------

void TBusyCursor::SetTimeout(unsigned long ticksBeforeTimeout)
{
	fTicksBeforeTimeout = ticksBeforeTimeout;

	fBusyStartedTicks = TickCount();			// restart the timeout
}

//----------------------------------------------------------------------------------------
// TBusyCursor::KeepCursorBusy:
//----------------------------------------------------------------------------------------

bool TBusyCursor::KeepCursorBusy(bool keepItSpinning)
{
	bool currentSetting = fIgnoreReset;
	fIgnoreReset = keepItSpinning;

	return currentSetting;
}

//----------------------------------------------------------------------------------------
// TBusyCursor::SetAnimatedCursor:
//----------------------------------------------------------------------------------------

ResNumber TBusyCursor::SetAnimatedCursor(ResNumber itsACUR, unsigned short animateDelay)
{
	ResNumber returnVal = fACUR;
	
	bool wasInControl = fInControl;
	fInControl = false; // so the vbl doesn't whack us!

	ReleaseAnimatedCursor();

	fCursorState = InitializeAnimatedCursor(itsACUR);// init the animated cursor routine
	if (fCursorState)
		fCurrentCursor = **NextAnimatedCursor(fCursorState);// get the first cursor
	else
		fCurrentCursor = **MacGetCursor(watchCursor);

	fAnimateDelay = animateDelay;

	fInControl = wasInControl;
	
	return returnVal;
}


//----------------------------------------------------------------------------------------
// TBusyCursor::ReleaseAnimatedCursor:
//----------------------------------------------------------------------------------------

void TBusyCursor::ReleaseAnimatedCursor()
{
	if (fCursorState)
	{
		for (short i = 0; i < (*fCursorState)->noOfCursors; ++i)
			ReleaseResource((Handle)(*fCursorState)->cursors[i].Memory.h);
		fCursorState = (AcurRsrcHandle)::DisposeIfHandle_AC((Handle)fCursorState);
	}
}

//----------------------------------------------------------------------------------------
// SetMacAppCursor: Patches SetCursor to remember the
// cursor being set. Installed as a "Head" patch, meaning the original SetCursor trap is
// called after this code has completed. Also called from InitMacAppCursor.
//----------------------------------------------------------------------------------------

void TBusyCursor::SetMacAppCursor(const Cursor* theCursor)
{
	TurnOff();

	// If we are setting the cursor to the busy cursor, then don't save it 
	if (theCursor != &fCurrentCursor)
	{
		fInColor = false;
		fOrigCursor = *theCursor;
	}
	else
		fBusyOn = true;				// because BusyTurnOff set it to false
}

//----------------------------------------------------------------------------------------
// SetCMacAppCursor: SetCursor is called from the ABusyTask VBL task. The SetCCursor patch, used to remember
// the color cursor being set. Installed as a "Head" patch, meaning the original
// SetCCursor trap is called after this code has completed.
//----------------------------------------------------------------------------------------

void TBusyCursor::SetCMacAppCursor(CCrsrHandle theCCursor)
{
	TurnOff();

	fInColor = true;
	fOrigCCursor = theCCursor;		// Save a copy of the color cursor 
}

//----------------------------------------------------------------------------------------
// TBusyCursor::BusyTask
//----------------------------------------------------------------------------------------

void TBusyCursor::BusyTask()
{
	ForceBusy();
}

//----------------------------------------------------------------------------------------
// End of UBusyCursor.cpp

/*
	Historical Change Record:
		----- R11 -----
		06/26/96	Changed nil back to NULL.
		06/26/96	Install release marker.  Scope many globals.  Change TRUE/FALSE/NULL.
		06/24/96	[1345531] Added #include "UStreamable.h" for noload buids
		04/30/96	Make all constructors use initialization lists if they weren't already
							doing do. Switch several more empty constructors to inlines.
		04/23/96	Use CTempObject/Handle/Region/Ptr, etc.
		----- R10 -----
		03/30/96	Don't set the watchcursor on launch. Our launches are fast enough
							now that the user perception is better if the cursor doesn't change unless
							the app will be busy for a while, and then the cursor will change automatically
							with the busycursor unit.
		03/18/96	Remove compatibility hacks.
		03/12/96	Made globals into member data and functions. Added
							TBusyCursor::TerminateBusyCursor
		12/08/95	Split up includes for modular MacApp. 
		----- 3.3 -----
		10/27/95	Activate returns old state.
		----- 3.3b1 -----
		09/05/95	Don't Detach resources. Call ReleaseResource when done with 'em.
							Move old pCursorInfo directly into TBusyCursor since objects are
							pointer based.
		07/28/95	Add configuration functions to use instead of gConfiguration. 
		04/24/95	Remove unnecessary #pragma push/trace off/pop
		03/13/95	1228351 Can't set a new busycursor animation
		03/13/95	Change Free methods to destructors. 
		02/21/95	Fix UPP definitions to work with OLDROUTINENAMES=0. 
		02/13/95	Remove unnecessary initialization of static variables. See ARM �8.4 
		02/13/95	make "p" (private) globals static 
		02/13/95	add static to global functions used internally 
		02/13/95	removed pascal from ResetBusyCursor and SetMacAppCursor
		01/11/95	TBusyCursor::Free was calling ReleaseResource to
							free cursor resources that had been detached. It
							now calls DisposeHandle.
		----- 3.5d3 Release -----
		11/13/94	Add pCursor.ignoreReset and KeepCursorBusy per Ken
							Ryall's changes.  Enable persistent busy cursor
							while acting as an apple event client.
		07/12/94	Patch StillDown for both PPC and 68K instead of patching
							EventAvail on 68K. Was causing spurious mouse ups. 
		06/21/94	Create patches using objects instead of code fragments. 
		06/20/94	Make the TrapPatch structure an object. 
*/