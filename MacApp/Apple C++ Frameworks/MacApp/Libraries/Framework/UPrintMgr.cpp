//----------------------------------------------------------------------------------------
// UPrintMgr.cpp
// Copyright © 1985-2001 by Apple Computer, Inc. All rights reserved.
//----------------------------------------------------------------------------------------

/*
	Change History
		08/15/01	Use kPMNoDefaultPrinter instead of errNoPrintDrvr.  Include
					PMDefinitions.h.
		01/11/01	Use CString_AC instead of CStr255_AC.
		01/02/01	Update copyright.
		06/14/00	Remove MASetResLoad(true) call at top of Restore.  Include CMultiLocal.h.
					Call CMultiLocale_AC::AddResource instead of MAAddResource.
		04/24/00	added non-inline versions of CPrintJobStarterStopper ctor/dtor for
					qDebug.  Do not throw res error in Restore when doing temp res.
		04/21/00	Removed commented out code.
		04/18/00	Renamed UPrintMgr.cpp.  Moved in TPrintInfo.  Changed kPrintMenuBehaviorID
					to scPrintMenuBehaviorID.  Changed kPrintBehaviorID to
					scPrintBehaviorID.  Changed kPrintInfoRsrcID
					to scPrintInfoRsrcID.
		04/06/00	Inlined empty functions or made them pure virtual.  General cleanup.
		03/24/99	Update copyright notice.
		10/08/98	GetPrintCommandContext. 
*/

#ifndef __UPrintMgr__
#include "UPrintMgr.h"
#endif

// MacApp

#ifndef __UDOCUMENT__
#include "UDocument.h"
#endif

#ifndef __UFILE__
#include "UFile.h"
#endif

#ifndef __UMACAPPGLOBALS__
#include "UMacAppGlobals.h"
#endif

#ifndef __UMACAPPUTILITIES__
#include "UMacAppUtilities.h"
#endif

#ifndef __UVIEW__
#include "UView.h"
#endif

// ACS

#ifndef __CFileStream_AC__
#include "CFileStream_AC.h"
#endif

#ifndef __CHandle_AC__
#include "CHandle_AC.h"
#endif

#ifndef __CHandleStream_AC__
#include "CHandleStream_AC.h"
#endif

#ifndef __CMultiLocal_AC__
#include "CMultiLocal_AC.h"
#endif

#ifndef __CStream_AC__
#include "CStream_AC.h"
#endif

// Toolbox

#ifndef __PMDEFINITIONS__
#include <PMDefinitions.h>
#endif

//========================================================================================
// static data members
//========================================================================================

bool						TPrintHandler::gFinderPrintingProceed;		// proceed with Finder printing
bool						TPrintHandler::gCouldPrint;
CViewPoint					TPrintHandler::gPageOffset;
CAutoPtr_AC<TPrintHandler>	TPrintHandler::gPrintHandler;
CAutoPtr_AC<TPrintHandler>	TPrintHandler::gCurrPrintHandler;

TRefCntPrintInfo			gDefaultPrintInfo;

//========================================================================================
// CLASS CPrintJobStarterStopper
//========================================================================================

#if qDebug

//----------------------------------------------------------------------------------------
// CPrintJobStarterStopper constructor
//----------------------------------------------------------------------------------------

CPrintJobStarterStopper::CPrintJobStarterStopper(TRefCntPrintInfo thePrintJob)
	:	fPrintJob(thePrintJob)
{
	ThrowIfNonObject_AC(fPrintJob);
	fJobStarted = fPrintJob->StartPrintJob(this);
}

//----------------------------------------------------------------------------------------
// CPrintJobStarterStopper destructor
//----------------------------------------------------------------------------------------

CPrintJobStarterStopper::~CPrintJobStarterStopper() throw()
{
	try
	{
		fPrintJob->StopPrintJob(this, fJobStarted);
	}
	catch (...) { }		// Eat exceptions.
}

#endif

//========================================================================================
// CLASS TPrintMenuBehavior
//========================================================================================

MA_DEFINE_CLASS(TPrintMenuBehavior);

//----------------------------------------------------------------------------------------
// TPrintMenuBehavior constructor
//----------------------------------------------------------------------------------------

TPrintMenuBehavior::TPrintMenuBehavior(TPrintHandler* itsPrintHandler)
	:	TBehavior(scPrintMenuBehaviorID),
		fPrintHandler(itsPrintHandler)
{
	if (fPrintHandler)
		fPrintHandler->SetManager(this);
}

//----------------------------------------------------------------------------------------
// TPrintMenuBehavior::DoScriptCommand: 
//----------------------------------------------------------------------------------------

bool TPrintMenuBehavior::DoScriptCommand(	CommandNumber 	aCommandNumber,	
											TAppleEvent*	messageEvent,
											TAppleEvent*	replyEvent)
{
	bool wasHandled = false;

	if (fPrintHandler)
	{
		wasHandled = fPrintHandler->DoScriptCommand(aCommandNumber, messageEvent, replyEvent);
		// Note: DoScriptCommand is implemented in TStdPrintHandler, not TPrintHandler. 
	}

	if (!wasHandled)
		wasHandled = TBehavior::DoScriptCommand(aCommandNumber, messageEvent, replyEvent);

	return wasHandled;
}

//----------------------------------------------------------------------------------------
// TPrintMenuBehavior::DoMenuCommand: 
//----------------------------------------------------------------------------------------

void TPrintMenuBehavior::DoMenuCommand(CommandNumber aCommandNumber)
{
	// Can print if:
	//  • have a print handler, and
	//  • print handler has a view, and
	//    either • view is not shown (e.g., Finder printing), or
	//           • view is active.
	//			 • we are printing from the finder
	// NOTE: we don't support printing of view's that are shown, but not active.

	// This algorithm allows a document to arbitrate between its various
    // TPrintMenuBehavior objects, representing several printable views owned by the
    // document. This arbitration wasn't supported in MacApp prior to version 3.0.

	bool didPrint = false;
	if (fPrintHandler && fPrintHandler->fView && (!fPrintHandler->fView->IsShown() || fPrintHandler->fView->IsActive() || TPrintHandler::gFinderPrintingProceed))
		didPrint = fPrintHandler->DoPrintCommand(aCommandNumber);

	if (!didPrint)
		TBehavior::DoMenuCommand(aCommandNumber);		// if we didn't print, call Inherited
}

//----------------------------------------------------------------------------------------
// TPrintMenuBehavior::DoSetupMenus: 
//----------------------------------------------------------------------------------------

void TPrintMenuBehavior::DoSetupMenus()
{
	TBehavior::DoSetupMenus();

	// see note in TPrintMenuBehavior::DoMenuCommand
	if (fPrintHandler && fPrintHandler->fView && (!fPrintHandler->fView->IsShown() || fPrintHandler->fView->IsActive() || TPrintHandler::gFinderPrintingProceed))
		fPrintHandler->DoSetupPrintMenus();
}

//========================================================================================
// CLASS TPrintInfo
//========================================================================================

//----------------------------------------------------------------------------------------
// TPrintInfo::InitUPrintMgr: 
//----------------------------------------------------------------------------------------

void TPrintInfo::InitUPrintMgr(	TRefCntPrintInfo	defaultPrintInfo,
								TPrintHandler*		defaultPrintHandler)
// InitUPrintMgr performs common application startup print initialization.  You should
// not call this from your application's main, rather it should be called by your 
// environment-specific print initialization such as InitUClassicPrinting, InitUGXPrinting,
// or InitUCarbonPrinting.  One and only one of those three should be called in your main.
// If you want GX printing be aware that Classic printing is also required, that you
// should call InitUGXPrinting(), and that it in turn calls InitUClassicPrinting.  When
// printing under Carbon only the Carbon printing unit should be included.
{
	static bool printingInitialized;

	if (!printingInitialized)
	{
		TPrintHandler::gCouldPrint = true;

		// Make sure some other print initialization 
		// has set up the default print info.
		ThrowIfNonObject_AC(defaultPrintInfo.get());
		gDefaultPrintInfo = defaultPrintInfo;
		
		// Install the PrintHandler in global variable gPrintHandler
		AssertNotNULL_AC(defaultPrintHandler);
		TPrintHandler::gPrintHandler = defaultPrintHandler;

		printingInitialized = true;
	}
}

//----------------------------------------------------------------------------------------
// TPrintInfo constructor
//----------------------------------------------------------------------------------------

TPrintInfo::TPrintInfo()
	:	fIsValid(false),
		fNeedsDefault(false)
{
	if (gDefaultPrintInfo)
		gDefaultPrintInfo->AddDependent(this);
}

//----------------------------------------------------------------------------------------
// TPrintInfo copy constructor
//----------------------------------------------------------------------------------------

TPrintInfo::TPrintInfo(const TPrintInfo& inPrintInfo)
	:	MDependable_AC(inPrintInfo),
		MStreamable_AC(inPrintInfo),
		fCurrentDocTitle(inPrintInfo.fCurrentDocTitle),
		fIsValid(inPrintInfo.fIsValid),
		fNeedsDefault(inPrintInfo.fIsValid)
{
	if (gDefaultPrintInfo)
		gDefaultPrintInfo->AddDependent(this);
}

//----------------------------------------------------------------------------------------
// TPrintInfo::ReadFrom: 
//----------------------------------------------------------------------------------------

void TPrintInfo::ReadFrom(CStream_AC* aStream)
{
	MStreamable_AC::ReadFrom(aStream);
	fNeedsDefault = false;
	Invalidate();
}

//----------------------------------------------------------------------------------------
// TPrintInfo::Save
//----------------------------------------------------------------------------------------

void TPrintInfo::Save(TFile* itsFile, bool useRsrcFork)
// Save writes the print info record out to the file's resource fork if there
// is one, otherwise it is written to the data fork.   The print info is checked
// to see if it is set to the default.  Default print info is not saved.   Non-default
// print info is written to the resource fork, if any, as a resource, as expected.  If
// there is no resource fork then the print info is written to the datafork.  A unsigned
// long length is always written to the data fork even if it is zero, such as will be
// the case with default print info.
//
// itsFile:			A pointer to the file to which the print info record is to be written.
// useRsrcFork:		A bool which, when true, indicates that the print info is to be
//					written to the resource fork.
{
	// Decide if we have a default print info record.
	// If this is a default print info then the user has not expressed
	// any specific preference: don't write the print info; this way it will
	// default next time as well.
	if (!IsSetToDefault())
	{
		// We do not have a default print info so create a handle containing
		// the print info.
		CTempHandle_AC		aHandle = NewPermHandle_AC(256);
		CHandleStream_AC	aHandleStream(aHandle, 256);
		WriteTo(&aHandleStream);

		// Do we have a resource fork available and should we try to use it?
		if (useRsrcFork && itsFile->HasRsrcFork())
		{
			// Is the resource fork open?
			if (itsFile->IsRsrcForkOpen())
			{
				CTempUseResFile_AC tempUseResFile(itsFile->GetRsrcRefNum());
	
#if qDebug
				CMultiLocale_AC::AddResource(aHandle, GetResType(), scPrintInfoRsrcID, ConstStr255Param("PrintInfo"));
#else
				CMultiLocale_AC::AddResource(aHandle, GetResType(), scPrintInfoRsrcID, gEmptyString);
#endif
				::ThrowIfResError_AC();

				WriteResource(aHandle);
				ReleaseResource(aHandle.release());
				aHandleStream.SetHandle(NULL);
			}
#if qDebug
			else
				::ProgramBreak_AC("TPrintInfo::Save: We want to write the print info to the resource fork but it's not open!");
#endif
		}
		else if (itsFile->HasDataFork())
		{
			CFileStream_AC	itsStream(itsFile);
			itsStream.WriteIDType(GetResType());
			itsStream.WriteUnsignedLong(GetHandleSize(aHandle.get()));
			WriteTo(&itsStream);
		}
#if qDebug
		else
			::ProgramBreak_AC("TPrintInfo::Save: What?  No resource fork and no data fork?  Impossible!");
#endif
	}
	else if (!useRsrcFork || !itsFile->HasRsrcFork())
	{
		// We're supposed to write to the data fork but there's no data to write
		// so just write the type and length.
		CFileStream_AC	itsStream(itsFile);
		itsStream.WriteIDType(GetResType());
		itsStream.WriteUnsignedLong(0);
	}
}

//----------------------------------------------------------------------------------------
// TPrintInfo::Restore
//----------------------------------------------------------------------------------------

void TPrintInfo::Restore(TFile* itsFile, bool useRsrcFork)
// Restore reads the print info from the file's resource (or data) fork.  The default
// behavior is to simply retrieve a resource of the environment's preferred type.  You
// may, however, want to be able to read other print info types and convert them to
// your preferred type.  Do this in an override of this function.
// Note: The default print info preferred by this document will have already been
// set into this.  If an appropriate resource type cannot be found the default
// will still be set.
//
// itsFile:		A pointer to the file from which the print info is to be retrieved.
// useRsrcFork:	A bool indicating if resource-based print info is preferred, the default.
{
	Handle	printInfoHandle = NULL;
	bool	wasFromResource = false;

	// Our preference is to retrieve the print info from a resource.
	if (useRsrcFork && itsFile->HasRsrcFork())			// Read the print info resource 
	{
		if (itsFile->IsRsrcForkOpen())
		{
			CTempUseResFile_AC tempUseResFile(itsFile->GetRsrcRefNum());
			printInfoHandle = ::Get1Resource(GetResType(), scPrintInfoRsrcID);
			wasFromResource = true;
		}
#if qDebug
		else
			::ProgramBreak_AC("TPrintInfo::Restore: We want to read the print info from the resource fork but it's not open!");
#endif
	}
	else if (itsFile->HasDataFork())
	{
		// Read the type and handle.
		CFileStream_AC	itsStream(itsFile);
		IDType	handleType = itsStream.ReadIDType();
		if (handleType == GetResType())
			// By default, we don't want to use the print info if it's not our type.
			printInfoHandle = itsStream.ReadHandle();
		else
			CTempHandle_AC	dummy(itsStream.ReadHandle());	// We have to move over the handle
													// so the reader is positioned properly.
	}
#if qDebug
	else
		::ProgramBreak_AC("TPrintInfo::Restore: What?  No resource fork and no data fork?  Impossible!");
#endif

	// If we actually retrieved something lets process it.
	if (printInfoHandle)
	{
		if (wasFromResource)
			DetachResource(printInfoHandle);

		{
			// This block is so that aHandleStream is disposed before we dispose of the handle.
			CHandleStream_AC	aHandleStream(printInfoHandle, 256);
			ReadFrom(&aHandleStream);					// Set ourselves up.
		}

		// Clean things up.
		DisposeIfHandle_AC(printInfoHandle);
	}
}

//----------------------------------------------------------------------------------------
// TPrintInfo::SetFrom
//----------------------------------------------------------------------------------------

void TPrintInfo::SetFrom(TRefCntPrintInfo jobToCopy)
{
	fIsValid = jobToCopy->IsValid();
	fNeedsDefault = jobToCopy->NeedsDefault();
}

//----------------------------------------------------------------------------------------
// TPrintInfo::Clone
//----------------------------------------------------------------------------------------

TRefCntPrintInfo TPrintInfo::Clone() const
{
	TRefCntPrintInfo newPrintInfo = Make();	// Polymorphic!
	newPrintInfo->SetFrom(const_cast<TPrintInfo*>(this));
		// Note: We know we're passing a TPrintInfo* instead of a TRefCntPrintInfo but
		// it's being copied so it should be safe.  Just don't change the original
		// TPrintInfo within the SetFrom function.
	return newPrintInfo;
}

//----------------------------------------------------------------------------------------
// TPrintInfo::DoUpdate:
//----------------------------------------------------------------------------------------

void TPrintInfo::DoUpdate(ChangeID_AC			theChange,
						  MDependable_AC*		changedObject,
						  void*					changeData,
						  CDependencySpace_AC*	dependencySpace)
{
	switch (theChange)
	{
		case mPrinterChanged:
			Invalidate();
			break;

		case mPrinterOpened:
			Update();						// Pool's open!
			break;

		default:
			MDependable_AC::DoUpdate(theChange, changedObject, changeData, dependencySpace);
	}
}

//----------------------------------------------------------------------------------------
// TPrintInfo::Invalidate:
//----------------------------------------------------------------------------------------

void TPrintInfo::Invalidate()
{
	fIsValid = false;
	Changed(mPrintInfoChanged, this);
}

//----------------------------------------------------------------------------------------
// TPrintInfo::GetDefaultPrintInfo:
//----------------------------------------------------------------------------------------

const TRefCntPrintInfo TPrintInfo::GetDefaultPrintInfo() const
// Returns THE default TPrintInfo.
{
	return gDefaultPrintInfo;
}
		
//----------------------------------------------------------------------------------------
// TPrintInfo::Update:
//----------------------------------------------------------------------------------------

void TPrintInfo::Update() const
{
	if (!fIsValid && TPrintHandler::gCouldPrint)
	{
		try
		{
			bool wantedDefault = fNeedsDefault;
			fNeedsDefault = false;
			TRefCntPrintInfo defaultPrintInfo = GetDefaultPrintInfo();
			if (wantedDefault && IsSetToDefault())
				fIsValid = true;				// matches the default. No validation necessary!
			else if (wantedDefault && (defaultPrintInfo != this) && defaultPrintInfo->IsValid())
			{
				TRefCntPrintInfo	nonConstThis = const_cast<TPrintInfo*>(this);
				nonConstThis->SetFrom(defaultPrintInfo);
			}
			else								// need to go ask Printing Management
			{
				TRefCntPrintInfo	nonConstThis = const_cast<TPrintInfo*>(this);
				if (wantedDefault)
					nonConstThis->SetPrintJobDefaults();
				else
					nonConstThis->ValidatePrintJob();

				fIsValid = true;
			}
		}
		catch(CException_AC& theException)
		{
			DoCatchMessage_AC(theException);
			if (theException.GetError() != kPMNoDefaultPrinter)
				throw;
		}
		
	}
}

//========================================================================================
// CLASS TPrintHandler
//========================================================================================

//----------------------------------------------------------------------------------------
// TPrintHandler constructor
//----------------------------------------------------------------------------------------

TPrintHandler::TPrintHandler(TView* itsView)
	:	TBehavior(scPrintBehaviorID),	// attaching to the view is handled by AttachPrintHandler
		fView(itsView),
		fDocument(NULL),
		fManager(NULL),
		fFocusedPage(1),
		fShowBreaks(false),
		fDeviceRes(72, 72) // default matches QD default
{
}

//----------------------------------------------------------------------------------------
// TPrintHandler::SetupForFinder: 
//----------------------------------------------------------------------------------------

bool TPrintHandler::SetupForFinder(CommandNumber aCommandNumber)
{
	#pragma unused (aCommandNumber)
#if qDebugMsg
	ProgramReport_AC("SetupForFinder called for a view that can't.\n");
#endif

	return false;
}

//----------------------------------------------------------------------------------------
// TPrintHandler::SetOwner
//----------------------------------------------------------------------------------------

void TPrintHandler::SetOwner(TEventHandler* itsOwner) // override
{
	TBehavior::SetOwner(itsOwner);

#if qAppleEventAware

	if (fView)
	{
		TWindow* window = fView->GetWindow();
		if (window)
		{
			if (itsOwner)
			{
				if (itsOwner == fView)
					window->SetScriptingPrintHandler(this);
			}
			else
			{
				window->ReleaseScriptingPrintHandler(this);
				// Note: This does not get called when a window is closed
				// because the window goes away first. 
			}
		}
	}
#endif
}

//----------------------------------------------------------------------------------------
// TPrintHandler::GetPrintCommandContext
//----------------------------------------------------------------------------------------

TEventHandler* TPrintHandler::GetPrintCommandContext() const
{
	TEventHandler* context;

	if (fDocument)
		context = fDocument;
	else if (fView)
	{
		TWindow* window = fView->GetWindow();
		context = window ? window : fView;
	}
	else
		context = NULL;

	return context;
}

//----------------------------------------------------------------------------------------
// End of UPrintMgr.cpp



/*
	Historical Change Record:
		----- R11 -----
		06/26/96	Changed nil back to NULL.
		06/26/96	Install release marker.  Scope many globals.  Change TRUE/FALSE/NULL.
		 5/08/96	Create and use CFSSpec_AC. You should search/replace in your code to switch to
		 					CFSSpec_AC.
		04/30/96	Make all constructors use initialization lists if they weren't already
							doing do. Switch several more empty constructors to inlines.
		 4/26/96	Made C/CViewPoint/Rect default constructors set the point/rect to a cleared value. Made
		 					clearing very fast/compact. Eliminated the now unnecessary hand clearing of C/CViewPoint/Rects.
		----- R10 -----
		03/28/96	Change several functions to return CViewPoint/VRects rather than take them as & parameters
		03/27/96	Add DispatcherIsAvailable call to complete UPrinting initialization.
		03/21/96	Make drag printing work again.
		  3/1/96	make gFinderPrintingProceed a static data member of TPrintHandler.
		 11/1/95	Add SetOwner so print handler can register and unregister
							itself with the window. 
		10/31/95	Add TPrintMenuBehavior::DoScriptCommand.
		----- 3.3b1 -----
		08/08/95	Added Invalidate and Update. Removed CheckPrinter.
							Moved fShowBreaks to TPrintHandler.
		07/30/95	Made fViewPerPage, fDeviceRes protected and added accessors.
							Make 'proceed' a return value from Print instead of an argument. 
		07/26/95	Return a THPrint from GetPrintInfo instead of a bare Handle.
		07/26/95	change fLastPrinterName to gLastPrinterName of static CStr255_AC, it doesn't need to be
							in the freestore and it is shared for the whole application.
							Removed RedoIt method of TPrintStyleChangeCommand and added default
							Parameter to IPrintStyleChangeCommand for isUndoable. The command is
							created and executed in all cases now. Changed PrinterDriverHasChanged
							to HasPrinterDriverChanged.
							StripToPage now takes a CViewPoint to identify the strip.
							Created a TPrinter object and a TPrintInfo object
		 3/13/95	Change Free methods to destructors. 
*/