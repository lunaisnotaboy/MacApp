//----------------------------------------------------------------------------------------
// UView.cpp
// Copyright © 1987-2001 by Apple Computer, Inc. All rights reserved.
//----------------------------------------------------------------------------------------

/*
	Change History:
		06/05/01	Make the ~CDrawingEnvironmentManager a dtor by adding the ~!
		05/17/01	Work around process not brought to front by click on Mac OS X. 
		05/07/01	Comment out pragma messages for Carbon. 
		05/01/01	In GivePasteData, don't call GetScrap with a NULL data handle. 
		04/23/01	Get scrap data through TClipboardMgr. 
		04/13/01	Bring back HandleDrawFailed and NotifyDrawFailed in slightly
					trimmed down form. Revert PrepareForDrawing and CompleteDrawing. 
		04/10/01	No longer pass area to DrawFailed.  Removed NotifyDrawFailed
					and HandleDrawFailed.  Reworked DrawFailed and HandleDraw.  
					Changed purpose of PrepareForDrawing and CompleteDrawing.
					Removed PostCommand.
		01/24/01	[W] DeleteWindowsWindow in TView dtor.
		01/11/01	Some functions have been made const.
		01/02/01	Update copyright.
		12/28/00	Fix typo in constructors for qMSWindows. 
		12/27/00	Not needed to set CTempAllocation in GivePasteData.  [C] Resize
					handle in GivePasteData if it is too small.
		12/26/00	[W] Set fTransparentView and fDrawingContext in TView ctor
					and copy ctor.  Reworked HandleDraw, LocalToSuperView,
					LocalToGlobal, SuperViewToLocal and HandleWindowsEvent.
					Updated CreateWindowsWindow. Customized Update, Validate and
					UpdateCoordinates.  Added SetWindowsWindowStyle, GetWindowsWindowStyle,
					SetDrawingContext, GetDrawingContext to TView.  Added TDrawingContext
					and all of its methods.
		12/26/00	[W] Set fTransparentView and fDrawingContext in TView ctors.
					Customize Invalidate, LocalToSuperView.
		11/14/00	[W] Customization in DoSetCursor, LocalToSuperView, LocalToGlobal
					and SuperViewToLocal.  Additional cases inHandleWindowsEvent.
		11/13/00	Need to get C string from standard string for printing. 
		11/10/00	Cosmetic.  pragma unused.
		11/09/00	[PB] Change initialization order to match declaration. 
					Remove unused local variables in UpdateCoordinates. 
		11/01/00	[PB] Include MacErrors instead of Errors.
		10/20/00	embeddingView should be const in BeInSuperView.  EmbedControls
					takes const
		10/19/00	Comment out unused theException in GetContextualMenu.
		10/16/00	Need to get the clip region from the window only with Carbon.
					Actually, get clip region from the root view instead of the
					window so views like TMenuView can provide a clip.
		10/16/00	[W] Make sure we have a port before setting up the environment
					in Focus.
		09/18/00	Cosmetic.  pragma unuseds. [C] Reworked GivePasteData.
		09/18/00	For Carbon, fix up clip in Focus.
					Conditionalize code needed only for opaque view support.
		09/11/00	GetClipRegion method should only be used on the view's port.
					Same for GetVisRegion.
		09/08/00	Added embedded documentation.
		09/01/00	Stripped dead code.
		08/17/00	Changed fgInstance to sfInstance in CreateWindowsWindow.
		08/01/00	[W]	Include QTML.h.  Eliminated Inherited.  Added static
					initialization.  Many qMSWindows changes.  Added
					MAViewWindowProc, DefaultWindowProcedure, FindSubViewByHWND,
					HandleWindowsEvent, SetWindowsWindow, CreateWindowsWindow
					and DeleteWindowsWindow.
		07/13/00	Include AppearanceUtils_AC.h.
		07/12/00	Disable opaque subviews.  Renamed ClipSubViews to ClipOpaqueSubViews
					and ClipSiblingViews to ClipOpaqueSiblingViews to clarify the
					purpose of the function.
		07/11/00	Take out qDebug around include of AppearanceUtils_AC.h, as
					its needed for AppearanceMgrVersion_AC function.
		07/05/00	Added GetEmbeddingControl and EmbedControls.  Include UControl.h.
		06/28/00	Cursor region can be outside normal space (i.e. overflow short)
					in GetDefaultCursorRegion if contained view is larger than short.
		06/28/00	Use pragma unused in GetDefaultCursorRegion.
		06/14/00	Eliminate unnecessary GetRegionCode calls.  Include CMultiLocal.h.
					Get rid of GetRegionCode function.
		05/23/00	[2279264] Remove false from ProgramReport_AC.
		05/14/00	Output debug messages about errors from GetScrap only if
					intense debugging. It should be okay to call GivePasteData for
					optional scrap types such as style information.
		04/18/00	Include UPrintMgr.h instead of UPrintHandler.h.  Changed
					kPrintBehaviorID to scPrintBehaviorID.
		02/22/00	[W] WriteFocus can now write for Windows.
		12/27/99	Stripped out unused code.
		12/08/99	Set fDocument NULL in FreeFromClipboard since it is deleted in
					document's FreeFromClipboard.  Compiler workaround no longer
					needed in ReadFields.  GetExtentRegion, GetQDExtent, GetVisibleRegion
					and GetDrawableRegion are now const.
		12/02/99	Carbon: TView::GivePasteData get pasting working.
		11/23/99	Carbon: In TView::GivePasteData, allocate memory for paste data.
		11/23/99	Carbon: Check for error in TView::ContainsClipType system calls.
		11/08/99	Change the API for GetContextualMenu so it has access to the click
					event and can fill in all of the parameters for the menu.
		11/04/99	Carbon: Move GivePasteData API back to what it was (remove ScrapRef).
					The clipboard will get the current scrap, instead of the caller.
		11/04/99	Carbon:Move the PutDeskScrap call back to its former API.
		10/05/99	In ::AsPict, now have all code call ::MacSetPort.
		09/29/99	GetCursor now called MacGetCursor, SetPort now called MacSetPort.
		08/09/99	Release ownership of aHandle when assigning to fTemplateUnknownData
					in TView::ReadFrom.  Replaced MA_GET_CLASS_NAME with typeid(...).name
					in AssumeFocused.
		07/23/99	[C]	Changed scrap checking in ContainsClipType and in
					WriteToDeskScrap.
		07/08/99	Change HandleDrawFailed so it doesn't depend on the window
					saving its update region.
		06/04/99	Added MoveSubView.
		04/15/99	Remove pattern customization based on platform and use
					CPattern_AC abstraction.  Include CPattern_AC.h.
		03/29/99	Rename Patterns_AC to CPattern_AC to avoid confusion with the
					include file.
		03/26/99	Use a const pattern pointer in SetHLPenState.
		03/24/99	Update copyright notice.
		03/23/99	Go back to native Toolbox region and rect calls.  Don't directly
					access qd.gray/black/etc.
		03/23/99	Renamed SetPenPatToGray_AC to Patterns_AC::SetPenPatToGray.
		03/22/99	[W] Further 'qd' reduction.  Can't DoShowHelp.
		03/19/99	Rename GetMessage to GetExceptionMessage
					since it conflicts with a Windows define.
					[W] Don't do help region calculations.
		03/18/99	Removed '&' on parms to a variety of Toolbox calls.
		02/03/99	Include CRect_AC.h.
		01/15/99	CAEDesc_AC is now in ACS.
		11/16/98	[2284756] Added some additional debug checks in both InsertSubViews
					and to BeInSUperview.
		11/13/98	[2279274] Force conversion to CViewPoint in LocalToGlobal.
		11/12/98	[2279244] Replaced dynamic_cast with dynamic_cast_AC.
		11/09/98	[2279100] Moved ContainsTarget from TControl to TView.
		11/06/98	CarbonSeed110398 - change GetWindowUpdateRegion to GetWindowRegion(w, kWindowUpdateRgn, rgn)
		11/05/98	Carbon - use SetCursorToArrow_AC(), SetPenPatToGray_AC(), GetQDGlobalsBlack, etc
		10/29/98	[W] No longer necessary to include QTMLMapNames.h.  Use InvertRect_AC.
					OffsetRgn_AC, GetCursor_AC, SetCursor_AC, UnionRgn_AC, FillRgn_AC,
					FrameRgn_AC, CopyRgn_AC, UnionRgn_AC, SetPort_AC, XorRgn_AC, FrameRect_AC
					and include ImagingUtils_AC.h.
		10/26/98	Carbonize: change GetClipRegion from static function to virtual method
		10/08/98	Simplify PostCommand.
					Merge TCommandHandler into TEventHandler.
		10/07/98	Use AsText instead of casting to char*.
*/

#ifndef __UVIEW__
#include "UView.h"
#endif

// MacApp

#ifndef __PLATFORMMEMORY__
#include "PlatformMemory.h"
#endif

#ifndef __UBEHAVIOR__
#include "UBehavior.h"
#endif

#ifndef __UCLIPBOARDMGR__
#include "UClipboardMgr.h"
#endif

#ifndef __UCOMMAND__
#include "UCommand.h"
#endif

#if qWantsContextualMenus
	#ifndef __UContextualMenu__
	#include "UContextualMenu.h"
	#endif
#endif

#ifndef __UCONTROL__
#include "UControl.h"
#endif

#ifndef __UCOREGLOBALS__
#include "UCoreGlobals.h"
#endif

#ifndef __UCOREUTILITIES__
#include "UCoreUtilities.h"
#endif

#ifndef __UDEBUG__
#include "UDebug.h"
#endif

#ifndef __UDISPATCHER__
#include "UDispatcher.h"
#endif

#ifndef __UDOCUMENT__
#include "UDocument.h"
#endif

#if qDrag
	#ifndef __UDRAGTRACKER__
	#include "UDragTracker.h"
	#endif
#endif

#ifndef __UGEOMETRY__
#include "UGeometry.h"
#endif

#ifndef __UMACAPPGLOBALS__
#include "UMacAppGlobals.h"
#endif

#ifndef __UMACAPPUTILITIES__
#include "UMacAppUtilities.h"
#endif

#ifndef __UMEMORY__
#include "UMemory.h"
#endif

#ifndef __UPATCH__
#include "UPatch.h"
#endif

#ifndef __UPOINTEROBJECT__
#include "UPointerObject.h"
#endif

#ifndef __UPrintMgr__
#include "UPrintMgr.h"
#endif

#ifndef __USCROLLER__
#include "UScroller.h"
#endif

#ifndef __USTREAM__
#include "UStream.h"
#endif

#ifndef __UVIEWSERVER__
#include "UViewServer.h"
#endif

#ifndef __UWINDOW__
#include "UWindow.h"
#endif

// ACS

#ifndef __AppearanceUtils_AC__
#include "AppearanceUtils_AC.h"
#endif

#ifndef __CDependencies_AC__
#include "CDependencies_AC.h"
#endif

#ifndef __CList_AC__
#include "CList_AC.h"
#endif

#ifndef __CMultiLocal_AC__
#include "CMultiLocal_AC.h"
#endif

#ifndef __CPattern_AC__
#include "CPattern_AC.h"
#endif

#ifndef __CRect_AC__
#include "CRect_AC.h"
#endif

#ifndef __CRegion_AC__
#include "CRegion_AC.h"
#endif

#ifndef __ImagingStreaming_AC__
#include "ImagingStreaming_AC.h"
#endif

#ifndef __ImagingUtils_AC__
#include "ImagingUtils_AC.h"
#endif

#ifndef __WindowUtils_AC__
#include "WindowUtils_AC.h"
#endif

// Toolbox

#ifndef __AEREGISTRY__
#include <AERegistry.h>
#endif

#ifndef __DIALOGS__
#include <Dialogs.h>
#endif

#if !qCarbon
	#ifndef __EDITIONS__
	#include <Editions.h>
	#endif
#endif

#if qGXViews || qGXPrinting
#	ifndef __GXGRAPHICS__
#	include <GXGraphics.h>
#	endif
#endif

#ifndef __LOWMEM__
#include <LowMem.h>
#endif

#ifndef __MACERRORS__
#include <MacErrors.h>
#endif

#ifndef __RESOURCES__
#include <Resources.h>
#endif

#ifndef __SCRAP__
#include <Scrap.h>
#endif

#ifndef __SCRIPT__
#include <Script.h>
#endif

#ifndef __TOOLUTILS__
#include <ToolUtils.h>
#endif

#if qMSWindows
#include <QTML.h>
#endif

// ANSI

static const short kRgnHandleTooBig = 16 * 1024;// regions > 16K don't work too well

#if qMSWindows
const char* kViewClassName = "TView";
const char* kWindowClassName = "TWindow";
#endif

//========================================================================================
// static data members
//========================================================================================

TView*		TView::gFocusedView;
TView*		TView::fgSetCursorView;
bool		TView::gDrawingPictScrap;
TView*		TView::gDrawingPictScrapView;
bool		TView::gPrinting;

#if qGXViews || qGXPrinting
gxGraphicsClient TView::gGXGraphicsClient;
#endif

#if qMSWindows
TView* TView::gNewViewObject = NULL;
#endif

//========================================================================================
// CLASS CSubViewIterator
//========================================================================================

//----------------------------------------------------------------------------------------
// CSubViewIterator::CSubViewIterator:
//----------------------------------------------------------------------------------------

CSubViewIterator::CSubViewIterator(const TView* theSuperView, bool itsForward)
	:	fCurrent(NULL),
		fFirstView(theSuperView ? theSuperView->GetSubView() : NULL),
		fIterateForward(itsForward)
// CSubViewIterator is a constructor that initializes an instance for iteration
// over subviews.
//
// theSuperView:	Specifies the TView object that has the subview list over
// 					whose elements you want to iterate.
// itsForward:		Specifies the direction in which iteration is to proceed; true
// 					indicates forward iteration.
//
// Call?		As needed. You typically define an instance with
//				these parameters when you want to specify the boundary for iteration
// 				over objects in the list. If you subclass CSubViewIterator, you must
// 				invoke this constructor from the subclass constructor.
{
	First();
}

//----------------------------------------------------------------------------------------
// CSubViewIterator::First:
//----------------------------------------------------------------------------------------

TView* CSubViewIterator::First()
{
	return fCurrent = fIterateForward ? const_cast<TView*>(fFirstView) : LastView();
}

//----------------------------------------------------------------------------------------
// CSubViewIterator::Next:
//----------------------------------------------------------------------------------------

TView* CSubViewIterator::Next()
{
	return fCurrent ? fCurrent = (fIterateForward ? NextView(fCurrent) : PreviousView(fCurrent)) : NULL;
}

//----------------------------------------------------------------------------------------
// CSubViewIterator::PreviousView:
//----------------------------------------------------------------------------------------

TView* CSubViewIterator::PreviousView(const TView* aView) const
{
	const TView * currentView = fFirstView;
	while (currentView && (NextView(currentView) != aView))
		currentView = NextView(currentView);

	return const_cast<TView*>(currentView);
}

//----------------------------------------------------------------------------------------
// CSubViewIterator::LastView:
//----------------------------------------------------------------------------------------

TView* CSubViewIterator::LastView() const
{
	const TView * currentView = fFirstView;
	while (currentView && NextView(currentView))
		currentView = NextView(currentView);

	return const_cast<TView*>(currentView);
}


//========================================================================================
// CDrawingEnvironmentManager
//========================================================================================

class CDrawingEnvironmentManager
// CDrawingEnvironmentManager manages the view's drawing environment and insures
// that the drawing environment, if any, gets a chance to clean things up even
// if an exception is thrown during the drawing process.
{
public:
	CDrawingEnvironmentManager(TView* theView)
		:	fView(theView)
	{
		fView->PrepareForDrawing();
	}
	
	~CDrawingEnvironmentManager()
	{
		fView->CompleteDrawing();
	}

private:
	TView*		fView;			// The view that we are managing.
};


//========================================================================================
// CLASS TView
//========================================================================================

MA_DEFINE_CLASS(TView);

//----------------------------------------------------------------------------------------
// TView constructor
//----------------------------------------------------------------------------------------

TView::TView(const CViewPoint&	itsLocation,
			 const CViewPoint&	itsSize,
			 SizeDeterminer		itsHSizeDet,
			 SizeDeterminer		itsVSizeDet)
	:	TEventHandler(NULL),
		fLocation(itsLocation),
		fSize (itsSize),
		fSuperView(NULL),
		fSubView(NULL),
		fNextView(NULL),
		fDocument(NULL),
		fUserArea(0),
		fTemplateVersion(kMARelease13ViewsTemplateVersion),
		fHelpIndex(1),
		fHelpID(kNoResource),
		fCursorID(kNoResource),
		fActiveHL(hlOn),
		fInactiveHL(hlDim),
		fHandlesCursor(true),
		fLetsSubViewsHandleCursor(true),
		fHandlesHelp(true),
		fHandlesFirstClicks(true),
		fLetsSubViewsHandleHelp(true),
		fShown(true),
		fWantsToBeTarget(false),
		fCoordinatesAreInvalid(true),
		fIsOpaque(false),
		fIsActive(true),
#if qDrag
		fDraggable(false),
		fDroppable(false),
		fDragMoveDeterminer(kNeverMove),
		fDragMoveFamily(kNoIdentifier),
#endif
#if qWriteTemplateViews
		fTemplateUnknownData(NULL),
#endif // qWriteTemplateViews
#if qMSWindows
		fNeedsOwnWindowsWindow(true),
		fWindowsWindow(NULL),
		fGrafPort(NULL),
		fWindowStyle(WS_CHILD),
		fTransparentView(false),
		fDrawingContext(NULL),
#endif
		fFrameInvalidateDeterminer(frameInvalidateDifference)
{
	fSizeDeterminer[hSel] = itsHSizeDet;
	fSizeDeterminer[vSel] = itsVSizeDet;
}

//----------------------------------------------------------------------------------------
// TView::HandlePostCreate:
//----------------------------------------------------------------------------------------

void TView::HandlePostCreate(TDocument* itsDocument)
{
	if (!fDocument)
		BeInDocument(itsDocument);
#if qDebugMsg
	else if (fDocument)
		::ThrowIfNonObject_AC(itsDocument);
#endif

	if (HasSubViews())
		for (CSubViewIterator iter(this); iter; ++iter)
			iter->HandlePostCreate(itsDocument);

	if (GetAdorners())
		for (CAdornerIterator adornIter(this); adornIter.Current(); ++adornIter)
			adornIter->AddedToView(this);

	TBehavior * aBehavior = GetFirstEnabledBehavior();
	if (aBehavior)
		aBehavior->DoPostCreate(itsDocument);

	DoPostCreate(itsDocument);
}

//----------------------------------------------------------------------------------------
// TView::DoPostCreate:
//----------------------------------------------------------------------------------------

void TView::DoPostCreate(TDocument* itsDocument)
{
	#pragma unused (itsDocument)

#if qMSWindows
	SetWindowsWindowStyle(WS_CHILD);
#endif
}

//----------------------------------------------------------------------------------------
// TView copy constructor
//----------------------------------------------------------------------------------------

TView::TView(const TView& inView)
	:	TEventHandler(inView),
		fLocation(inView.fLocation),
		fSize(inView.fSize),
		fSuperView(NULL),
		fSubView(NULL),
		fNextView(NULL),
		fDocument(NULL),
		fUserArea(inView.fUserArea),
		fTemplateVersion(inView.fTemplateVersion),
		fHelpIndex(inView.fHelpIndex),
		fHelpID(inView.fHelpID),
		fCursorID(inView.fCursorID),
		fActiveHL(inView.fActiveHL),
		fInactiveHL(inView.fInactiveHL),
		fHandlesCursor(inView.fHandlesCursor),
		fLetsSubViewsHandleCursor(inView.fLetsSubViewsHandleCursor),
		fHandlesHelp(inView.fHandlesHelp),
		fHandlesFirstClicks(inView.fHandlesFirstClicks),
		fLetsSubViewsHandleHelp(inView.fLetsSubViewsHandleHelp),
		fShown(inView.fShown),
		fWantsToBeTarget(inView.fWantsToBeTarget),
		fCoordinatesAreInvalid(inView.fCoordinatesAreInvalid),
		fIsOpaque(inView.fIsOpaque),
		fIsActive(inView.fIsActive),
#if qDrag
		fDraggable(inView.fDraggable),
		fDroppable(inView.fDroppable),
		fDragMoveDeterminer(inView.fDragMoveDeterminer),
		fDragMoveFamily(inView.fDragMoveFamily),
#endif
#if qMSWindows
		fNeedsOwnWindowsWindow(inView.fNeedsOwnWindowsWindow),
		fWindowsWindow(NULL),
		fGrafPort(NULL),
		fWindowStyle(inView.fWindowStyle),
		fTransparentView(inView.fTransparentView),
		fDrawingContext(NULL),
#endif
		fFrameInvalidateDeterminer(inView.fFrameInvalidateDeterminer)
{
	fSizeDeterminer[hSel] = inView.fSizeDeterminer[hSel];
	fSizeDeterminer[vSel] = inView.fSizeDeterminer[vSel];

	if (inView.HasSubViews())
	{
		for (CSubViewIterator iter(&inView); iter; ++iter)
			AddSubView(static_cast<TView*>(iter->Clone()));
	}

	if (inView.fDrawingEnvironment)
		fDrawingEnvironment = static_cast<TDrawingEnvironment*>(inView.fDrawingEnvironment->Clone());

	{
		for (CAdornerIterator iter(&inView); iter.Current(); ++iter)
			AddAdorner(iter->GetFreeOnDeletion() ? static_cast<TAdorner*>(iter->Clone()) : iter, inView.fAdorners->PriorityAt(iter.CurrentIndex()), false);
	}
}

//----------------------------------------------------------------------------------------
// TView::Free:
//----------------------------------------------------------------------------------------

TView::~TView()
{
	while (fSubView)
		delete fSubView;

	InvalidateFocus();
	if (gDispatcher)
		gDispatcher->InvalidateMouseRegions();		// Must re-calc cursor and help rgn.

	if (fgSetCursorView == this)
		fgSetCursorView = NULL;

	if (gDispatcher && this == GetTarget())		// Fixup the target chain
		SetTarget(gDispatcher);

#if qMSWindows
	if (GetWindowsWindow() != NULL)
	{
		::ShowWindow(GetWindowsWindow(), SW_HIDE);
		DeleteWindowsWindow();
	}
#endif

	if (fSuperView)
	{
		fSuperView->RemoveSubView(this);
		fSuperView = NULL;						// redundant, but safe
	}

	DeleteAllAdorners();

	RemoveFromDocument();
}

//----------------------------------------------------------------------------------------
// TView::DeleteAllAdorners:
//----------------------------------------------------------------------------------------

void TView::DeleteAllAdorners()
{
	if (fAdorners)
		for (CAdornerIterator iter(this); iter.Current(); ++iter)
		{
			iter->RemovedFromView(this);
			// anAdorner might get freed here
			if (iter->GetFreeOnDeletion())
				delete iter.Current();
		}
}

//----------------------------------------------------------------------------------------
// TView::HighlightAdorners:
//----------------------------------------------------------------------------------------

void TView::HighlightAdorners(const CViewRect& area,
							  HLState fromHL,
							  HLState toHL)
{
	PenState savePenState;
	HLState localFromHL = fromHL;
	HLState localToHL = toHL;

	// The direction of iteration is controlled by the following state transition diagram:
	//
	// toHL
	// 				  || 	OFF  	 ||		   DIM		  || 	  ON
	//  --------------||-------------||-------------------||-------------------
	//  		OFF	  || 	(NA)	 ||		 Forward 	  || 	Forward
	//  --------------||-------------||-------------------||-------------------
	//  fromHL  DIM	  ||   Backward	 ||		  (NA)		  || 	Forward
	//  --------------||-------------||-------------------||-------------------
	//  		ON	  ||   Backward	 ||		Backward	  || 	 (NA)
	//  --------------||-------------||-------------------||-------------------

	PenNormal();
	GetPenState(&savePenState);

	if ((fromHL == hlOn && (toHL == hlDim || toHL == hlOff)) || (fromHL == hlDim && toHL == hlOff))
	{
		for (CAdornerIterator iter(this, kIterateBackward_AC); iter.Current(); ++iter)
			if (iter->DoesAdorn(this))
			{
				SetPenState(&savePenState);
				iter->DoHighlightSelection(this, area, localFromHL, localToHL);
			}
	}
	else if (((fromHL == hlOff || fromHL == hlDim) && toHL == hlOn) || (fromHL == hlOff && toHL == hlDim))
	{
		for (CAdornerIterator iter(this); iter.Current(); ++iter)
			if (iter->DoesAdorn(this))
			{
				SetPenState(&savePenState);
				iter->DoHighlightSelection(this, area, localFromHL, localToHL);
			}
	}
}

//----------------------------------------------------------------------------------------
// TView::SetActiveState:
//----------------------------------------------------------------------------------------

void  TView::SetActiveState(bool beActive, bool redraw)
{
	#pragma unused (redraw)

	if (fIsActive != beActive)
	{
		fIsActive = beActive;

		// Let views decide whether they should redraw.
		//if (redraw)
		//	ForceRedraw();

		HandleActivate();
	}
}

//----------------------------------------------------------------------------------------
// TView::Activate:
//----------------------------------------------------------------------------------------

void TView::Activate(bool entering)
{
	#pragma unused (entering)
	// Subclasses may implement or defeat behavior by overriding this method
	// without affecting subview iteration.
}

//----------------------------------------------------------------------------------------
// TView::HandleActivate:
//----------------------------------------------------------------------------------------

void TView::HandleActivate()
{
	bool entering = IsActive();

	Activate(entering);

	if (fAdorners && IsDrawable())
	{
		CViewRect visRect(GetDrawableRect());
		if (entering)
			HighlightAdorners(visRect, fInactiveHL, fActiveHL);
		else
			HighlightAdorners(visRect, fActiveHL, fInactiveHL);
	}

	if (HasSubViews())
		for (CSubViewIterator iter(this); iter; ++iter)
			iter->HandleActivate();
}

//----------------------------------------------------------------------------------------
// TView::AddAdorner:
//----------------------------------------------------------------------------------------

void TView::AddAdorner(TAdorner* anAdorner, AdornPriority itsPriority, bool invalidate)
// AddAdorner adds the specified adorner to the view’s list of adorners, invokes
// the adorner’s AddedToView method, and, if requested, invalidates the adorner,
// causing it to be drawn.
//
// anAdorner:	Specifies the adorner.
// itsPriority:	Specifies the priority within a range of priorities. See kAdornFirst
//				for the range and a list of constants representing significant values
//				within that range.
//
// Call?		As needed.
// Override?	Seldom.
{
	{
		CTempObjectAllocation tempObjectAllocation(true);
		fAdorners = MakeAdornerList();
		fAdorners->AddAdorner(anAdorner, itsPriority);
	}

	anAdorner->AddedToView(this);

	if (invalidate)
		anAdorner->InvalidateAdorner(this);
}

//----------------------------------------------------------------------------------------
// TView::DeleteAdorner:
//----------------------------------------------------------------------------------------

void TView::DeleteAdorner(TAdorner* anAdorner, bool invalidate)
// DeleteAdorner removes the specified adorner from this view and invalidates
// the adorner if requested.
// For example, MacApp calls DeleteAdorner to remove a border around a view.
//
// anAdorner:	Specifies the adorner to be deleted.
// invalidate:	Specifies whether MacApp must redraw the area occupied by the
// 				adorner.
//
// Call?		As needed. You can also call DeleteAdornerByID.
// Override?	Seldom.
{
	if (fAdorners)
	{
		for (CAdornerIterator iter(this); iter.Current(); ++iter)
			if (iter == anAdorner)
			{
				if (invalidate)
					iter->InvalidateAdorner(this);
				iter->RemovedFromView(this);
				// anAdorner might get freed here
				if (iter->GetFreeOnDeletion())
					delete iter.Current();
				fAdorners->DeleteElementsAt(iter.CurrentIndex(), 1);
			}

		// dispose of fAdorners if it only contains the default gDrawAdorner
		if ((fAdorners->GetSize() == 1) && (AdornerAt(1) == &TAdorner::fgDrawAdorner))
			fAdorners.reset();
	}
}

//----------------------------------------------------------------------------------------
// TView::DeleteAdornerByID:
//----------------------------------------------------------------------------------------

void TView::DeleteAdornerByID(IDType itsID, bool invalidate)
// DeleteAdornerByID removes the specified adorner from this view and invalidates
// the adorner if requested.
//
// itsID:		Specifies the identifier of the adorner to be deleted.
// invalidate:	Specifies whether MacApp must redraw the area occupied by the adorner.
//
// Call?		As needed. You can also call DeleteAdorner.
// Override?	Seldom.
{
	if (fAdorners)
	{
		for (CAdornerIterator iter(this); iter.Current(); ++iter)
			if (iter->GetIdentifier() == itsID)
			{
				if (invalidate)
					iter->InvalidateAdorner(this);
				iter->RemovedFromView(this);
				// anAdorner might get freed here
				if (iter->GetFreeOnDeletion())
					delete iter.Current();
				fAdorners->DeleteElementsAt(iter.CurrentIndex(), 1);
			}

		// dispose of fAdorners if it only contains the default TAdorner::fgDrawAdorner
		if ((fAdorners->GetSize() == 1) && (AdornerAt(1) == &TAdorner::fgDrawAdorner))
			fAdorners.reset();
	}
}

//----------------------------------------------------------------------------------------
// TView::AdornerAt:
//----------------------------------------------------------------------------------------

TAdorner* TView::AdornerAt(ArrayIndex_AC i) const
// AdornerAt returns the adorner specified by an index into this view’s list
// of adorners, or NULL.
//
// i:	Specifies the position in the list.
//
// Call?		Seldom.
// Override?	Seldom.
{
	return fAdorners ? fAdorners->AdornerAt(i) : NULL;
}

//----------------------------------------------------------------------------------------
// TView::AdornerWithID:
//----------------------------------------------------------------------------------------

TAdorner* TView::AdornerWithID(IDType itsID) const
// AdornerWithID returns the first adorner with the specified ID from this
// view’s list of adorners.
//
// itsID:	Specifies the adorner, such as kCompatibilityAdorner.
//
// Call?		As needed.
// Override?	Seldom.
{
	TAdorner* returnVal = NULL;

	if (fAdorners)
		for (CAdornerIterator iter(this); iter.Current(); ++iter)
			if (iter->GetIdentifier() == itsID)
			{
				returnVal = iter;
				break;
			}

	return returnVal;
}

//----------------------------------------------------------------------------------------
// TView::Dim:
//----------------------------------------------------------------------------------------

void TView::Dim()
{
#if qDebug
	AssumeFocused();
#endif

	CPattern_AC::SetPenPatToGray();
	::PenMode(patBic);
	::PaintRect(GetQDExtent());
}

//----------------------------------------------------------------------------------------
// TView::GetAdornExtent:
//----------------------------------------------------------------------------------------

CViewRect TView::GetAdornExtent()
{
	return GetExtent();
}

//----------------------------------------------------------------------------------------
// TView::GetEventNumber:
//----------------------------------------------------------------------------------------

EventNumber TView::GetEventNumber()
{
	return cNoEvent;
}

//----------------------------------------------------------------------------------------
// TView::Hilite:
//----------------------------------------------------------------------------------------

void TView::Hilite()
{
#if qDebug
	AssumeFocused();
#endif

	::MacInvertRect(GetQDExtent());
}

//----------------------------------------------------------------------------------------
// TView::MakeAdornerList:
//----------------------------------------------------------------------------------------

TAdornerList* TView::MakeAdornerList()
{
	TAdornerList* returnVal = NULL;

	if (fAdorners)
		returnVal = fAdorners;
	else
	{
		CAutoPtr_AC<TAdornerList> anAdornerList(TH_new TAdornerList);

		anAdornerList->AddAdorner(&TAdorner::fgDrawAdorner, kDrawView);// default "Draw" adorner

		returnVal = anAdornerList.release();
	}

	return returnVal;
}

//----------------------------------------------------------------------------------------
// TView::FindParentView
//----------------------------------------------------------------------------------------

TView* TView::FindParentView(IDType itsID)
{
	TView * parentView = this;

	while (parentView && parentView->fIdentifier != itsID)
		parentView = parentView->fSuperView;

	return parentView;
}

//----------------------------------------------------------------------------------------
// TView::FindPeerView
//----------------------------------------------------------------------------------------

TView* TView::FindPeerView(IDType itsID)
{
	TView * returnVal = NULL;

	for (CSubViewIterator iter(fSuperView); iter; ++iter)
		if (iter->fIdentifier == itsID)
		{
			returnVal = iter;
			break;
		}

	return returnVal;
}

//----------------------------------------------------------------------------------------
// TView::InsertSubView:
//----------------------------------------------------------------------------------------

void TView::InsertSubView(TView* theSubView, bool last)
{
#if qDebug
	::ThrowIfNonObject_AC(theSubView);

	// theSubView should not already be in a superview.  If it is then something is wrong.
	if (theSubView->fSuperView)
	{
		if (theSubView->fSuperView != this)
			ProgramBreak_AC("TView::InsertSubView: Attempting to make view %#x sub to %#x when it is already subbed to %#x.",
							theSubView, this, theSubView->fSuperView);
		else if (gIntenseDebugging)
			ProgramBreak_AC("TView::InsertSubView: View %#x is already subbed to %#x.",
							theSubView, this);
	}
#endif

	if (last && fSubView)
	{
		// place at the tail of the list
		register TView* lastView = fSubView;
		register TView* nextView = lastView->fNextView;
		while (nextView)
		{
			lastView = nextView;
			nextView = lastView->fNextView;
		}
		lastView->fNextView = theSubView;
		theSubView->fNextView = NULL;
	}
	else										// first
	{
		theSubView->fNextView = fSubView;
		fSubView = theSubView;
	}
}

//----------------------------------------------------------------------------------------
// TView::InsertSubView:
//----------------------------------------------------------------------------------------

void TView::InsertSubView(TView* theSubView, TView* beforeView)
{
#if qDebug
	::ThrowIfNonObject_AC(theSubView);

	// theSubView should not already be in a superview.  If it is then something is wrong.
	if (theSubView->fSuperView)
	{
		if (theSubView->fSuperView != this)
			ProgramBreak_AC("TView::InsertSubView: Attempting to make view %#x sub to %#x when it is already subbed to %#x.",
							theSubView, this, theSubView->fSuperView);
		else if (gIntenseDebugging)
			ProgramBreak_AC("TView::InsertSubView: View %#x is already subbed to %#x.",
							theSubView, this);
	}
#endif

	if (!fSubView)
		beforeView = NULL; // if there are no views, there is nothing to insert before

	if (fSubView == beforeView)
	{
		fSubView = theSubView;
	}
	else
	{
		register TView* lastView = fSubView;
		register TView* nextView = lastView->fNextView;
		while (nextView && nextView != beforeView)
		{
			lastView = nextView;
			nextView = lastView->fNextView;
		}
		lastView->fNextView = theSubView;
	}

	theSubView->fNextView = beforeView; // reconnect next to linked list
}

//----------------------------------------------------------------------------------------
// TView::MoveSubView:
//----------------------------------------------------------------------------------------

void TView::MoveSubView(TView* theSubView, TView* beforeView)
{
	// There's really no need to move the view if it's nextView is beforeView.
	if (theSubView->fNextView != beforeView)
	{
#if qDebug
		::ThrowIfNonObject_AC(theSubView);

		// theSubView must already be our subview.  If it is not then something is wrong.
		if (theSubView->fSuperView != this)
			ProgramBreak_AC("TView::MoveSubView: View %#x must already be a subView of %#x to move it.  It is a subView to %#x.",
							theSubView, this, theSubView->fSuperView);
		if (!fSubView)
			ProgramBreak_AC("TView::MoveSubView: SubView list is empty but view %#x must be a subView of %#x to move it.",
							theSubView, this);
#endif

		// Remove theSubView from the list.
		if (fSubView == theSubView)
			fSubView = theSubView->fNextView;
		else
		{
			TView* lastView = fSubView;
			TView* nextView = lastView->fNextView;
			while (nextView && nextView != theSubView)
			{
				lastView = nextView;
				nextView = lastView->fNextView;
			}

#if qDebug
			if (!nextView)
				ProgramBreak_AC("TView::MoveSubView: theSubView %#x is not a subView of %#x.",
								theSubView, this);
#endif

			lastView->fNextView = theSubView->fNextView;
		}
		theSubView->fNextView = NULL;		// Final disconnect.

		// Hook theSubView back into the view list.
		if (fSubView == beforeView)
			fSubView = theSubView;
		else
		{
			TView* lastView = fSubView;
			TView* nextView = lastView->fNextView;
			while (nextView && nextView != beforeView)
			{
				lastView = nextView;
				nextView = lastView->fNextView;
			}

#if qDebug
			if (!nextView && beforeView)
				ProgramBreak_AC("TView::MoveSubView: beforeView %#x is not a subView of %#x.",
								beforeView, this);
#endif

			lastView->fNextView = theSubView;
		}

		theSubView->fNextView = beforeView; 	// Reconnect next to linked list
	}
#if qDebug
	else
		ProgramBreak_AC("TView::MoveSubView: theSubView %#x is already just before beforeView %#x.",
						theSubView, beforeView);
#endif
}

//----------------------------------------------------------------------------------------
// TView::DeleteSubView:
//----------------------------------------------------------------------------------------

void TView::DeleteSubView(TView* theSubView)
{
#if qDebug
	::ThrowIfNonObject_AC(theSubView);
#endif

	if (fSubView)
	{
		if (fSubView == theSubView)
			fSubView = theSubView->fNextView;
		else
		{
			register TView* lastView = fSubView;
			register TView* nextView = fSubView->fNextView;
			while (nextView && (nextView != theSubView))
			{
				lastView = nextView;
				nextView = lastView->fNextView;
			}

			if (nextView)
				lastView->fNextView = theSubView->fNextView;
			else
			{
#if qDebug
				::ProgramBreak_AC("Delete subview not in list!");
#endif

			}
		}

		theSubView->fNextView = NULL;
	}

}

//----------------------------------------------------------------------------------------
// TView::AddedASubView:
//----------------------------------------------------------------------------------------

void TView::AddedASubView(TView* newSubView)
// AddedASubView is intended to specify the actions to take after adding a
// subview to this view. TView::AddedASubView invokes the AddedASubView method for this view’s superview.
//
// newSubView:	Is the view that was added.
//
// Call?		Seldom.
// Override?	As needed.
{
	if (fSuperView)
		fSuperView->AddedASubView(newSubView);
}

//----------------------------------------------------------------------------------------
// TView::AddSubView:
//----------------------------------------------------------------------------------------

void TView::AddSubView(TView* theSubView)
// AddSubView adds the specified view to this view’s list of subviews, makes
// this view the superview, and invokes this view’s AddedASubView method.
//
// theSubView:	Specifies the new view.
//
// Call?		Seldom. MacApp calls this method for you when it
//				reads views from a resource or when you initialize a view procedurally.
// Override?	Seldom.
{
	if (theSubView)
	{
		InsertSubView(theSubView);

	//	theSubView->BeInDocument(fDocument);	// •••  back out fix for [1338821]
		theSubView->BeInSuperView(this);
		AddedASubView(theSubView);
	}
}

//----------------------------------------------------------------------------------------
// TView::AdjustFrame:
//----------------------------------------------------------------------------------------

void TView::AdjustFrame()
// AdjustFrame adjusts the size of this view and its subviews and causes repagination
// for each of them if the size of this view has changed.
// For example, MacApp calls AdjustFrame when the number of rows or columns
// is set for a TGridView object.
//
// Call?		As needed.
// Override?	Seldom.
{
	CViewRect oldFrame(GetFrame());
	CViewRect newFrame(oldFrame);
	ComputeFrame(newFrame);

	if (newFrame != oldFrame)
	{
		SetFrame(newFrame, kInvalidate);
#if !qCarbon
		DoPagination();
#endif
	}
	else if (HasSubViews())
		for (CSubViewIterator iter(this); iter; ++iter)
			iter->AdjustFrame();
}

//----------------------------------------------------------------------------------------
// TView::AssumeFocused:
//----------------------------------------------------------------------------------------
#if qDebug

void TView::AssumeFocused() const
// AssumeFocused is intended to display debugging information and cause a
// program break if this view is not focused. TView::AssumeFocused requires gAssumeFocused to be true to perform these actions. This method is provided for debugging your application and is typically compiled conditionally on qDebug.
//
// Call?		As needed.
// Override?	Seldom.
{
	if (gAssumeFocused)
		if (!IsFocused())
		{
#if qDebugMsg
			ProgramReport_AC(", ClassName=%s\n", typeid(*this).name());
			if (gFocusedView)
			{
				ProgramReport_AC("View actually focused is:\n");
				ProgramReport_AC(", ClassName=%s\n", typeid(*gFocusedView).name());
			}
#endif
			::ProgramReport_AC("Failed AssumeFocused");
		}
}
#endif

//----------------------------------------------------------------------------------------
// TView::AttachPrintHandler:
//----------------------------------------------------------------------------------------

void TView::AttachPrintHandler(TPrintHandler* itsPrintHandler)
// AttachPrintHandler is intended to implement printing behavior for this
// view. TView::AttachPrintHandler adds gPrintAdorner to this view’s list
// of adorners, adds the specified print handler to the view’s list of behaviors,
// and calls DoCheckPrinter to update the current printer selection and do other
// housekeeping tasks needed to support printing.
//
// itsPrintHandler:	Specifies this view’s print handler.
//
// Call?		Seldom. Create a print handler and call its initialization
//				method(for example, IStdPrintHandler) from your document’s
//				override of DoMakeViews.
// Override?	As needed.
{
	AddAdorner(&TAdorner::fgPrintAdorner, kAdornLast, false);// adorner calls DoDrawPrintFeedback
	AddBehavior(itsPrintHandler);
	DoCheckPrinter();
}

//----------------------------------------------------------------------------------------
// TView::DetachPrintHandler:
//----------------------------------------------------------------------------------------

void TView::DetachPrintHandler(TPrintHandler* itsPrintHandler)
{
	DeleteAdorner(&TAdorner::fgPrintAdorner, false);
	RemoveBehavior(itsPrintHandler);
	DoCheckPrinter();
}

//----------------------------------------------------------------------------------------
// TView::GetPrintHandler:
//----------------------------------------------------------------------------------------

TPrintHandler* TView::GetPrintHandler()
{
	// This can return NULL.

	return dynamic_cast_AC(TPrintHandler*,
						   GetBehaviorWithIdentifier(TPrintHandler::scPrintBehaviorID));
}

//----------------------------------------------------------------------------------------
// TView::BeInPort:
//----------------------------------------------------------------------------------------

void TView::BeInPort(GrafPtr itsPort)
// BeInPort is intended to specify that this view and its subviews are in
// the specified GrafPort. TView::BeInPort checks the printer associated
// with each view and updates each view’s coordinates.
//
// itsPort:		Specifies the port.
//
// Call?		As inherited only.
// Override?	As needed. Your overrride of BeInPort must call
//				its inherited BeInPort as its first action.
{
	if (itsPort && GetPrintHandler())
		DoCheckPrinter();

	if (HasSubViews())
		for (CSubViewIterator iter(this); iter; ++iter)
			iter->BeInPort(itsPort);

	InvalidateCoordinates();
}

//----------------------------------------------------------------------------------------
// TView::BeInDocument:
//----------------------------------------------------------------------------------------

void TView::BeInDocument(TDocument* itsDocument)
// BeInDocument is intended to specify that this view is part of the specified
// document. TView::BeInDocument associates the specified document with this
// view and adds this view to the document’s list of views.
//
// itsDocument:	Specifies the document to associate with this view.
//
// Call?		Seldom. MacApp calls this method for you when it
//				reads views from a resource or when you initialize
// 				a view procedurally.
// Override?	Seldom. MacApp provides an override for windows.
{
	if (itsDocument != fDocument)
	{
		if (fDocument)
		{
			fDocument->DeleteView(this);
			fDocument = NULL;
		}
		if (itsDocument)
		{
			itsDocument->AddView(this);
			fDocument = itsDocument;
		}
	}
}

//----------------------------------------------------------------------------------------
// TView::RemoveFromDocument:
//----------------------------------------------------------------------------------------

void TView::RemoveFromDocument()
{
	if (fDocument)
	{
		fDocument->DeleteView(this);
		fDocument = NULL;
	}
}

//----------------------------------------------------------------------------------------
// TView::BeInScroller:
//----------------------------------------------------------------------------------------

void TView::BeInScroller(TScroller* itsScroller)
// BeInScroller is intended to perform housekeeping that is needed when this
// view’s scroller becomes the current scroller. TView::BeInScroller sets the
// scroll limits of this view’s scroller to the view’s size.
//
// itsScroller:	Specifies this view’s scroller.
//
// Call?		Seldom. MacApp calls this method for you when it
//				reads views from a resource or when you initialize a view procedurally.
// Override?	Seldom.
{
	// convert the size to superview location.

	if (itsScroller)
		itsScroller->SetScrollLimits(fSize + fLocation, kDontRedraw);
}

//----------------------------------------------------------------------------------------
// TView::BeInSuperView:
//----------------------------------------------------------------------------------------

void TView::BeInSuperView(TView* itsSuperview)
// BeInSuperView attaches this view to or detaches it from the event handler
// chain just before its specified superview. If the superview is not NULL,
// this view is attached; otherwise it is detached.
//
// itsSuperView:	Specifies this view’s superview.
//
// Call?		Seldom. MacApp calls this method for you when it
//				reads views from a resource, when you initialize
// 				a view procedurally, or when you remove a subview.
// Override?	Seldom.
{
	if (fSuperView != itsSuperview)
	{
#if qDebug
		// Either fSuperView or itsSuperview should be NULL.  If one isn't then
		// this view might be hooked up to two superviews -- not a good thing.
		if (fSuperView && itsSuperview)
			ProgramBreak_AC("TView::BeInSuperView: Attempting to make view %#x sub to %#x when it is already subbed to %#x.",
							this, itsSuperview, fSuperView);
#endif

		InvalidateFocus();						// the subview may have been focused

		fSuperView = itsSuperview;
		fNextHandler = itsSuperview;

		if (itsSuperview)
		{
			BeInPort(GetGrafPort());

			// Now see if we should do a little control embedding.
			if (fSuperView && AppearanceMgrVersion_AC() >= 0x101)
			{
				const TCtlMgr*	embeddingView = fSuperView->GetEmbeddingControl();
				if (embeddingView)
				{
					// We've found an embedding control so scan all subviews and
					// let them have a chance to embed themselves.  Start with
					// ourself since we might be such a control.
					EmbedControls(embeddingView);
				}
			}
		}
		else
		{
			// Leave the views in the same port. Putting controls in gWorkPort leads to
			// crashes. Putting them in a NULL port means we'll have to delete the controls,
			// with a possible loss of state. The most likely case is the view will be
			// deleted, or it will be plugged in to another view in the same port.
			// If the view is plugged into a view in another port, we'll deal with the
			// port change at that time.
		}
	}
}

//----------------------------------------------------------------------------------------
// TView::FindTarget:
//----------------------------------------------------------------------------------------

TView* TView::FindTarget()
{
	TView * foundView = NULL;

	if (WantsToBeTarget())
		foundView = this;
	else if (HasSubViews())
		for (CSubViewIterator iter(this); iter; ++iter)
		{
			foundView = iter->FindTarget();
			if (foundView)
				break;
		}

	return foundView;
}

//----------------------------------------------------------------------------------------
// TView::ContainsTarget:
//----------------------------------------------------------------------------------------
bool TView::ContainsTarget(TEventHandler* target)
{
	TEventHandler 	*localTarget = target;
	bool			containsTarget = false;

	while (localTarget && !containsTarget)
	{
		if (localTarget == this)
			containsTarget = true;
		localTarget = localTarget->GetNextHandler();
	}
	return containsTarget;
}

//----------------------------------------------------------------------------------------
// TView::SetTargetSelection:
//----------------------------------------------------------------------------------------

void TView::SetTargetSelection(bool redraw)
{
	ScrollSelectionIntoView(redraw);
}

//----------------------------------------------------------------------------------------
// TView::WantsToBeTarget:
//----------------------------------------------------------------------------------------

bool TView::WantsToBeTarget()

{
	return fWantsToBeTarget;
}

//----------------------------------------------------------------------------------------
// TView::ContainsSubView:
//----------------------------------------------------------------------------------------

bool TView::ContainsSubView(TView* aSubView) const
// ContainsSubView returns the value true if the specified view is a subview
// of this view.
//
// aView:	Specifies the view to be tested.
//
// Call?		As needed.
// Override?	Seldom.
{
	bool foundView = false;

	if (HasSubViews())
	{
		for (TView * viewToTest = aSubView; viewToTest; viewToTest = viewToTest->fSuperView)
		{
			if (viewToTest->fSuperView == this)
			{
				foundView = true;
				break;
			}
		}
	}

	return foundView;
}

//----------------------------------------------------------------------------------------
// TView::CalcMinFrame:
//----------------------------------------------------------------------------------------

CViewRect TView::CalcMinFrame()
// CalcMinFrame is intended to compute the minimum size of this view.
//
// minFrame:	Receives the calculated size, represented as a view rectangle.
//
// Call?		Seldom. Call AdjustFrame instead.
// Override?	As needed.
{
	return GetFrame();
}

//----------------------------------------------------------------------------------------
// TView::ClipFurtherTo:
//----------------------------------------------------------------------------------------

void TView::ClipFurtherTo(RgnHandle rRgn, CPoint_AC deltaOrg)
// ClipFurtherTo sets this view’s clip region to the intersection of the current
// clip region and the specified region. The new clip region’s origin is offset by
// the specifed point.
//
// rRgn:		specifies the region to intersect with the clip region.
// deltaOrg:	specifies the offset.
//
// Call?		As needed. Call your view’s OffsetAndClipFurtherTo
//				method if you want to offset the clip region before performing the intersection.
// Override?	Seldom.
{
#if qDebug
	AssumeFocused();
#endif

	SectRgn(GetClipRegion(), rRgn, rRgn);
	if (deltaOrg != gZeroPt)
		::MacOffsetRgn(rRgn, deltaOrg.h, deltaOrg.v);
	SetClip(rRgn);
}

//----------------------------------------------------------------------------------------
// TView::OffsetAndClipFurtherTo:
//----------------------------------------------------------------------------------------

void TView::OffsetAndClipFurtherTo(RgnHandle rRgn, CPoint_AC deltaOrg)
{
#if qDebug
	AssumeFocused();
#endif

	// First offset the clip Rgn
	if (deltaOrg != gZeroPt)
#if !qCarbon
		::MacOffsetRgn(GetClipRegion(), deltaOrg.h, deltaOrg.v);
#else
	// Note - OffsetRgn changes thePort's clipRgn
	{
		CGrafPtr port = ::GetCGrafPtr_AC();
		RgnHandle clipRegion = GetClipRegion();
		::MacOffsetRgn(clipRegion, deltaOrg.h, deltaOrg.v);
		::SetPortClipRegion(port, clipRegion);
	}
#endif

	SectRgn(GetClipRegion(), rRgn, rRgn);
	SetClip(rRgn);
}

//----------------------------------------------------------------------------------------
// TView::Close:
//----------------------------------------------------------------------------------------

void TView::Close()
// Close is intended to specify actions to take when this view is closed.
// TView::Close notifies dependent objects that the view has closed and
// invokes the Close method for each of its subviews.
//
// Call?		As inherited only.
// Override?	As needed. Your override must call its inherited Close method.
{
	Changed(mClosed, this);

	if (HasSubViews())
		for (CSubViewIterator iter(this); iter; ++iter)
			iter->Close();
}

//----------------------------------------------------------------------------------------
// TView::ComputeFrame:
//----------------------------------------------------------------------------------------

void TView::ComputeFrame(CViewRect& newFrame)
// ComputeFrame is intended to compute a view rectangle that represents the
// horizontal and vertical dimensions of this view. TView::ComputeFrame uses
// the view’s size determiners to specify the rules for the calculation. See
// SizeDeterminer for more information.
//
// newFrame:	Receives the view’s frame rectangle.
//
// Call?		Seldom. Call your view’s AdjustFrame method instead.
//
// Override?	As needed.
{
	CViewRect minFrame;								// will be calculated only when necessary
	bool haveMinFrame = false;

	// •••  location determiners
	// Adjust view location based on size determiners.
	VHSelect vhs;
	for (vhs = vSel; vhs <= hSel; ++vhs)
	{
		ViewCoordinate location;

		switch (GetLocationDeterminer(vhs))
		{
			case sizeRelSuperView:
				location = newFrame[topLeft][vhs];	// newFrame set in SuperViewChangedFrame
				break;

			case sizeVariable:					// For sizeVariable location is already set correctly
				if (!haveMinFrame)
				{
					minFrame = CalcMinFrame();
					haveMinFrame = true;
				}
				location = minFrame[topLeft][vhs];
				break;

			default:
				location = newFrame[topLeft][vhs];
				break;
		}
		newFrame[topLeft][vhs] = location;
	}
	// •••  location determiners

	// Adjust view size based on size determiners.
	for (vhs = vSel; vhs <= hSel; ++vhs)
	{
		ViewCoordinate dimension;

		switch (GetSizeDeterminer(vhs))
		{
			case sizeFixed:
				dimension = fSize[vhs];
				break;

			case sizeRelSuperView:
				dimension = newFrame.GetSize()[vhs];	// newFrame set in SuperViewChangedFrame
				break;

			case sizeSuperView:
				if (fSuperView)
					dimension = fSuperView->fSize[vhs];
				else
				{
					if (!haveMinFrame)
					{
						minFrame = CalcMinFrame();
						haveMinFrame = true;
					}
					dimension = minFrame.GetSize()[vhs];	// Set dimension to a default
				}
				break;

			case sizePage:
				{
					// If there is no printhandler we can defer until one is attached
					TPrintHandler * itsPrintHandler = GetPrintHandler();
					if (itsPrintHandler)
						dimension = itsPrintHandler->GetViewPerPage()[vhs];
					else
					{
						if (!haveMinFrame)
						{
							minFrame = CalcMinFrame();
							haveMinFrame = true;
						}
						dimension = minFrame.GetSize()[vhs];// Set dimension to a default
					}
				}
				break;

			case sizeFillPages:
				{
					if (!haveMinFrame)
					{
						minFrame = CalcMinFrame();
						haveMinFrame = true;
					}
					// If there is no printhandler we can defer until one is attached
					TPrintHandler * itsPrintHandler = GetPrintHandler();
					if (itsPrintHandler)
						dimension = RoundUp(minFrame.GetSize()[vhs], static_cast<short>(itsPrintHandler->GetViewPerPage()[vhs]));
					else
						dimension = minFrame.GetSize()[vhs];// Set dimension to a default
				}
				break;

			case sizeVariable:					// For sizeVariable dimension is already set correctly
			default:
				if (!haveMinFrame)
				{
					minFrame = CalcMinFrame();
					haveMinFrame = true;
				}
				dimension = minFrame.GetSize()[vhs];// Set dimension to a default
				break;
		}
		newFrame[botRight][vhs] = newFrame[topLeft][vhs] + dimension;
	}
}

//----------------------------------------------------------------------------------------
// TView::ContainsClipType:
//----------------------------------------------------------------------------------------

bool TView::ContainsClipType(ResType aType)
// ContainsClipType is intended to return true if the clipboard supports data
// of the specified type. TView::ContainsClipType returns true if the desk scrap
// contains data of the specified type.
// For example, a text edit view’s ContainsClipType can be overridden to return
// TRUE if the clipboard allows 'TEXT' data.
// The default is to just check if the specified type is in the clip. That doesn't
// account for data that is in the view itself, which is why views might want
// to override this method. 
//
// aType:	Specifies the resource ID for the specified type.
//
// Call?		As needed.
// Override?	As needed.
{
	return gClipboardMgr->GetFlavorSize(aType) > 0;
}

//----------------------------------------------------------------------------------------
// TView::ContainsMouse:
//----------------------------------------------------------------------------------------

bool TView::ContainsMouse(const CViewPoint& theMouse)
// ContainsMouse is intended to return true if the mouse pointer is in this
// view. TView::ContainsMouse returns true if this view’s extent is currently
// displayed and contains the mouse.
//
// theMouse:	Specifies the mouse pointer’s location.
//
// Call?		As needed.
// Override?	Seldom.
{
	CTempRegion_AC extentRgn;
	GetExtentRegion(extentRgn);

	return (IsShown() && PtInRgn(ViewToQD(theMouse), extentRgn));
}

//----------------------------------------------------------------------------------------
// TView::CountSubViews:
//----------------------------------------------------------------------------------------

short TView::CountSubViews() const
{
	short count = 0;

	register TView* subView = fSubView;
	while (subView)
	{
		++count;
		subView = subView->fNextView;
	}

	return count;
}

//----------------------------------------------------------------------------------------
// TView::DoBreakFollowing:
//----------------------------------------------------------------------------------------

ViewCoordinate TView::DoBreakFollowing(	VHSelect			vhs,
										ViewCoordinate		previousBreak,
										bool&				automatic)
// CountSubViews returns the number of subviews contained in this view.
//
// Call?		As needed.
// Override?	Seldom.
{
	ViewCoordinate returnVal = 0;

	TPrintHandler * itsPrintHandler = GetPrintHandler();
	if (itsPrintHandler)
		returnVal = itsPrintHandler->BreakFollowing(vhs, previousBreak, automatic);

	return returnVal;
}

//----------------------------------------------------------------------------------------
// TView::DoCalcPageStrips:
//----------------------------------------------------------------------------------------

CViewPoint TView::DoCalcPageStrips()
{
	TPrintHandler * itsPrintHandler = GetPrintHandler();

	return itsPrintHandler ? itsPrintHandler->CalcPageStrips() : gZeroVPt;
}

//----------------------------------------------------------------------------------------
// TView::DoCalcViewPerPage:
//----------------------------------------------------------------------------------------

CViewPoint TView::DoCalcViewPerPage()
{
	TPrintHandler * itsPrintHandler = GetPrintHandler();

	return itsPrintHandler ? itsPrintHandler->CalcViewPerPage() : fSize;
}

//----------------------------------------------------------------------------------------
// TView::DoCheckPrinter:
//----------------------------------------------------------------------------------------

void TView::DoCheckPrinter()
{
	// If you are sizeVariable and are going to want to depend on the printed page geometry
	// then you will want to override this method and add an appropriate test

	TPrintHandler * itsPrintHandler = GetPrintHandler();
	if (itsPrintHandler)
	{
		if (itsPrintHandler->fShowBreaks || GetSizeDeterminer(vSel) == sizePage || GetSizeDeterminer(vSel) == sizeFillPages || GetSizeDeterminer(hSel) == sizePage || GetSizeDeterminer(hSel) == sizeFillPages)
			itsPrintHandler->Update();
	}
}

//----------------------------------------------------------------------------------------
// TView::DoDrawPrintFeedback:
//----------------------------------------------------------------------------------------

void TView::DoDrawPrintFeedback(const CViewRect& area)
{
#if qDebug
	AssumeFocused();
#endif

	TPrintHandler * itsPrintHandler = GetPrintHandler();
	if (itsPrintHandler)
		itsPrintHandler->DrawPrintFeedback(area);
}

//----------------------------------------------------------------------------------------
// TView::DoDrawPageBreak:
//----------------------------------------------------------------------------------------

void TView::DoDrawPageBreak(VHSelect		vhs,
							short			whichBreak,
							ViewCoordinate	loc,
							bool			automatic)
{
	TPrintHandler * itsPrintHandler = GetPrintHandler();
	if (itsPrintHandler)
		itsPrintHandler->DrawPageBreak(vhs, whichBreak, loc, automatic);
}

//----------------------------------------------------------------------------------------
// TView::HandlesCursor:
//----------------------------------------------------------------------------------------

bool TView::HandlesCursor() const
{
	bool result = (fHandlesCursor && IsEnabled()) || LetsSubViewsHandleCursor()
#if qDrag
	||fDraggable
#endif
	;

	return result;
}

//----------------------------------------------------------------------------------------
// TView::LetsSubViewsHandleCursor:
//----------------------------------------------------------------------------------------

bool TView::LetsSubViewsHandleCursor() const
{
	return fLetsSubViewsHandleCursor && HasSubViews();
}

//----------------------------------------------------------------------------------------
// TView::HandlesHelp:
//----------------------------------------------------------------------------------------

bool TView::HandlesHelp() const
{
	return fHandlesHelp || LetsSubViewsHandleHelp();
}

//----------------------------------------------------------------------------------------
// TView::LetsSubViewsHandleHelp:
//----------------------------------------------------------------------------------------

bool TView::LetsSubViewsHandleHelp() const
{
	return fLetsSubViewsHandleHelp && HasSubViews();
}

//----------------------------------------------------------------------------------------
// TView::UpdateSelection:
//----------------------------------------------------------------------------------------

void TView::UpdateSelection(const CViewPoint& theMouse, TToolboxEvent* event)
{
	#pragma unused (theMouse, event)
}

//----------------------------------------------------------------------------------------
// TView::DoHighlightSelection:
//----------------------------------------------------------------------------------------

void TView::DoHighlightSelection(HLState fromHL, HLState toHL)
{
	#pragma unused (fromHL, toHL)
}

//----------------------------------------------------------------------------------------
// TView::GetCurrentHL:
//----------------------------------------------------------------------------------------

HLState TView::GetCurrentHL()
{
	return IsActive() ? fActiveHL : fInactiveHL;
}

//----------------------------------------------------------------------------------------
// TView::DoMouseCommand:
//----------------------------------------------------------------------------------------

void TView::DoMouseCommand(CViewPoint&		theMouse,
						   TToolboxEvent*	event,
						   CPoint_AC		hysteresis)
{
	#pragma unused (theMouse, event, hysteresis)
}

//----------------------------------------------------------------------------------------
// TView::DoMouseUp:
//----------------------------------------------------------------------------------------

void TView::DoMouseUp(CViewPoint&		theMouse,
					  TToolboxEvent*	event,
					  CPoint_AC			hysteresis)
{
	#pragma unused (theMouse, event, hysteresis)
}

//----------------------------------------------------------------------------------------
// TView::DoPagination:
//----------------------------------------------------------------------------------------

void TView::DoPagination()
{
	TPrintHandler * itsPrintHandler = GetPrintHandler();
	if (itsPrintHandler)
		itsPrintHandler->RedoPageBreaks();
}

//----------------------------------------------------------------------------------------
// TView::DoPrinterChanged:
//----------------------------------------------------------------------------------------

void TView::DoPrinterChanged()
{
	TPrintHandler * itsPrintHandler = GetPrintHandler();
	if (itsPrintHandler)
		itsPrintHandler->PrinterChanged();
}

//----------------------------------------------------------------------------------------
// TView::DoSetPageOffset:
//----------------------------------------------------------------------------------------

void TView::DoSetPageOffset(const CViewPoint& coord)
{
	TPrintHandler * itsPrintHandler = GetPrintHandler();
	if (itsPrintHandler)
		itsPrintHandler->SetPageOffset(coord);
}

//----------------------------------------------------------------------------------------
// TView::DoSetCursor:
//----------------------------------------------------------------------------------------

void TView::DoSetCursor(const CViewPoint& localPoint, RgnHandle cursorRegion)
{
#if qDebug
	AssumeFocused();
#endif

#if qDrag
	RgnHandle dragCursorRegion = NULL;
	if (!HasDragManager_AC() || !DoSetDragCursor(localPoint, cursorRegion, dragCursorRegion))
	{
#endif
		ResNumber theCursorID = GetCursorID();
		if (theCursorID != kNoResource)
		{
			CPoint_AC localQDPoint(ViewToQD(localPoint));
			if (PtInRgn(localQDPoint, cursorRegion))
			{
#if !qMSWindows // •••  This needs work to work in Windows!
				CursHandle aCursor = ::GetCursor_AC(theCursorID);
				::ThrowIfNULLResource_AC((Handle)aCursor);
				::SetCursor_AC(*aCursor);
#endif
			}
			else
				::SetCursorToArrow_AC();
		}
		else
			::SetCursorToArrow_AC();

#if qDrag
		// remove the drag region from the cursor region so the cursor
		// will be updated if it moves into or out of the drag region
		if (dragCursorRegion)
			DiffRgn(cursorRegion, dragCursorRegion, cursorRegion);
	}
	DisposeIfRgnHandle(dragCursorRegion);
#endif

	// If you claim the cursor don't forget to _PROPERLY_ calculate the cursorRegion or
	// WaitNextEvent might give you a lovely mouse-moved event shower. (Lather up!)

	// P.S. In debug this is checked for in our original caller: TApplication.TrackMouse.

	// If you need to do any direct drawing or other good stuff put it in an override

	fgSetCursorView = this; // It's us, we claimed it
}

//----------------------------------------------------------------------------------------
// TView::DoUnsetCursor:
//----------------------------------------------------------------------------------------

void TView::DoUnsetCursor()
{
	// If you need to do any direct drawing or other good stuff put it in an override
}

//----------------------------------------------------------------------------------------
// TView::DoShowHelp:
//----------------------------------------------------------------------------------------

void TView::DoShowHelp(const CViewPoint& localPoint, RgnHandle helpRegion)
{
#if qCarbon || qMSWindows
	#pragma unused (localPoint, helpRegion)
	//#pragma message ("TView::DoShowHelp: This needs a new approach that is more generic.")
#else
	if (GetHelpID() != kNoResource)
	{
		GetDefaultHelpRegion(localPoint, helpRegion);

		try
		{
			HMMessageRecord helpMessage;
			CPoint_AC tip;
			CRect_AC hotRect;
			short balloonVariant;

			GetHelpParameters(localPoint, helpRegion, helpMessage, tip, hotRect, balloonVariant);
			DoShowBalloon(localPoint, helpRegion, helpMessage, tip, hotRect, balloonVariant);
		}
		catch(CException_AC& theException)
		{
			DoCatchMessage_AC(theException);

			if (theException.GetError() != hmSkippedBalloon)
				throw;

			// fall through
		}
	}
#endif
}

#if !qCarbon && !qMSWindows

//----------------------------------------------------------------------------------------
// TView::DoShowBalloon:
//----------------------------------------------------------------------------------------

void TView::DoShowBalloon(const CViewPoint&			localPoint,
						  RgnHandle					helpRegion,
						  const HMMessageRecord&	helpMessage,
						  CPoint_AC					localQDTip,
						  const CRect_AC&			localQDRect,
						  short						balloonVariant)
{
	#pragma unused (localPoint, localQDRect)

	OSErr err = (HMShowBalloon(&helpMessage, LocalToGlobal(localQDTip), NULL, NULL, 0, balloonVariant, kHMRegularWindow));
	if (err != hmBalloonAborted)
		::ThrowIfOSErr_AC(err);

	// Intersect with visible region. Excludes the balloon region.
	SectRgn(GetWindow()->GetVisRegion(), helpRegion, helpRegion);
	SectRgn(GetClipRegion(), helpRegion, helpRegion);
}

//----------------------------------------------------------------------------------------
// TView::GetHelpParameters:
//----------------------------------------------------------------------------------------

void TView::GetHelpParameters(const CViewPoint& localPoint,
							  RgnHandle			helpRegion,
							  HMMessageRecord&	helpMessage,
							  CPoint_AC&		localQDTip,
							  CRect_AC&			localQDRect,
							  short&			balloonVariant)
{
	gDispatcher->GetHelpParameters(GetHelpID(), GetHelpIndex(),// component number within resource
								   GetHelpState(),// view state: enabled, disabled etc.
								   helpMessage, localQDTip, localQDRect, balloonVariant);

	// Ignore the hotRect from the resource
	if (helpRegion)
	{
		//localQDRect = (*helpRegion)->rgnBBox;
		localQDRect = GetRegionBounds_AC(helpRegion);	// Carbonized
		if ((localQDTip.h < 0) || (localQDTip.v < 0))
		{
			//GetMouse(localQDTip);	 ???
			localQDTip = ViewToQD(localPoint);
		}
	}
}

//----------------------------------------------------------------------------------------
// TView::GetHelpState:
//----------------------------------------------------------------------------------------

short TView::GetHelpState()
{
	return IsEnabled() ? static_cast<short>(kHMEnabledItem) : static_cast<short>(kHMDisabledItem);
}

#endif		// !qCarbon && !qMSWindows

//----------------------------------------------------------------------------------------
// TView::GetDefaultCursorRegion:
//----------------------------------------------------------------------------------------
void TView::GetDefaultCursorRegion(const CViewPoint& localPoint, RgnHandle cursorRegion)
{
	// If we get all the way to this view without any other view having claimed the cursor
	// its because no superview handled it in a "HandleCursor" and no subview handled it
	// in a "DoSetCursor" thus there is a _very_ high probability that this view should
	// set the cursor. Just in case though, we remove the frames.
	//
	// If a containing view wishes to set the cursor for itself && all its subview, the
	// place to do that is in our caller: HandleCursor. See HandleCursor in the homebrew
	// controls TDialogView subclass in DemoDialogs.
	//
	// This strategy lets MacApp provide the _largest_ possible cursor rgn, as a default.
	// This way windows, controls, background views, etc can have nice big cursor rgns but
	// the developer can wrest control if they care to.
	#pragma unused (localPoint)

#if qDebug
	AssumeFocused();
#endif

	GetExtentRegion(cursorRegion);
	RestrictRegionToVisible(cursorRegion);	// Limit to visible since it might exceed short space.

	// We won't claim subviews' territory
	if (LetsSubViewsHandleCursor())
	{
		bool rgnHandleWasTooBig = false;
		CTempRegion_AC subViewFrameRgn;

		for (CSubViewIterator iter(this); iter; ++iter)
			if (iter->HandlesCursor() && !rgnHandleWasTooBig)
			{
				iter->GetExtentRegion(subViewFrameRgn);		// Remember, the frame is in OUR
															// coordinate system
				iter->SuperViewToLocal(cursorRegion);		// Remporarily map cursor region to prevent overflow.

				// Remove the subview from the claimed region.
				DiffRgn(cursorRegion, subViewFrameRgn, cursorRegion);

				iter->LocalToSuperView(cursorRegion);		// Unmap cursor region to bring back into correct space.

				if ((GetHandleSize((Handle)cursorRegion) > kRgnHandleTooBig) || (MemError() != noErr))
				{
					rgnHandleWasTooBig = true;
					SetEmptyRgn(cursorRegion);
				}
			}
	}
	// If you claim the cursor don't forget to _PROPERLY_ calculate the cursorRegion or
	// WaitNextEvent might give you a lovely mouse-moved event shower. (Lather up!)

	// P.S. In debug this is checked for in our original caller: TApplication.TrackCursor.
}

//----------------------------------------------------------------------------------------
// TView::GetDefaultHelpRegion:
//----------------------------------------------------------------------------------------
void TView::GetDefaultHelpRegion(const CViewPoint& localPoint, RgnHandle helpRegion)
{
	#pragma unused (localPoint)

#if qDebug
	AssumeFocused();
#endif

	GetExtentRegion(helpRegion);

	// We won't claim subviews' territory
	if (LetsSubViewsHandleHelp())
	{
		bool rgnHandleWasTooBig = false;
		CTempRegion_AC subViewFrameRgn;

		for (CSubViewIterator iter(this); iter; ++iter)
			if (iter->HandlesHelp() && !rgnHandleWasTooBig)
			{
				iter->GetExtentRegion(subViewFrameRgn);// Remember, the frame is in OUR
				// coordinate system
				iter->LocalToSuperView(subViewFrameRgn);
				DiffRgn(helpRegion, subViewFrameRgn, helpRegion);// Remove the subview from the claimed rgn

				if ((GetHandleSize((Handle)helpRegion) > kRgnHandleTooBig) || (MemError() != noErr))
				{
					rgnHandleWasTooBig = true;
					SetEmptyRgn(helpRegion);
				}
			}
	}
}

//----------------------------------------------------------------------------------------
// TView::GetLocalOffsetInSuper:
//----------------------------------------------------------------------------------------

CViewPoint TView::GetLocalOffsetInSuper() const
{
	return fLocation - fTranslation;
}

//----------------------------------------------------------------------------------------
// TView::SetLocalOrigin:
//----------------------------------------------------------------------------------------

void TView::SetLocalOrigin(const CViewPoint& newOrigin, bool redraw)
{
	if (fTranslation != -newOrigin)
	{
		fTranslation = -newOrigin;
		InvalidateFocus();
		InvalidateCoordinates();
		if (redraw)
			ForceRedraw();
	}
}

//----------------------------------------------------------------------------------------
// TView::GetUserSelection:
//----------------------------------------------------------------------------------------

TDesignator* TView::GetUserSelection() const
{
	TDesignator*	theDesignator = NULL;

	if (fSuperView)
		theDesignator = fSuperView->GetUserSelection();
	else if (fDocument)
		theDesignator = fDocument->GetUserSelection();

	return theDesignator;
}

//----------------------------------------------------------------------------------------
// TView::SetUserSelection:
//----------------------------------------------------------------------------------------

void TView::SetUserSelection(TDesignator* newSelection)
{
	if (fSuperView)
		fSuperView->SetUserSelection(newSelection);
	else if (fDocument)
		fDocument->SetUserSelection(newSelection);
}

//----------------------------------------------------------------------------------------
// TView::UserSelectionChanged:
//----------------------------------------------------------------------------------------

void TView::UserSelectionChanged(TView* changedView)
{
	if (fSuperView)
		fSuperView->UserSelectionChanged(changedView);
	else if (fDocument)
		fDocument->UserSelectionChanged(changedView);
}

//----------------------------------------------------------------------------------------
// TView::ScrollSelectionIntoView:
//----------------------------------------------------------------------------------------

void TView::ScrollSelectionIntoView(bool redraw)
{
	// As a default, reveal the view's extent
	RevealRect(GetExtent(), fSize, redraw);
}

//----------------------------------------------------------------------------------------
// TView::DoMakeNewDrawingEnvironment:
//----------------------------------------------------------------------------------------

TDrawingEnvironment* TView::DoMakeNewDrawingEnvironment()
{
	return TH_new TDrawingEnvironment;
}

//----------------------------------------------------------------------------------------
// TView::CreateDrawingEnvironment:
//----------------------------------------------------------------------------------------

void TView::CreateDrawingEnvironment()
// If the value of this view’s fDrawingEnvironment field is NULL, then
// create a drawing environment for this view.
//
// Call?		As needed.
// Override?	Seldom. Override your view’s DoMakeNewDrawingEnvironment
//				method instead.
{
	if (!fDrawingEnvironment)
		fDrawingEnvironment = DoMakeNewDrawingEnvironment();
}

//----------------------------------------------------------------------------------------
// TView::SetDrawingEnvironment:
//----------------------------------------------------------------------------------------

void TView::SetDrawingEnvironment(TDrawingEnvironment*	itsDrawingEnvironment,
								  bool					invalidate)
{
	// protect against installing same drawing environment
	if (fDrawingEnvironment != itsDrawingEnvironment)
		fDrawingEnvironment = itsDrawingEnvironment;

	if (invalidate)
		ForceRedraw();
}

//----------------------------------------------------------------------------------------
// TView::PrepareForDrawing:
//----------------------------------------------------------------------------------------

void TView::PrepareForDrawing()
// PrepareForDrawing is intended to specify the actions to take before this view
// is drawn.  The default action is to prepate and setup the drawing environment. 
//
// Call?		Seldom.
// Override?	As needed.  You might override in order to implement off-screen
//				drawing (though we recommend you use a drawing environment for
//				this purpose).
{
	if (fDrawingEnvironment)
		fDrawingEnvironment->Prepare();

	SetupDrawingEnvironment();
}

//----------------------------------------------------------------------------------------
// TView::SetupDrawingEnvironment:
//----------------------------------------------------------------------------------------

void TView::SetupDrawingEnvironment()
{
	if (fDrawingEnvironment)
		fDrawingEnvironment->Setup();
}

//----------------------------------------------------------------------------------------
// TView::CompleteDrawing:
//----------------------------------------------------------------------------------------

void TView::CompleteDrawing()
// CompleteDrawing is intended to specify the actions to take after this view
// is drawn. TView::CompleteDrawing invokes the drawing environment’s Complete
// method for this view to reset the pen and foreground and background colors.
//
// Call?		Seldom.
// Override?	As needed.  You might override in order to implement off-screen
//				drawing.
{
	if (fDrawingEnvironment)
		fDrawingEnvironment->Complete();
}

//----------------------------------------------------------------------------------------
// TView::Draw:
//----------------------------------------------------------------------------------------

void TView::Draw(const CViewRect& area)
{
	#pragma unused (area)
}

//----------------------------------------------------------------------------------------
// TView::HandleDrawFailed:
//----------------------------------------------------------------------------------------

bool TView::HandleDrawFailed(const CViewRect& area, const CException_AC& theException)
{
	// Show the error then call DrawFailed() to paint in the region
	// Remembering to validate the region AFTER showing the error
	// This way the error won't keep recurring!

	bool alertAndContinue = NotifyDrawFailed(theException);

	InvalidateFocus();
	if (Focus())
		DrawFailed(area);

	if (alertAndContinue)
		Validate(GetQDExtent());

	return alertAndContinue;
}

//----------------------------------------------------------------------------------------
// TView::NotifyDrawFailed:
//----------------------------------------------------------------------------------------

bool TView::NotifyDrawFailed(const CException_AC& theException)
{
	// The default is to just let the user know by posting an alert, however, you may
	// wish to update a status panel or something in an override.

	// We don't post the alert when NOT updating b/c we'll just take the default re-throwing
	// of the exception
	TWindow* theWindow = GetWindow();
	bool alertAndContinue = theWindow && theWindow->GetUpdating();
	if (alertAndContinue)
		gDispatcher->ShowError(theException.GetError(), theException.GetExceptionMessage());

	return alertAndContinue;
}

//----------------------------------------------------------------------------------------
// TView::DrawFailed:
//----------------------------------------------------------------------------------------

void TView::DrawFailed(const CViewRect& area)
{
	#pragma unused (area)

	::PenNormal();
#if qCarbon
	CTempRegion_AC clipRgn;
	::GetPortClipRegion(GetCGrafPtr_AC(), clipRgn);
	Pattern ltGray;
	::MacFillRgn(clipRgn, ::GetQDGlobalsLightGray(&ltGray));
#else
	::MacFillRgn(GetGrafPtr_AC()->clipRgn, CPattern_AC::LightGray());
#endif

#if qDebug
	::PenSize(2, 2);
#if qCarbon
	::MacFrameRgn(clipRgn);
#else
	::MacFrameRgn(GetGrafPtr_AC()->clipRgn);
#endif
	::PenNormal();
#endif
}

//----------------------------------------------------------------------------------------
// TView::DrawContents:
//----------------------------------------------------------------------------------------

void TView::DrawContents()
{
	HandleDraw(GetExtent());
}

//----------------------------------------------------------------------------------------
// TView::HandleDraw:
//----------------------------------------------------------------------------------------

void TView::HandleDraw(const CViewRect& area)
{
	if (!(area & GetVisibleExtent()).Empty() && IsShown() && Focus())
	{
		// Even if the visible extent is not empty the Drawable rect might be.
		// The Focus (above) will set the clipping for us so we can use it to determine
		// what can be drawn.
		const RgnHandle currentClipRgn = GetClipRegion();
		const CRect_AC clipQDRect(GetRegionBounds_AC(currentClipRgn));
		if (!clipQDRect.Empty())				// can we draw anything at all thru the current clip?
		{
			const CViewRect drawArea(area & QDToView(clipQDRect));
			if (!drawArea.Empty())				// does the requested drawing area intersect the drawable area?
			{
				// As suggested by Ed Anson:
				// Check to see if the drawing area intersects the clipping region
				// before drawing.
				const CRect_AC drawQDArea(ViewToQD(drawArea));
				if (RectInRgn(&drawQDArea, currentClipRgn))// does the requested area intersect the drawable region?
				{
					try
					{
#if qOpaqueViews
						CTempRegion_AC originalClippedRgn(NULL);
						CTempRegion_AC subviewClippedRgn(NULL);

						// remove any opaque subviews from the clip
						bool subviewClippingOccurred = false;
						if (HasSubViews())
						{
							subviewClippedRgn = MakeNewRgn();
							::MacCopyRgn(currentClipRgn, subviewClippedRgn);

							originalClippedRgn = MakeNewRgn();
							::MacCopyRgn(currentClipRgn, originalClippedRgn); // we'll need this later

							if (ClipOpaqueSubViews(subviewClippedRgn))
							{
								ClipFurtherTo(subviewClippedRgn, gZeroPt);

								// put the subview clips into the current clip
								::MacUnionRgn(subviewClippedRgn, currentClipRgn, currentClipRgn);

								subviewClippingOccurred = true;
							}
						}
#endif

						// Prepare for drawing and initialize the drawing environment.
						CDrawingEnvironmentManager	manageDrawingEnvironment(this);

						if (fAdorners)
							DrawAdorners(drawArea);
						else
							Draw(drawArea);

						// Give the behavior a chance to draw
						TBehavior * aBehavior = GetFirstEnabledBehavior();
						if (aBehavior)
							aBehavior->Draw(drawArea);

						// Draw all of the subviews
						if (HasSubViews())
						{
#if qOpaqueViews
							if (subviewClippingOccurred && IsFocused())		// no-one else cares about the removal of my subviews
								::SetClip(originalClippedRgn);
#endif

							for (CSubViewIterator iter(this); iter; ++iter)
							{
#if !qMSWindows
								// Standard Mac section.
								CViewRect subViewDrawArea(iter->SuperViewToLocal(drawArea));

								const CViewRect subViewDrawAreaExtent(subViewDrawArea & iter->GetExtent());
								if (!subViewDrawAreaExtent.Empty())
									iter->HandleDraw(subViewDrawAreaExtent);
#else
								// Windows section.
								if (!iter->NeedsOwnWindowsWindow() || iter->IsTransparentView())
								{
									CViewRect subViewDrawArea(iter->SuperViewToLocal(drawArea));

									const CViewRect subViewDrawAreaExtent(subViewDrawArea & iter->GetExtent());
									if (!subViewDrawAreaExtent.Empty())
									{
										
										HDC hdc = ::GetDC(iter->GetWindowsWindow());
										iter->SetDrawingContext(new TDrawingContext(hdc));
										iter->HandleDraw(subViewDrawAreaExtent);
										iter->SetDrawingContext(NULL);
										ReleaseDC(iter->GetWindowsWindow(), hdc);
									}
								}
#endif
							}
						}

						// Note that we need to re-focus because we've been left
						// focused on our subviews.
						if (Focus())
						{
#if qOpaqueViews
							if (subviewClippingOccurred)
								// Remove any opaque subviews from the clip.
								::SetClip(subviewClippedRgn);
#endif
						}

						// Add the adornments.
						if (!(gPrinting || gDrawingPictScrap) && fAdorners)
							HighlightAdorners(drawArea, hlOff, GetCurrentHL());

#if qOpaqueViews
						if (subviewClippingOccurred && IsFocused())
							// remove any opaque subviews from the clip
							::SetClip(originalClippedRgn);
#endif
						// At this point the CDrawingEnvironmentManager will go out of scope
						// and its destructor will be called. 
					}
					catch (CException_AC& theException)
					{
						DoCatchMessage_AC(theException);

						if (!HandleDrawFailed(area, theException))
							throw;
					}
				}
			}
		}

#if qDebug
		if (gShowInvalidations)		// Special delay after drawing each view so you
			DelayFuture_AC(15);		// can watch it advance so you can see it.
#endif
	}
}

//----------------------------------------------------------------------------------------
// TView::DrawAdorners:
//----------------------------------------------------------------------------------------

void TView::DrawAdorners(const CViewRect& area)
{
	PenState savePenState;
	GetPenState(&savePenState);

	for (CAdornerIterator iter(this); iter.Current(); ++iter)
		if (iter->DoesAdorn(this))
		{
			iter->Draw(this, area);
			SetPenState(&savePenState);
		}
}

//----------------------------------------------------------------------------------------
// TView::FindSubView:
//----------------------------------------------------------------------------------------

TView* TView::FindSubView(IDType itsIdentifier) const
{
	TView* returnVal = NULL;

	if (fIdentifier == itsIdentifier)
		returnVal = const_cast<TView*>(this);
	else if (HasSubViews())
		for (CSubViewIterator iter(this); iter; ++iter)
		{
			if (iter->fIdentifier == itsIdentifier)
			{
				returnVal = iter;
				break;
			}
			else if (iter->HasSubViews())
			{
				TView * foundSubView = iter->FindSubView(itsIdentifier);
				if (foundSubView)
				{
					returnVal = foundSubView;
					break;
				}
			}
		}

	return returnVal;
}

//----------------------------------------------------------------------------------------
// TView::Focus:
//----------------------------------------------------------------------------------------

bool TView::Focus()
// Focus is used to set up the drawing environment for this view and return true
// if successful. First we focus on our superview (and on up the chain of views),
// set the QuickDraw origin, and clip the view to its superview.
//
// Call?		As needed.
// Override?	Seldom. Set up pen characteristics, text styles, and so forth,
//				in your drawing environment’s Prepare method. See
//				TView::PrepareForDrawing for more information.
{
	bool		didFocus = false;

#if qCarbon
	// If the clip was blown away, force a full refocus
	if (IsFocused() && ::EmptyRgn(GetClipRegion()))
		InvalidateFocus();
#endif

	if (IsFocused())							// Already focused.
	{
		GrafPtr		currentPort;
		GrafPtr		expectedPort = GetGrafPort();

		::GetPort(&currentPort);
		if (currentPort != expectedPort)
		{
			::SetPort_AC(expectedPort);

			SetupDrawingEnvironment();
		}
	}
	else if (gDrawingPictScrapView == this)
	{
		gFocusedView = this;

		CRect_AC qdExtent(GetQDExtent());
		CPoint_AC qdOrigin(GetQDOrigin());
		::SetOrigin(qdOrigin.h, qdOrigin.v);
		::ClipRect(&qdExtent);

		SetupDrawingEnvironment();
	}
#if qMSWindows
	else if (fNeedsOwnWindowsWindow)
	{
		// Make sure we have a port before setting up the environment.
		GrafPtr port = GetGrafPort();
		if (port)
		{
			::SetPort_AC(port);
			gFocusedView = this;
			SetupDrawingEnvironment();
		}
	}
#endif
	else if (FocusOnSuperView())				// Do my own focus.
	{
		CPoint_AC qdOrigin(GetQDOrigin());
		::SetOrigin(qdOrigin.h, qdOrigin.v);	// Set the new QD origin.

		CPoint_AC deltaOrigin;
		if (TPrintHandler::gCurrPrintHandler && (TPrintHandler::gCurrPrintHandler->fView == this))
			deltaOrigin = qdOrigin - TPrintHandler::gCurrPrintHandler->GetQDOrigin();
		else if (fSuperView)
			deltaOrigin = qdOrigin - fSuperView->GetQDOrigin();
		else
			deltaOrigin.Clear();

		gFocusedView = this;					// Now we have the basic focus.

		// Add the shaping to the view's extent shape.
		CTempRegion_AC rRgn;
		GetExtentRegion(rRgn);
		OffsetAndClipFurtherTo(rRgn, deltaOrigin);

		// Add the clipping to the currently visible portion of the extent.
		GetVisibleRegion(rRgn);
		ClipOpaqueSiblingViews(rRgn);
		ClipFurtherTo(rRgn, gZeroPt);

		SetupDrawingEnvironment();
	}
	didFocus = (gFocusedView == this);

	return didFocus;
}

//----------------------------------------------------------------------------------------
// TView::FocusOnSuperView:
//----------------------------------------------------------------------------------------

bool TView::FocusOnSuperView()
{
	bool returnVal = false;

	if (TPrintHandler::gCurrPrintHandler && (TPrintHandler::gCurrPrintHandler->fView == this))
		returnVal = TPrintHandler::gCurrPrintHandler->Focus();
	else if (fSuperView)
		returnVal = fSuperView->Focus();

	return returnVal;
}

//----------------------------------------------------------------------------------------
// TView::ForceRedraw:
//----------------------------------------------------------------------------------------

void TView::ForceRedraw()
{
	if (IsVisible())
	{
#if !qMSWindows
		CTempRegion_AC itsExtentRgn;

		GetExtentRegion(itsExtentRgn);
		Invalidate(itsExtentRgn);
#else
		if (fWindowsWindow != NULL)
		{
			RECT rect;
			GetClientRect(fWindowsWindow, &rect);
			InvalidateRect(fWindowsWindow, &rect, true);
		}
#endif
	}
}

//----------------------------------------------------------------------------------------
// TView::FreeFromClipboard:
//----------------------------------------------------------------------------------------

void TView::FreeFromClipboard()
{
	gClipboardMgr->Changed(mFreeClipboardView, this);

	if (fDocument)
	{
		fDocument->FreeFromClipboard();
		fDocument = NULL;
	}

	else if (gClipboardMgr->GetClipOrphanage() != this)
		delete this;
}

//----------------------------------------------------------------------------------------
// TView::GetStandardSignature:
//----------------------------------------------------------------------------------------

IDType TView::GetStandardSignature() const
{
	return kStdView;
}

//----------------------------------------------------------------------------------------
// TView::ReadFrom:
//----------------------------------------------------------------------------------------

void TView::ReadFrom(CStream_AC* aStream)
{
	TEventHandler::ReadFrom(aStream);					// read in TEventHandler info

	// Subclasses of TView should override either TView::ReadFields or TView::ReadSubViews,
	// not TView::ReadFrom.

	fTemplateVersion = aStream->ReadInteger();		// Moved from ReadFields.

	if (fTemplateVersion == kMARelease13ViewsTemplateVersion)
	{
		// read fields size and remember the current position.
		long sizePosition = aStream->GetReadPosition();
		long fieldsSize = aStream->ReadLong();
		ReadFields(aStream);						// read in fields polymorphically

#if qWriteTemplateViews
		if (aStream->GetReadPosition() < sizePosition + fieldsSize)
		{
			Size itsSize = sizePosition + fieldsSize - aStream->GetReadPosition();
			CTempHandle_AC aHandle = NewPermHandle_AC(itsSize);

			// Lock the handle and read into it from the stream.
			// We definitely need to lock the handle here because
			// the code in ReadBytes may move memory before reading
			// the data.
			CTempHandleLock_AC tempHandleLock(aHandle);
			::ThrowIfMemError_AC();
			aStream->ReadBytes(*(Handle)aHandle, itsSize);

			fTemplateUnknownData = aHandle.release();	// CAutoPtr ownership is transferred
		}
#if qDebug
		else if (aStream->GetReadPosition() > sizePosition + fieldsSize)
			::ProgramBreak_AC("###Stream position is greater than saved position in TView::ReadFrom.");
#endif // qDebug
#endif // qWriteTemplateViews

		// move the stream position past the end of our fields
		aStream->SetReadPosition(sizePosition + fieldsSize);

	}
	else if (fTemplateVersion == kMAThreeOhTemplateVersion)
	{
		// bump up the template version and read in fields directly.
		fTemplateVersion = kMARelease13ViewsTemplateVersion;
		ReadFields(aStream);						// read in fields polymorphically
	}
#if qDebug
	else
		::ProgramBreak_AC("###Unknown template version in TView::ReadFrom.");
#endif

	ReadSubViews(aStream);						// read in subviews
}

//----------------------------------------------------------------------------------------
// TView::ReadFields:
//----------------------------------------------------------------------------------------

void TView::ReadFields(CStream_AC* aStream)
{
	// template version moved to ReadFrom where it is needed for guard length protection.

	*aStream 	>> fLocation
				>> fSize
				>> StreamInEnum_AC(fSizeDeterminer[vSel])
				>> StreamInEnum_AC(fSizeDeterminer[hSel])
				>> fShown
				>> fWantsToBeTarget
				>> fHandlesCursor
				>> fLetsSubViewsHandleCursor
				>> fCursorID
				>> fHandlesHelp
				>> fLetsSubViewsHandleHelp
				>> fHelpID
				>> fHelpIndex;

	bool wasValid;
	fDrawingEnvironment = dynamic_cast_AC(TDrawingEnvironment*,aStream->ReadStreamObject(wasValid));
	if (!wasValid)
	{
		fDrawingEnvironment = NULL;
#if qDebugMsg
		::ProgramBreak_AC("###Unknown TDrawingEnvironment in TView::ReadFields.");
#endif

	}

	// It so happens that some default adorners may attach themselves at constructor time.
	// We make sure to delete them here before the list is deleted by the auto-ptr assignment
	DeleteAllAdorners();

	fAdorners = dynamic_cast_AC(TAdornerList*, aStream->ReadStreamObject(wasValid));

	if (!wasValid)
	{
		fAdorners = NULL;
#if qDebugMsg
		::ProgramBreak_AC("###Unknown TAdornerList in TView::ReadFields.");
#endif

	}

	*aStream >> fUserArea;

	aStream->ReadIDType();					// read in idtype and ignore it
}

//----------------------------------------------------------------------------------------
// TView::ReadSubViews:
//----------------------------------------------------------------------------------------

void TView::ReadSubViews(CStream_AC* aStream)
{
	short numSubViews = aStream->ReadInteger();// read in count of subviews

	for (short count = 0; count < numSubViews; ++count)
	{
		bool wasValid;
		TView * aView = dynamic_cast_AC(TView*,aStream->ReadStreamObject(wasValid));
		if (wasValid && aView)
			AddSubView(aView);
#if qDebugMsg
		else
			::ProgramBreak_AC("###Unknown TView in TView::ReadSubViews: Attempting to create a TView.");
#endif
	}
}

//----------------------------------------------------------------------------------------
// TView::WriteTo:
//----------------------------------------------------------------------------------------

void TView::WriteTo(CStream_AC* aStream) const
{
	TEventHandler::WriteTo(aStream);				// write out TEventHandler info

	// Subclasses of TView should override either TView::WriteFields or TView::WriteSubViews,
	// not TView::WriteTo.

	if (qWriteTemplateViews)
	{
		aStream->WriteInteger(fTemplateVersion);			// Moved from WriteFields.
		long sizePosition = aStream->GetWritePosition();			// Remember the position of the fields size in the stream.
		aStream->WriteLong(LONG_MAX);						// Write a dummy size (maximum object size).

		WriteFields(aStream);								// write out fields polymorphically

#if qWriteTemplateViews
		if (fTemplateUnknownData)
		{
			Size itsSize = GetHandleSize(fTemplateUnknownData);

			// Write the contents of the handle.
			// We definitely need to lock the handle here because
			// the code in WriteBytes may move memory before reading
			// the data.
			CTempHandleLock_AC tempHandleLock(fTemplateUnknownData);
			::ThrowIfMemError_AC();
			aStream->WriteBytes(*fTemplateUnknownData, itsSize);
		}
#endif

		long currentPosition = aStream->GetWritePosition();		// Remember where we are.
		aStream->SetWritePosition(sizePosition);					// Go back to position of size.
		aStream->WriteLong(currentPosition - sizePosition);	// Write the size.
		aStream->SetWritePosition(currentPosition);				// Go back to where we were.

		WriteSubViews(aStream);								// write out subviews
	}
}

//----------------------------------------------------------------------------------------
// TView::WriteFields:
//----------------------------------------------------------------------------------------

void TView::WriteFields(CStream_AC* aStream) const
{
//	Byte itsHSizeDet = (Byte);
//	Byte itsVSizeDet = (Byte);
	// formerly SizeDeterminers; however, sizeof(enum) is compiler-dependent

	*aStream 	<< fLocation
				<< fSize
				<< StreamOutEnum_AC(fSizeDeterminer[vSel])
				<< StreamOutEnum_AC(fSizeDeterminer[hSel])
				<< fShown
				<< fWantsToBeTarget
				<< fHandlesCursor
				<< fLetsSubViewsHandleCursor
				<< fCursorID
				<< fHandlesHelp
				<< fLetsSubViewsHandleHelp
				<< fHelpID
				<< fHelpIndex;

	aStream->WriteStreamObject(fDrawingEnvironment);

	aStream->WriteStreamObject(fAdorners, kStandardObject);

	*aStream << fUserArea << GetStandardSignature();
}

//----------------------------------------------------------------------------------------
// TView::WriteSubViews:
//----------------------------------------------------------------------------------------

void TView::WriteSubViews(CStream_AC* aStream) const
{
	aStream->WriteInteger(CountSubViews());		// write out count of subviews

	if (HasSubViews())
		for (CSubViewIterator iter(this); iter; ++iter)
			aStream->WriteStreamObject(iter, kStandardObject);
}

//----------------------------------------------------------------------------------------
// TView::GetContext:
//----------------------------------------------------------------------------------------

TEventHandler* TView::GetContext(CommandNumber aCommandNumber)
{
	#pragma unused (aCommandNumber)
	return fDocument ? fDocument : dynamic_cast_or_throw_AC(TEventHandler*,GetWindow());
}

//----------------------------------------------------------------------------------------
// TView::GetExtent:
//----------------------------------------------------------------------------------------

CViewRect TView::GetExtent() const
{
	// Allow for the origin of the view's coordinate system.
	return CViewRect(gZeroVPt, fSize) - (GetLocalOffsetInSuper() - fLocation);
}

//----------------------------------------------------------------------------------------
// TView::GetExtentRegion:
//----------------------------------------------------------------------------------------

void TView::GetExtentRegion(RgnHandle itsExtentRgn) const
{
	::RectRgn(itsExtentRgn, GetQDExtent());
}

//----------------------------------------------------------------------------------------
// TView::GetFrame:
//----------------------------------------------------------------------------------------

CViewRect TView::GetFrame() const
{
	return CViewRect(fLocation, fLocation + fSize);
}

//----------------------------------------------------------------------------------------
// TView::GetGrafPort:
//----------------------------------------------------------------------------------------

GrafPtr TView::GetGrafPort() const
{
	GrafPtr returnVal = NULL;

	if (fDrawingEnvironment)
		returnVal = fDrawingEnvironment->GetGrafPort();
	if (!returnVal)
	{
		if (gPrinting || gDrawingPictScrap)
			returnVal = GetGrafPtr_AC();				//thePort assumed to be set by print handler
#if qMSWindows
		else if (fNeedsOwnWindowsWindow)
			returnVal = fGrafPort;
#endif
		else if (fSuperView)
			returnVal = fSuperView->GetGrafPort();
	}
	return returnVal;
}

//----------------------------------------------------------------------------------------
// TView::GetPartCode:
//----------------------------------------------------------------------------------------

short TView::GetPartCode(const CViewPoint& theMouse) const
{
	return GetExtent().Contains(theMouse) ? inContent : inDesk;
}

//----------------------------------------------------------------------------------------
// TView::GetPrintExtent:
//----------------------------------------------------------------------------------------

CViewRect TView::GetPrintExtent()
{
	return GetExtent();
}

//----------------------------------------------------------------------------------------
// TView::GetQDExtent:
//----------------------------------------------------------------------------------------

CRect_AC TView::GetQDExtent() const
{
	return ViewToQD(GetExtent());
}

//----------------------------------------------------------------------------------------
// TView::GetScroller:
//----------------------------------------------------------------------------------------

TScroller* TView::GetScroller(bool immediateSuperView)
{
	TScroller * returnVal = NULL;

	if (fSuperView)
	{
		TScroller * aScroller = fSuperView->GetScroller(immediateSuperView);
		if ((aScroller == fSuperView) || (!immediateSuperView))
			returnVal = aScroller;
	}
	return returnVal;
}

//----------------------------------------------------------------------------------------
// TView::GetVisibleRect:
//----------------------------------------------------------------------------------------

CViewRect TView::GetVisibleRect()
{
	return QDToView(GetVisibleQDRect());
}

//----------------------------------------------------------------------------------------
// TView::GetVisibleQDRect:
//----------------------------------------------------------------------------------------

CRect_AC TView::GetVisibleQDRect()
{
	CTempRegion_AC visibleRgn;

	GetVisibleRegion(visibleRgn);

	//return (*(RgnHandle)visibleRgn)->rgnBBox;
	return GetRegionBounds_AC(visibleRgn);	// Carbonized
}

//----------------------------------------------------------------------------------------
// TView::GetVisibleRegion:
//----------------------------------------------------------------------------------------

void TView::GetVisibleRegion(RgnHandle visibleRgn) const
{
	CViewRect visibleExtent(GetVisibleExtent());

	if (visibleExtent.Empty())
		SetEmptyRgn(visibleRgn);
	else
	{
		::RectRgn(visibleRgn, ViewToQD(visibleExtent));
		VisibleRgn(visibleRgn);
	}
}

//----------------------------------------------------------------------------------------
// TView::GetDrawableRect:
//----------------------------------------------------------------------------------------

CViewRect TView::GetDrawableRect()
{
	return QDToView(GetDrawableQDRect());
}

//----------------------------------------------------------------------------------------
// TView::GetDrawableQDRect:
//----------------------------------------------------------------------------------------

CRect_AC TView::GetDrawableQDRect()
{
	CTempRegion_AC drawableRgn;

	GetDrawableRegion(drawableRgn);

	//return (*(RgnHandle)drawableRgn)->rgnBBox;
	return GetRegionBounds_AC(drawableRgn);	// Carbonized
}

//----------------------------------------------------------------------------------------
// TView::GetDrawableRegion:
//----------------------------------------------------------------------------------------

void TView::GetDrawableRegion(RgnHandle drawRgn) const
{
	GetVisibleRegion(drawRgn);
	if (!EmptyRgn(drawRgn))
		DrawableRgn(drawRgn);
}

//----------------------------------------------------------------------------------------
// TView::GetHelpID:
//----------------------------------------------------------------------------------------

ResNumber TView::GetHelpID()
{
	return fHelpID;
}

//----------------------------------------------------------------------------------------
// TView::GetHelpIndex:
//----------------------------------------------------------------------------------------

short TView::GetHelpIndex()
{
	return fHelpIndex;
}

//----------------------------------------------------------------------------------------
// TView::GetCursorID:
//----------------------------------------------------------------------------------------

ResNumber TView::GetCursorID()
{
	return fCursorID;
}

//----------------------------------------------------------------------------------------
// TView::GetRootView:
//----------------------------------------------------------------------------------------

const TView* TView::GetRootView() const
{
	return fSuperView ? fSuperView->GetRootView() : this;
}

TView* TView::GetRootView()
{
	return fSuperView ? fSuperView->GetRootView() : this;
}

//----------------------------------------------------------------------------------------
// TView::GetWindow:
//----------------------------------------------------------------------------------------

TWindow* TView::GetWindow() const
{
	return fSuperView ? fSuperView->GetWindow() : NULL;
}

//----------------------------------------------------------------------------------------
// TView::GivePasteData:
//----------------------------------------------------------------------------------------

long TView::GivePasteData(Handle aDataHandle, ResType dataType)
// GivePasteData will determine if any paste data of the desired type is available
// and return the size of that data.  If aDataHandle is not NULL then the data will
// be returned in that handle (see note below).
//
// aDataHandle:		A Handle that will receive the paste data if not NULL.  Note that
//					the handle will be resized if it is not big enough to receive
//					the data.
// dataType:		A ScrapFlavorType indicating the type of data desired.
//
// Call?			Never.
// Override?		Never.
{
	long err = gClipboardMgr->GetFlavorSize(dataType);
	if (err < 0)
	{
#if qDebugMsg
		if (gIntenseDebugging)
			ProgramReport_AC("TView::GivePasteData: Got error code # %d from GetScrap for type %s\n", err, &dataType);
#endif
	}
	else if (aDataHandle)
	{
		// Make sure the scrap handle is grown out of permanent memory.	If it
		// was grown out of temporary memory it would eat away at our code space.
		// NOTE: If aDataHandle is NULL GetScrap will not return the data.
		// NOTE: GetScrap returns either an error (<0) or the size of the data.
		CTempAllocation tempAllocation(false);
		gClipboardMgr->GetScrap(aDataHandle, dataType);
	}
	return err;
}

//----------------------------------------------------------------------------------------
// TView::HandleCursor:
//----------------------------------------------------------------------------------------

void TView::HandleCursor(const CViewPoint& theMouse, RgnHandle cursorRegion)
{

	// Assume if we got here then we already know the mouse is in this view
	if (LetsSubViewsHandleCursor())
		for (CSubViewIterator iter(this, kIterateBackward_AC); iter; ++iter)
		{
			CViewPoint subViewPt(iter->SuperViewToLocal(theMouse));

			if ((iter->ContainsMouse(subViewPt) && iter->HandlesCursor()))
			{
				iter->HandleCursor(subViewPt, cursorRegion);
				// bring the cursor Rgn back to our coordinate system.
				iter->LocalToSuperView(cursorRegion);
				break;
			}
		}

	if (EmptyRgn(cursorRegion) && Focus())
	{
		// First let the Behavior have a crack at handling the cursor
		bool proceed = true;

		GetDefaultCursorRegion(theMouse, cursorRegion);

		if (GetFirstBehavior())
			proceed = !dynamic_cast_or_throw_AC(TBehavior*,GetFirstBehavior())->DoSetCursor(theMouse, cursorRegion);

		if (proceed)
			DoSetCursor(theMouse, cursorRegion);

		// Restrict the claimed cursor region to the visible extent of this view
		RestrictRegionToVisible(cursorRegion);

		fgSetCursorView = this; // in case someone's override of DoSetCursor forgot
	}
}

//----------------------------------------------------------------------------------------
// TView::HandleUnCursor:
//----------------------------------------------------------------------------------------

void TView::HandleUnCursor()
{
	if (Focus())
	{
		// First let the Behavior have a crack at handling the cursor
		bool proceed = true;

		if (GetFirstBehavior())
			proceed = !dynamic_cast_or_throw_AC(TBehavior*,GetFirstBehavior())->DoUnsetCursor();

		if (proceed)
			DoUnsetCursor();
	}
}

//----------------------------------------------------------------------------------------
// TView::HandleHelp:
//----------------------------------------------------------------------------------------

void TView::HandleHelp(const CViewPoint& theMouse, RgnHandle helpRegion)
{
	//Assume if we got here then we already know the mouse is in this view

	if (LetsSubViewsHandleHelp())
		for (CSubViewIterator iter(this, kIterateBackward_AC); iter; ++iter)
		{
			CViewPoint subViewPt(iter->SuperViewToLocal(theMouse));

			if (iter->ContainsMouse(subViewPt) && iter->HandlesHelp())
			{
				iter->HandleHelp(subViewPt, helpRegion);

				// bring the help Rgn back to our coordinate system.
				iter->LocalToSuperView(helpRegion);
				break;
			}
		}

	if (EmptyRgn(helpRegion) && HandlesHelp() && Focus())
	{
		DoShowHelp(theMouse, helpRegion);

		// Restrict the claimed help region to the visible extent of this view
		RestrictRegionToVisible(helpRegion);
	}
}

#if qWantsContextualMenus
//----------------------------------------------------------------------------------------
// TView::GetContextualMenu:
//----------------------------------------------------------------------------------------

void TView::GetContextualMenu(const CViewPoint& theMouse,
							  TToolboxEvent* event,
							  CContextualMenu& contextualMenu)
{
#pragma unused (theMouse, event)

	// Default implementation is to return a description of the containing window.
	// Subclasses of TView that mix MScriptable object may choose to describe themselves rather
	// than their containing window.
	TWindow* myWindow = GetWindow();
	if (myWindow)
	{
		try
		{
			CTempDesc_AC theSelection;
			if (myWindow->MakeObjectSpecifier(theSelection, myWindow->GetSpecifierForm()))
			{
				contextualMenu.SetSelection(TH_new CAEDesc_AC(theSelection.release()));
			}
		}
		catch(CException_AC& /*theException*/)
		{
		}

		// no resignal on failure
	}
}
#endif // qWantsContextualMenus

//----------------------------------------------------------------------------------------
// TView::HandleMouseDown:
//----------------------------------------------------------------------------------------

bool TView::HandleMouseDown(const CViewPoint& theMouse,
							   TToolboxEvent* event,
							   CPoint_AC hysteresis,
							   EMouseDownType mouseDownType)
{
	bool wasHandled = false;

	bool isFirstClick = (mouseDownType == kFirstClick_dragOnly || mouseDownType == kFirstClick_dragOrClick);
	bool canDoMouse = (mouseDownType == kDragOrClick || mouseDownType == kFirstClick_dragOrClick);

	if (HasSubViews())
		for (CSubViewIterator iter(this, kIterateBackward_AC); iter; ++iter)
		{
			CViewPoint subViewPt(iter->SuperViewToLocal(theMouse));

			if (iter->ContainsMouse(subViewPt))
				if (iter->HandleMouseDown(subViewPt, event, hysteresis, mouseDownType))
				{
					wasHandled = true;
					break;
				}
		}

	if (!wasHandled && Focus())								// see if we can handle it
	{
		CViewPoint tempMouse = theMouse;			// We do this so we can pass a const to DoMouseCommand
		CPoint_AC globalMouse(LocalToGlobal(ViewToQD(theMouse)));

		//  This is important to allowing the cursor to change when selecting
		if (gDispatcher->IsCursorRgnInvalid())
		{
			gDispatcher->TrackCursor(globalMouse);
			Focus();
		}

		if (canDoMouse && IsEnabled())
			UpdateSelection(tempMouse, event);

#if qDrag
		// if the user is dragging, and the view wants to drag, initiate a drag
		if (HasDragManager_AC())
		{
			RgnHandle dragCursorRegion = DoMakeDragCursorRegion();
			if (WillDrag(theMouse, dragCursorRegion))
			{
				dragCursorRegion = DisposeIfRgnHandle(dragCursorRegion);
				short cursorID = GetIsDraggingCursorID();
				if (cursorID != kNoResource)
				{
					CursHandle aCursor = MacGetCursor(cursorID);
					::ThrowIfNULLResource_AC((Handle)aCursor);
					::SetCursor_AC(*aCursor);
				}
				else
					::SetCursorToArrow_AC();

				if (TDragDropSession::fgDragDropSession->UserIsDragging(globalMouse))
				{
					DoGetDragProxy()->HandleDrag(theMouse, event, hysteresis);
					wasHandled = true;
				}
			}
			else
				dragCursorRegion = DisposeIfRgnHandle(dragCursorRegion);
		}
#endif // qDrag

		if (!wasHandled && isFirstClick)
		{
			TWindow * theWindow = GetWindow();
			if (theWindow)
			{
				if (!fHandlesFirstClicks)
					wasHandled = true;
				theWindow->Select();
#if qCarbonEvents
				// Work around process not brought to front by click on Mac OS X
				if (gDispatcher->UseCarbonEvents())
					gDispatcher->MakeFrontProcess();
#endif
	//			gDispatcher->UpdateAllWindows();
				Focus();
			}
		}

		if (!wasHandled && canDoMouse && IsEnabled())
		{
			if (WantsToBeTarget() && !BecomeTarget())
				wasHandled = true;				// don't allow subviews to handle it
			else
			{
				// Give behaviors a chance to handle the mouseDown
				TBehavior * aBehavior = GetFirstEnabledBehavior();
				if (aBehavior)
					wasHandled = aBehavior->DoMouseCommand(tempMouse, event, hysteresis);

				if (!wasHandled && IsEnabled())
				{
					DoMouseCommand(tempMouse, event, hysteresis);
					wasHandled = true;
				}
			}
		}

		if (wasHandled || GetDraggable())
			gDispatcher->InvalidateMouseRegions();
	}

	return wasHandled;
}

//----------------------------------------------------------------------------------------
// TView::HandleMouseUp:
//----------------------------------------------------------------------------------------

bool TView::HandleMouseUp(const CViewPoint& theMouse,
							 TToolboxEvent* event,
							 CPoint_AC hysteresis)
{
	bool wasHandled = false;

	if (HasSubViews())
		for (CSubViewIterator iter(this, kIterateBackward_AC); iter; ++iter)
		{
			CViewPoint subViewPt(iter->SuperViewToLocal(theMouse));

			if (iter->ContainsMouse(subViewPt))
				if (iter->HandleMouseUp(subViewPt, event, hysteresis))
				{
					wasHandled = true;
					break;
				}
		}

	if (!wasHandled && Focus())								// see if we can handle it
	{
		CViewPoint tempMouse(theMouse);				// We do this so we can pass a const to DoMouseCommand

		// Change added to support behaviors
		bool proceed = true;

		TBehavior * aBehavior = GetFirstEnabledBehavior();
		if (aBehavior)
			proceed = !aBehavior->DoMouseUp(tempMouse, event, hysteresis);

		if (proceed && IsEnabled())
		{
			DoMouseUp(tempMouse, event, hysteresis);
			wasHandled = true;
		}
		else
			wasHandled = !proceed;
	}

	return wasHandled;
}

//----------------------------------------------------------------------------------------
// TView::HasPendingUpdate:
//----------------------------------------------------------------------------------------

bool TView::HasPendingUpdate()	// was const
{
	return fSuperView ? fSuperView->HasPendingUpdate() : false;
}

//----------------------------------------------------------------------------------------
// TView::InvalidateVRect:
//----------------------------------------------------------------------------------------

void TView::Invalidate(const CViewRect& badVRect)
{
	Invalidate(ViewToQD(badVRect));
}

//----------------------------------------------------------------------------------------
// TView::InvalidateRect:
//----------------------------------------------------------------------------------------

void TView::Invalidate(const CRect_AC& badRect)
{
#if qMSWindows
	if (GetWindowsWindow())
	{
		RECT rect;
		rect.top = badRect.top;
		rect.left = badRect.left;
		rect.bottom = badRect.bottom;
		rect.right = badRect.right;
		InvalidateRect(GetWindowsWindow(), &rect, false);
	}
#else
	CTempRegion_AC badRectRgn;

	RectRgn(badRectRgn, &badRect);
	Invalidate(badRectRgn);
#endif
}

//----------------------------------------------------------------------------------------
// TView::InvalidateRegion:
//----------------------------------------------------------------------------------------

void TView::Invalidate(const RgnHandle badRgn)
{
	if (Focus())
	{
		CTempRegion_AC visibleBadRgn;

		::RectRgn(visibleBadRgn, ViewToQD(GetVisibleExtent()));
		::SectRgn(badRgn, visibleBadRgn, visibleBadRgn);
		if (!EmptyRgn(visibleBadRgn))
			DoInvalidateRegion(visibleBadRgn);
	}
}

//----------------------------------------------------------------------------------------
// TView::DoInvalidateRegion:
//----------------------------------------------------------------------------------------

void TView::DoInvalidateRegion(const RgnHandle badRgn)
{
	if (fSuperView)
		fSuperView->DoInvalidateRegion(badRgn);	// see if someone knows how
}

//----------------------------------------------------------------------------------------
// TView::IsShown:
//----------------------------------------------------------------------------------------

bool TView::IsShown() const
{
	// Rewritten as single exit code. (It's smaller and faster object code too!)
	bool returnVal = fShown;

	if (!(gDrawingPictScrap && gDrawingPictScrapView == this) && !(TPrintHandler::gCurrPrintHandler && TPrintHandler::gCurrPrintHandler->fView == this) && fSuperView)
		returnVal = returnVal && fSuperView->IsShown();	// A view can't be shown if its superview isn't shown

	return returnVal;
}

//----------------------------------------------------------------------------------------
// TView::IsActive:
//----------------------------------------------------------------------------------------

bool TView::IsActive() const
{
	return fIsActive && fSuperView && fSuperView->IsActive();
}

//----------------------------------------------------------------------------------------
// TView::IsDrawable:
//----------------------------------------------------------------------------------------

bool TView::IsDrawable()
{
	// Rewritten as single exit code. (It's smaller and faster object code too!)
	// also avoid call to GetDrawableQDRect by checking the clipRgn directly.
	bool returnVal = false;

	if (IsShown() && Focus())					// leaves view focused if it is drawable
		returnVal = !EmptyRgn(GetClipRegion());

	return returnVal;
}

//----------------------------------------------------------------------------------------
// TView::IsVisible:
//----------------------------------------------------------------------------------------

bool TView::IsVisible()
{
	bool returnVal = false;

	if (IsShown())
		returnVal = IsFocused() ? !GetVisibleQDRect().Empty() : !GetVisibleExtent().Empty();

	return returnVal;
}

//----------------------------------------------------------------------------------------
// TView::GetEmbeddingControl:
//----------------------------------------------------------------------------------------

const TCtlMgr* TView::GetEmbeddingControl() const
// GetEmbeddingControl scans upward in view hierarchy until it finds the top
// of the hierarchy or a view which wraps a CToolboxControl_AC.  Return the
// TCtlMgr if found otherwise NULL.
//
// Call:		Never.
// Override:	Never.  TCtlMgr overrides this in order to test to see if it
//				wraps a CToolboxControl_AC.
{
	const TCtlMgr*		aToolboxControlView = NULL;
	if (fSuperView)
		aToolboxControlView = fSuperView->GetEmbeddingControl();
	return aToolboxControlView;
}

//----------------------------------------------------------------------------------------
// TView::EmbedControls:
//----------------------------------------------------------------------------------------

void TView::EmbedControls(const TCtlMgr* embeddingView) const
// Allow our subviews to check to see if they should be embedded.
//
// Call:		Never.
// Override:	Never.  TCtlMgr overrides this in order to test to see if it
//				wraps a CToolboxControl_AC and embeds itself if so.
{
	if (HasSubViews())
		for (CSubViewIterator iter(this); iter; ++iter)
			iter->EmbedControls(embeddingView);
}

//----------------------------------------------------------------------------------------
// TView::LocalToSuperView:
//----------------------------------------------------------------------------------------

CViewPoint TView::LocalToSuperView(const CViewPoint& thePoint) const
{
#if !qMSWindows
	return thePoint + GetLocalOffsetInSuper();
#else
	if (!fNeedsOwnWindowsWindow)
		return thePoint + GetLocalOffsetInSuper();
	else
	{
		POINT mappedPoint;
		mappedPoint.x = thePoint.h;
		mappedPoint.y = thePoint.v;
		if (fSuperView == NULL) // assume TWindow, maybe move this code to TWindow
			MapWindowPoints(GetWindowsWindow(), CApplication_AC::fgProcess->fChildClientWindow, &mappedPoint, 1);
		else
			MapWindowPoints(GetWindowsWindow(), fSuperView->GetWindowsWindow(), &mappedPoint, 1);
		CViewPoint result;
		result.h = mappedPoint.x;
		result.v = mappedPoint.y;
		return result;
	}
#endif
}

//----------------------------------------------------------------------------------------
// TView::LocalToSuperView:
//----------------------------------------------------------------------------------------

CViewRect TView::LocalToSuperView(const CViewRect& viewRect) const
{
	return viewRect + GetLocalOffsetInSuper();
}

//----------------------------------------------------------------------------------------
// TView::LocalToSuperView:
//----------------------------------------------------------------------------------------

void TView::LocalToSuperView(RgnHandle theRgn) const
{
	CViewPoint localViewPt(LocalToSuperView(QDToView(gZeroPt)));	// get 0 in View Space

	CPoint_AC superQDPt(fSuperView ? fSuperView->ViewToQD(localViewPt) : localViewPt.ToPoint());

	::MacOffsetRgn(theRgn, superQDPt.h, superQDPt.v);
}

//----------------------------------------------------------------------------------------
// TView::LocalToGlobal:
//----------------------------------------------------------------------------------------

CPoint_AC TView::LocalToGlobal(CPoint_AC thePoint) const
{
#if !qMSWindows
	CPoint_AC returnVal(thePoint);
	::LocalToGlobal(&returnVal);
	return returnVal;
#else
	if (fNeedsOwnWindowsWindow)
	{
		POINT mappedPoint;
		mappedPoint.x = thePoint.h;
		mappedPoint.y = thePoint.v;
		MapWindowPoints(GetWindowsWindow(), CApplication_AC::fgProcess->fChildClientWindow, &mappedPoint, 1);
		CPoint_AC result;
		result.h = mappedPoint.x;
		result.v = mappedPoint.y;
		return result;
	}
	else if (fSuperView)
		return fSuperView->LocalToGlobal(LocalToSuperView(thePoint).ToPoint());
	else
		return thePoint;
#endif
}

//----------------------------------------------------------------------------------------
// TView::LocalToGlobal:
//----------------------------------------------------------------------------------------

CViewPoint TView::LocalToGlobal(const CViewPoint& thePoint) const
{
	return thePoint + CViewPoint(LocalToGlobal(gZeroPt));
}

//----------------------------------------------------------------------------------------
// TView::LocalToGlobal:
//----------------------------------------------------------------------------------------

CViewRect TView::LocalToGlobal(const CViewRect& viewRect) const
{
	return viewRect + CViewPoint(LocalToGlobal(gZeroPt));
}

//----------------------------------------------------------------------------------------
// TView::LocalToGlobal:
//----------------------------------------------------------------------------------------

void TView::LocalToGlobal(RgnHandle theRgn) const
{
	// Note that the intention of this function is to offset the region from _window_
	// coordinates into global coordinates.  It is not necessary to also offset based
	// on the view's offset within the window.
	CPoint_AC globalQDPt(LocalToGlobal(gZeroPt));
	::MacOffsetRgn(theRgn, globalQDPt.h, globalQDPt.v);
}

//----------------------------------------------------------------------------------------
// TView::LocalToWindow:
//----------------------------------------------------------------------------------------

CViewPoint TView::LocalToRootView(const CViewPoint& thePoint) const
{
	return fSuperView ? fSuperView->LocalToRootView(LocalToSuperView(thePoint)) : thePoint;
}

//----------------------------------------------------------------------------------------
// TView::LocalToRootView:
//----------------------------------------------------------------------------------------

CViewRect TView::LocalToRootView(const CViewRect& viewRect) const
{
	return fSuperView ? fSuperView->LocalToRootView(LocalToSuperView(viewRect)) : viewRect;
}

//----------------------------------------------------------------------------------------
// TView::LocalToRootView:
//----------------------------------------------------------------------------------------

void TView::LocalToRootView(RgnHandle theRgn) const
{
	CViewPoint localViewPt(LocalToRootView(QDToView(gZeroPt)));	// get 0 in view space

	TWindow * itsWindow = GetWindow();
	CPoint_AC windowQDPt(itsWindow ? itsWindow->ViewToQD(localViewPt) : localViewPt.ToPoint());

	::MacOffsetRgn(theRgn, windowQDPt.h, windowQDPt.v);
}

//----------------------------------------------------------------------------------------
// TView::InvalidateFrameDifference:
//----------------------------------------------------------------------------------------

void TView::InvalidateFrameDifference(const CViewRect& oldFrame,
									  const CViewRect& newFrame)
{
	if (fSuperView && FocusOnSuperView())
	{
		CRect_AC oldQDFrame(fSuperView->ViewToQD(oldFrame));
		CTempRegion_AC oldFrameRgn;
		RectRgn(oldFrameRgn, &oldQDFrame);

		CRect_AC newQDFrame(fSuperView->ViewToQD(newFrame));
		CTempRegion_AC newFrameRgn;
		RectRgn(newFrameRgn, &newQDFrame);

		// If it didn't move then only the size difference is invalid if the view
		// doesn't have contents proportional to its size. Otherwise both the regions
		// are invalid
		if (oldFrame[topLeft] == newFrame[topLeft])
			::MacXorRgn(oldFrameRgn, newFrameRgn, newFrameRgn);
		else
			::MacUnionRgn(oldFrameRgn, newFrameRgn, newFrameRgn);

		fSuperView->Invalidate(newFrameRgn);
	}
}

//----------------------------------------------------------------------------------------
// TView::SetFrame:
//----------------------------------------------------------------------------------------

void TView::SetFrame(const CViewRect& newFrame,
					 bool invalidate)
// SetFrame is intended to set this view’s extent(boundaries) to the specified
// rectangle. TView::SetFrame sets the new extent, updates its coordinates, and
// invalidates the help region, cursor region, and its superview’s region. It also
// notifies its adorners, subviews, and superview that the frame has changed.
//
// newFrame:	Specifies the size and location of the frame, in this coordinate
//				system of this view’s superview.
// invalidate:	True if this view must be redrawn as part of this operation.
//
// Call?		Seldom. Call your view’s Locate or Resize method
//				instead.
// Override?	Seldom. MacApp provides an override method for
//				windows.
{
	CViewRect oldFrame(GetFrame());

	if (newFrame != oldFrame)
	{
		// update the frame stored in the view
		fLocation = newFrame[topLeft];
		fSize = newFrame.GetSize();

		InvalidateFocus();						// Must re-focus because frame changed
		InvalidateCoordinates();				// Re-calc all the offsets

		gDispatcher->InvalidateMouseRegions();	// Must re-calc cursor and help regions

#if qMSWindows
		if ((fWindowsWindow != NULL) && (fSuperView != NULL))
		{
			short int xOrigin = 0;
			short int yOrigin = 0;
			if (fSuperView != NULL)
			{
				HWND view = fSuperView->GetWindowsWindow();
				if (view != NULL)
			    {
					xOrigin = GetScrollPos(view,SB_HORZ);
					yOrigin = GetScrollPos(view,SB_VERT);
				}
			}
			MoveWindow(	fWindowsWindow,
						fLocation.h - xOrigin,
						fLocation.v - yOrigin,
						fSize.h,
						fSize.v,
						invalidate);
		}
#endif

		if (invalidate)
		{
			switch (fFrameInvalidateDeterminer)
			{
				case frameInvalidateDifference:
					InvalidateFrameDifference(oldFrame, newFrame);
					break;
				case frameInvalidateWholeFrame:
					InvalidateFrameDifference(oldFrame, newFrame);
					ForceRedraw();
					break;
				default:
#if qDebug
					::ProgramBreak_AC("This view has an invalid frameInvalidateDeterminer (is the view corrupt or deleted?)");
#endif
					;
			}
		}

		// • Let my adorners know that my frame changed
		NotifyAdornersOfFrameChange(oldFrame, newFrame, invalidate);

		// • Let my superview know that my frame changed
		if (fSuperView)
			fSuperView->SubViewChangedFrame(this, oldFrame, newFrame, invalidate);

		// • Let my subviews know that my frame changed
		NotifySubViewsOfFrameChange(oldFrame, newFrame, invalidate);

		// Let other interested items know about my frame change.
		Changed(mFrameChanged,this);
	}
}

//----------------------------------------------------------------------------------------
// TView::NotifyAdornersOfFrameChange:
//----------------------------------------------------------------------------------------

void TView::NotifyAdornersOfFrameChange(const CViewRect& oldFrame,
										const CViewRect& newFrame,
										bool invalidate)
{
	if (fAdorners && Focus())
		for (CAdornerIterator iter(this); iter.Current(); ++iter)
			iter->ViewChangedFrame(this, oldFrame, newFrame, invalidate);
}

//----------------------------------------------------------------------------------------
// TView::NotifySubViewsOfFrameChange:
//----------------------------------------------------------------------------------------

void TView::NotifySubViewsOfFrameChange(const CViewRect& oldFrame,
										const CViewRect& newFrame,
										bool invalidate)
{
	if (HasSubViews())
		for (CSubViewIterator iter(this); iter; ++iter)
			iter->SuperViewChangedFrame(oldFrame, newFrame, invalidate);
}

//----------------------------------------------------------------------------------------
// TView::Locate:
//----------------------------------------------------------------------------------------

void TView::Locate(const CViewPoint& newLoc,
				   bool invalidate)
{
	SetFrame(CViewRect(newLoc, newLoc + fSize), invalidate);
}

//----------------------------------------------------------------------------------------
// TView::MakeFirstSubView:
//----------------------------------------------------------------------------------------

void TView::MakeFirstSubView(TView* theSubView)
{
	DeleteSubView(theSubView);
	InsertSubView(theSubView, kInsertSubViewFirst);
}

//----------------------------------------------------------------------------------------
// TView::MakeLastSubView:
//----------------------------------------------------------------------------------------

void TView::MakeLastSubView(TView* theSubView)
{
	DeleteSubView(theSubView);
	InsertSubView(theSubView);
}

//----------------------------------------------------------------------------------------
// TView::Open:
//----------------------------------------------------------------------------------------

void TView::Open()
{
#if qMSWindows
	if (fShown)
	{
		if (fNeedsOwnWindowsWindow)
		{
			if (GetWindowsWindow() == NULL)
				CreateWindowsWindow();
			ShowWindow(GetWindowsWindow(), SW_SHOW);
		}
	}
#endif

	if (HasSubViews())
		for (CSubViewIterator iter(this); iter; ++iter)
			iter->Open();
}

//----------------------------------------------------------------------------------------
// TView::PageInteriorChanged:
//----------------------------------------------------------------------------------------

void TView::PageInteriorChanged(const CViewRect& newInterior)
{
	#pragma unused (newInterior)
}

//----------------------------------------------------------------------------------------
// TView::RevealUndoRedo:
//----------------------------------------------------------------------------------------

void TView::RevealUndoRedo(TCommand* command)
{
	TEventHandler::RevealUndoRedo(command);
	ScrollSelectionIntoView(kRedraw);

	TWindow * window = GetWindow();
	if (window)
		window->Select();
}

//----------------------------------------------------------------------------------------
// TView::QDToView:
//----------------------------------------------------------------------------------------

CViewPoint TView::QDToView(CPoint_AC qdPoint) const
{
	return CViewPoint(qdPoint) + GetViewToQDOffset();
}

//----------------------------------------------------------------------------------------
// TView::QDToView:
//----------------------------------------------------------------------------------------

CViewRect TView::QDToView(const CRect_AC& qdRect) const
{
	return CViewRect(qdRect) + GetViewToQDOffset();
}

//----------------------------------------------------------------------------------------
// TView::RemovedASubView:
//----------------------------------------------------------------------------------------

void TView::RemovedASubView(TView* theSubView)
{
	if (fSuperView)
		fSuperView->RemovedASubView(theSubView);
}

//----------------------------------------------------------------------------------------
// TView::RemoveSubView:
//----------------------------------------------------------------------------------------

void TView::RemoveSubView(TView* theSubView)
{
	DeleteSubView(theSubView);

	RemovedASubView(theSubView);
	theSubView->BeInSuperView(NULL);
	//theSubView->RemoveFromDocument();	// •••  back out fix for [1338821]
}

//----------------------------------------------------------------------------------------
// TView::Resize:
//----------------------------------------------------------------------------------------

void TView::Resize(const CViewPoint& newSize, bool invalidate)
{
	SetFrame(CViewRect(fLocation, fLocation + newSize), invalidate);
}

//----------------------------------------------------------------------------------------
// TView::RestrictRegionToVisible:
//----------------------------------------------------------------------------------------

void TView::RestrictRegionToVisible(RgnHandle aRegion)
{
#if qDebug
	AssumeFocused();
#endif

	CRect_AC itsVisibleExtent(ViewToQD(GetVisibleExtent()));

	CTempRegion_AC visibleExtentRgn;

	RectRgn(visibleExtentRgn, &itsVisibleExtent);
	SectRgn(aRegion, visibleExtentRgn, aRegion);

	// Intersect with visible region
	SectRgn(GetWindow()->GetVisRegion(), aRegion, aRegion);

	// Don't further restrict to clip region, it may have accumulated invalidated views
	// and if it did, we won't correctly set the cursor.
	// SectRgn(GetClipRegion(qd.thePort), aRegion, aRegion);
}

//----------------------------------------------------------------------------------------
// TView::RevealBottom:
//----------------------------------------------------------------------------------------

void TView::RevealBottom(bool redraw)
{
	RevealRect(CViewRect(fSize, fSize), gZeroVPt, redraw);
}

//----------------------------------------------------------------------------------------
// TView::RevealRect:
//----------------------------------------------------------------------------------------

void TView::RevealRect(const CViewRect& rectToReveal,
					   const CViewPoint& minToSee,
					   bool redraw)
{
	if (fSuperView)
		fSuperView->RevealRect(LocalToSuperView(rectToReveal), minToSee, redraw);
}

//----------------------------------------------------------------------------------------
// TView::RevealTop:
//----------------------------------------------------------------------------------------

void TView::RevealTop(bool redraw)
{
	RevealRect(gZeroVRect, gZeroVPt, redraw);
}

//----------------------------------------------------------------------------------------
// TView::Show:
//----------------------------------------------------------------------------------------

void TView::Show(bool state, bool redraw)
{
#if qMSWindows
	if (fNeedsOwnWindowsWindow)
	{
		if (GetWindowsWindow() == NULL)
			CreateWindowsWindow();
		fShown = state;
		if (fShown)
			::ShowWindow(GetWindowsWindow(), SW_SHOW);
		else
			::ShowWindow(GetWindowsWindow(), SW_HIDE);
	}
	else
#endif
	if (state != fShown)
	{
		if (redraw)
		{
			fShown = true;						// So that ForceRedraw works.
			ForceRedraw();
		}
		InvalidateFocus();
		gDispatcher->InvalidateMouseRegions();	// Must re-calc cursor and help regions
		fShown = state;
	}
}

//----------------------------------------------------------------------------------------
// TView::ShowReverted:
//----------------------------------------------------------------------------------------

void TView::ShowReverted()
{
	AdjustFrame();
	ForceRedraw();

	if (HasSubViews())
		for (CSubViewIterator iter(this); iter; ++iter)
			iter->ShowReverted();
}

//----------------------------------------------------------------------------------------
// TView::SubViewChangedFrame:
//----------------------------------------------------------------------------------------

void TView::SubViewChangedFrame(TView*				theSubView,
								const CViewRect&	oldFrame,
								const CViewRect&	newFrame,
								bool				invalidate)
{
	#pragma unused (theSubView, oldFrame, newFrame, invalidate)
	// Just a warning. If you override this method to change your frame based on your
	// subview changing its frame you will need to be careful if your subviews have size
	// determiners of sizeRelSuperView. If you do, you will find yourself in an infinite
	// loop. For an sample solution look at TIncludeView::SubViewChangedFrame. Essentially
	// you have to be careful not to renotify your subviews that your frame has changed
	// since you are probably changing your frame because they changed theirs. I think you
	// get the picture.
}

//----------------------------------------------------------------------------------------
// TView::SuperViewToLocal:
//----------------------------------------------------------------------------------------

CViewPoint TView::SuperViewToLocal(const CViewPoint& thePoint) const
{
#if !qMSWindows
	return thePoint - GetLocalOffsetInSuper();
#else
	if (!fNeedsOwnWindowsWindow)
		return thePoint - GetLocalOffsetInSuper();
	else
	{
		POINT mappedPoint;
		mappedPoint.x = thePoint.h;
		mappedPoint.y = thePoint.v;
		if (fSuperView == NULL) // assume TWindow, maybe move this code to TWindow
			MapWindowPoints(CApplication_AC::fgProcess->fChildClientWindow, GetWindowsWindow(), &mappedPoint, 1);
		else
			MapWindowPoints(fSuperView->GetWindowsWindow(), GetWindowsWindow(), &mappedPoint, 1);
		CViewPoint result;
		result.h = mappedPoint.x;
		result.v = mappedPoint.y;
		return result;
	}
#endif
}

//----------------------------------------------------------------------------------------
// TView::SuperViewToLocal:
//----------------------------------------------------------------------------------------

CViewRect TView::SuperViewToLocal(const CViewRect& viewRect) const
{
	return viewRect - GetLocalOffsetInSuper();
}

//----------------------------------------------------------------------------------------
// TView::SuperViewToLocal:
//----------------------------------------------------------------------------------------

void TView::SuperViewToLocal(RgnHandle theRgn) const
{
	CViewPoint localViewPt(LocalToSuperView(QDToView(gZeroPt)));	// get 0 in View Space

	CPoint_AC superQDPt(fSuperView ? fSuperView->ViewToQD(localViewPt) : localViewPt.ToPoint());

	::MacOffsetRgn(theRgn, -superQDPt.h, -superQDPt.v);
}

//----------------------------------------------------------------------------------------
// TView::SuperViewChangedFrame:
//----------------------------------------------------------------------------------------

void TView::SuperViewChangedFrame(const CViewRect& oldFrame,
								  const CViewRect& newFrame,
								  bool invalidate)
{
	if (oldFrame != newFrame)
	{
		CViewRect itsOldFrame(GetFrame());
		CViewRect itsNewFrame(itsOldFrame);

		for (VHSelect vhs = vSel; vhs <= hSel; ++vhs)
		{
			// •••  location determiners
			if (GetLocationDeterminer(vhs) == sizeRelSuperView)
			{
				// need to capture the amount of change in the superview here for use
				// in ComputeFrame
				itsNewFrame[topLeft][vhs] += newFrame.GetSize()[vhs] - oldFrame.GetSize()[vhs];
			}
			// •••  location determiners

			if (GetSizeDeterminer(vhs) == sizeRelSuperView)
			{
				// need to capture the amount of change in the superview here for use
				// in ComputeFrame
				itsNewFrame[botRight][vhs] += newFrame.GetSize()[vhs] - oldFrame.GetSize()[vhs];
			}
		}

		ComputeFrame(itsNewFrame);
		if (itsOldFrame != itsNewFrame)
		{
			SetFrame(itsNewFrame, invalidate);
			DoPagination();
		}
	}
}

//----------------------------------------------------------------------------------------
// TView::IsDoneTracking:
//----------------------------------------------------------------------------------------

bool TView::IsDoneTracking()
{
	// Default to mouse-down tracking
	return !StillDown();
}

//----------------------------------------------------------------------------------------
// TView::TrackConstrain:
//----------------------------------------------------------------------------------------

void TView::TrackConstrain(TrackPhase			aTrackPhase,
						   const CViewPoint&	anchorPoint,
						   const CViewPoint&	previousPoint,
						   CViewPoint&			nextPoint,
						   bool					mouseDidMove)
{
	#pragma unused (aTrackPhase, anchorPoint, previousPoint, nextPoint, mouseDidMove)
}

//----------------------------------------------------------------------------------------
// TView::TrackFeedback:
//----------------------------------------------------------------------------------------

void TView::TrackFeedback(TrackPhase			aTrackPhase,
						  const CViewPoint&		anchorPoint,
						  const CViewPoint&		previousPoint,
						  const CViewPoint&		nextPoint,
						  bool					mouseDidMove,
						  bool					turnItOn)

// Use code like this to get a flickering rectangle.
{
	#pragma unused (aTrackPhase, previousPoint, turnItOn)

	if (mouseDidMove)
	{
		CViewRect vr(anchorPoint, nextPoint);
		vr.Validate();

		CPattern_AC::SetPenPatToGray();
		::MacFrameRect(ViewToQD(vr));
	}
}

//----------------------------------------------------------------------------------------
// TView::TrackMouse:
//----------------------------------------------------------------------------------------

void TView::TrackMouse(TrackPhase	aTrackPhase,
					   CViewPoint&	anchorPoint,
					   CViewPoint&	previousPoint,
					   CViewPoint&	nextPoint,
					   bool			mouseDidMove)
{
	#pragma unused (aTrackPhase, anchorPoint, previousPoint, nextPoint, mouseDidMove)
}

//----------------------------------------------------------------------------------------
// TView::Update:
//----------------------------------------------------------------------------------------

void TView::Update()
{
#if qMSWindows
	if (fNeedsOwnWindowsWindow)
		UpdateWindow(GetWindowsWindow());
	else
#endif
	if (fSuperView)
		fSuperView->Update();
	else
		DrawContents();
}

//----------------------------------------------------------------------------------------
// TView::GetValidationError:
//----------------------------------------------------------------------------------------

long TView::GetValidationError()
{
	return noErr;
}

//----------------------------------------------------------------------------------------
// TView::IsValid:
//----------------------------------------------------------------------------------------

bool TView::IsValid()
{
	bool returnVal = true;

	long result = GetValidationError();
	if (result != noErr)
	{
		ValidationFailed(result);
		returnVal = false;
	}

	return returnVal;
}

//----------------------------------------------------------------------------------------
// TView::ValidationFailed:
//----------------------------------------------------------------------------------------

void TView::ValidationFailed(long reason)
{
	#pragma unused (reason)
}

//----------------------------------------------------------------------------------------
// TView::IsHierarchyValid:
//----------------------------------------------------------------------------------------

bool TView::IsHierarchyValid()
{
	bool result = IsValid();

	if (result && HasSubViews())
		for (CSubViewIterator iter(this); iter; ++iter)
		{
			result = iter->IsHierarchyValid();
			if (!result)
				break;
		}

	return result;
}

//----------------------------------------------------------------------------------------
// TView::Validate:
//----------------------------------------------------------------------------------------

void TView::Validate(const CViewRect& goodVRect)
{
	Validate(ViewToQD(goodVRect));
}

//----------------------------------------------------------------------------------------
// TView::Validate:
//----------------------------------------------------------------------------------------

void TView::Validate(const CRect_AC& goodRect)
{
#if qMSWindows
	if (GetWindowsWindow())
	{
		RECT rect;
		rect.top = goodRect.top;
		rect.left = goodRect.left;
		rect.bottom = goodRect.bottom;
		rect.right = goodRect.right;
		ValidateRect(GetWindowsWindow(), &rect);
	}
#else
	CTempRegion_AC goodRectRgn;

	RectRgn(goodRectRgn, &goodRect);
	Validate(goodRectRgn);
#endif
}

//----------------------------------------------------------------------------------------
// TView::Validate:
//----------------------------------------------------------------------------------------

void TView::Validate(const RgnHandle goodRgn)
{
	if (Focus())
	{
		CTempRegion_AC visibleGoodRgn;

		::RectRgn(visibleGoodRgn, ViewToQD(GetVisibleExtent()));
		::SectRgn(goodRgn, visibleGoodRgn, visibleGoodRgn);
		if (!EmptyRgn(visibleGoodRgn))
			DoValidateRegion(visibleGoodRgn);
	}
}

//----------------------------------------------------------------------------------------
// TView::DoValidateRegion:
//----------------------------------------------------------------------------------------

void TView::DoValidateRegion(const RgnHandle goodRgn)
{
	if (fSuperView)
		fSuperView->DoValidateRegion(goodRgn);	// see if someone knows how
}

//----------------------------------------------------------------------------------------
// TView::ViewEnable:
//----------------------------------------------------------------------------------------

void TView::ViewEnable(bool state, bool redraw)
{
	SetEnable(state);

	if (redraw)
		ForceRedraw();
}

//----------------------------------------------------------------------------------------
// TView::ViewToQD:
//----------------------------------------------------------------------------------------

CPoint_AC TView::ViewToQD(const CViewPoint& viewPt) const
{
	return (viewPt - GetViewToQDOffset()).ToPoint();
}

//----------------------------------------------------------------------------------------
// TView::ViewToQD:
//----------------------------------------------------------------------------------------

CRect_AC TView::ViewToQD(const CViewRect& viewRect) const
{
	return (viewRect - GetViewToQDOffset()).ToRect();
}

//----------------------------------------------------------------------------------------
// TView::WindowToLocal:
//----------------------------------------------------------------------------------------

CViewPoint TView::RootViewToLocal(const CViewPoint& thePoint) const
{
	return fSuperView ? SuperViewToLocal(fSuperView->RootViewToLocal(thePoint)) : thePoint;
}

//----------------------------------------------------------------------------------------
// TView::RootViewToLocal:
//----------------------------------------------------------------------------------------

CViewRect TView::RootViewToLocal(const CViewRect& viewRect) const
{
	return fSuperView ? SuperViewToLocal(fSuperView->RootViewToLocal(viewRect)) : viewRect;
}

//----------------------------------------------------------------------------------------
// TView::RootViewToLocal:
//----------------------------------------------------------------------------------------

void TView::RootViewToLocal(RgnHandle theRgn) const
{
	if (fSuperView)
	{
		fSuperView->RootViewToLocal(theRgn);
		SuperViewToLocal(theRgn);
	}
}

//----------------------------------------------------------------------------------------
// TView::AsPict:
//----------------------------------------------------------------------------------------

PicHandle TView::AsPict()
// AsPict returns a picture frame of this view and its subviews.
// For example, MacApp calls AsPict to build the bit image that it writes
// to the desk scrap. See the QuickDraw chapter of “Inside Macintosh,” Volume I,
// for more information about pictures and picture frames.
//
// Call?		As needed.
// Override?	Seldom.
{
	GrafPtr savedPort;
	GetPort(&savedPort);
	PicHandle pHndl = NULL;
	bool pictureIsOpen = false;

	//CRect_AC aRect(savedPort->portRect);
	CRect_AC aRect(GetPortRect_AC(savedPort));

#if !qCarbon
	CRect_AC oldPortFrame = gWorkPort->portRect;
	::MacSetPort(gWorkPort);
#else
	CRect_AC oldPortFrame(GetPortRect_AC(gWorkCPort));
	::MacSetPort(gWorkCPort);
#endif
	PortSize(aRect.GetLength(hSel), aRect.GetLength(vSel));
	MovePortTo(aRect.left, aRect.top);

	InvalidateFocus();
	gDrawingPictScrap = true;
	gDrawingPictScrapView = this;
#if !qCarbon
	::MacSetPort(gWorkPort);
	BeInPort((GrafPtr)GetWindowPort(gWorkPort));
#else
	::MacSetPort(gWorkCPort);
	BeInPort(gWorkCPort);
#endif

	try
	{
		if (Focus())
		{
			//Open new or old style, depending on QD
			CRect_AC qdExtent(GetQDExtent());

			OpenCPicParams picParms;
			picParms.srcRect = qdExtent;
			picParms.hRes = 0x00480000;
			picParms.vRes = 0x00480000;
			picParms.version = -2;
			picParms.reserved1 = 0;
			picParms.reserved2 = 0;
			pHndl = OpenCPicture(&picParms);

			pictureIsOpen = true;				// Failure handler needs to close it
			::ThrowIfNULL_AC(pHndl);

			::ClipRect(&qdExtent);
			DrawContents();

			ClosePicture();
			pictureIsOpen = false;				// Failure handler doesn't need to close it

			//  On the 128K ROMs the picFrame will be empty if drawing the
			// picture failed.
			if (((CRect_AC &)(*pHndl)->picFrame).Empty())
			{
#if qDebug
				ProgramReport_AC("Picture frame is empty!\n");
#endif

				::ThrowIfOSErr_AC(memFullErr);
			}

			InvalidateFocus();
		}
#if qDebug
		else									// can't focus
			::ProgramBreak_AC("Can't focus view while writing picture");
#endif
	}
	catch(CException_AC& theException)
	{
		DoCatchMessage_AC(theException);

		if (pHndl)
		{
			if (pictureIsOpen)
				ClosePicture();
			pHndl = DisposeIfPicHandle(pHndl);
		}

		PortSize(oldPortFrame.GetLength(hSel), oldPortFrame.GetLength(vSel));
		MovePortTo(oldPortFrame.right, oldPortFrame.top);

		gDrawingPictScrap = false;
		gDrawingPictScrapView = NULL;
		//SetPortWindowPort(savedPort);
		SetPortWindowPort(GetWindowFromPort_AC(savedPort));	// Carbonized
		BeInPort(savedPort);
		throw;
	}

	PortSize(oldPortFrame.GetLength(hSel), oldPortFrame.GetLength(vSel));
	MovePortTo(oldPortFrame.right, oldPortFrame.top);

	gDrawingPictScrap = false;
	gDrawingPictScrapView = NULL;
	//SetPortWindowPort(savedPort);
	SetPortWindowPort(GetWindowFromPort_AC(savedPort));	// Carbonized
	BeInPort(savedPort);

	return pHndl;
}

//----------------------------------------------------------------------------------------
// TView::WriteToDeskScrap:
//----------------------------------------------------------------------------------------

void TView::WriteToDeskScrap()
{
	PicHandle pHndl = NULL;

	try
	{
			pHndl = AsPict();
			::ThrowIfNULL_AC(pHndl);

			gClipboardMgr->PutDeskScrapData(kPictType_AC, (Handle)pHndl);

			pHndl = DisposeIfPicHandle(pHndl);		// dispose of picture created by AsPict
			// so failure handler doesn't to kill it
	}
	catch(CException_AC& theException)
	{
		DoCatchMessage_AC(theException);

		if (pHndl && !qCarbon)
		{
#if qDebug
			::ProgramBreak_AC("Failed to put PICT-type scrap");
#endif

			pHndl = DisposeIfPicHandle(pHndl);
		}
		throw;
	}

}

//----------------------------------------------------------------------------------------
// TView::GoAwayByUser:
//----------------------------------------------------------------------------------------

void TView::GoAwayByUser(const CViewPoint& theMouse)
{
	#pragma unused (theMouse)
}

//----------------------------------------------------------------------------------------
// TView::MoveByUser:
//----------------------------------------------------------------------------------------

void TView::MoveByUser(const CViewPoint& theMouse)
{
	#pragma unused (theMouse)
}

//----------------------------------------------------------------------------------------
// TView::ResizeByUser:
//----------------------------------------------------------------------------------------

void TView::ResizeByUser(const CViewPoint& theMouse)
{
	#pragma unused (theMouse)
}

//----------------------------------------------------------------------------------------
// TView::SetHLPenState:
//----------------------------------------------------------------------------------------

void TView::SetHLPenState(HLState fromHL, HLState toHL)
{
	short mode = patXor;						// every transition except hlOn <-> hlDim uses patXOR

	const Pattern* pPat = NULL;

	if (fromHL + toHL == hlOffOn)
		pPat = CPattern_AC::Black();
	else if (fromHL != toHL)
		pPat = CPattern_AC::Gray();

	if (fromHL + toHL == hlDimOn)
		mode = notPatXor;

	PenMode(mode);

	if(pPat)
		PenPat(pPat);
#if qDebugMsg
	else
		ProgramReport_AC("TView::SetHLPenState: Attempting to PenPat(NULL).");
#endif
}

//----------------------------------------------------------------------------------------
// TView::UpdateCoordinates:
//----------------------------------------------------------------------------------------

void TView::UpdateCoordinates() const
{
	const short kMaxOriginFixup = 1024;			// The maximum amount by which to _fixup_
	// (not offset) the QD origin when
	// focusing. This allows patterns and
	// pixpats to be pinned to global space as
	// they were intended. See note below.
	// Larger values than this may be required
	// for _extremely_ complex pixpats (not
	// patterns as they are restricted to 8
	// bit repetition.) The reason that the
	// fixup is restricted is that you don't
	// want to run off the end of QD space and
	// we already have slop allowance of about
	// 2k in ViewCoords.p.

	// we can't update our coordinates until our superview updates theirs
	// however once a views coordinates are valid we don't have to walk up
	// the tree any further.
	if (fCoordinatesAreInvalid)
	{
#if qMSWindows
		if (fNeedsOwnWindowsWindow)
		{
			TView* mutableThis = const_cast<TView*>(this);
			mutableThis->fQDOrigin = CPoint_AC(0,0);
			mutableThis->fViewToQDOffset = CViewPoint(0,0);
			mutableThis->fVisibleExtent = GetExtent();
		}
		else
#endif
		if (fSuperView)
			fSuperView->UpdateCoordinates();

		TView*			nonConstThis = const_cast<TView*>(this);

		if (fSuperView || (TPrintHandler::gCurrPrintHandler && (TPrintHandler::gCurrPrintHandler->fView == this)))
		{
			// First calculate and setup the new origins.
			// But first a word about this approach. (thanks Keith Rollins!) Problems with
			// pattern alignment when using 32bit views occur when virtual origin of the port
			// has coordinates that are not multiples of 8. This can occur if, for example,
			// you scroll a view by increments of other than 8, 16, or other multiple of 8.
			// The solution is to appropriately set the origin so that patterns are drawn
			// correctly aligned. This can be done by making sure that we set the origin to
			// some value that will cause QuickDraw to perform in exactly the same way as if
			// the origin were really at the value specified by fViewToQDOffset. Since classic
			// QuickDraw patterns repeat after 8 pixels, we can accomplish this task by making
			// sure that fViewToQDOffset is a multiple of 8, and setting the origin to
			// compensate by setting it to fViewToQDOffset % 8.
			// Unfortunately, this will only work for classic QuickDraw patterns that repeat
			// after 8 pixels. With PixPats, this period can be any power of 2. In order to
			// support them, we have to make sure that fViewToQDOffset must be only a multiple
			// of whatever power of 2 is being used. Ideally, therefore, we could like to make
			// the chunkiness of fViewToQDOffset to be as large as possible. On the other
			// hand, we can't make it too large, or else the amount by which we offset the
			// origin in TView.Focus may overflow QuickDraw's limits. Probably a value of 1024
			// or 2048 should be sufficient enough to accomodate the largest of PixPats a
			// developer may use, and still be small enough that we shouldn't overflow
			// QuickDraw.
			CViewPoint localOriginInSuper(GetLocalOffsetInSuper());

			CViewPoint actualViewToQDOffset;
			if (TPrintHandler::gCurrPrintHandler && (TPrintHandler::gCurrPrintHandler->fView == this))
				actualViewToQDOffset = TPrintHandler::gCurrPrintHandler->GetViewToQDOffset() + CViewPoint(TPrintHandler::gCurrPrintHandler->GetQDOrigin());
			else
				actualViewToQDOffset = fSuperView->fViewToQDOffset + CViewPoint(fSuperView->fQDOrigin) - localOriginInSuper;

			nonConstThis->fViewToQDOffset = actualViewToQDOffset;// to allow testing of the Extent
			if (CViewRect(-kMaxQDCoord, -kMaxQDCoord, kMaxQDCoord, kMaxQDCoord).Contains(GetExtent()))
			{
				nonConstThis->fQDOrigin = actualViewToQDOffset.ToPoint();
				nonConstThis->fViewToQDOffset.Clear();
			}
			else
			{
				CPoint_AC deltaOrigin(static_cast<short>(actualViewToQDOffset.h % kMaxOriginFixup), static_cast<short>(actualViewToQDOffset.v % kMaxOriginFixup));
				nonConstThis->fViewToQDOffset = actualViewToQDOffset - CViewPoint(deltaOrigin);
				nonConstThis->fQDOrigin = deltaOrigin;
			}

			// Update my visible extent by intersecting my extent with my superview's visible extent

			// When printing, or drawing the scrap, the grafPort is supplied.
			if ((gDrawingPictScrapView == this) || (TPrintHandler::gCurrPrintHandler && TPrintHandler::gCurrPrintHandler->fView == this))
				nonConstThis->fVisibleExtent = GetExtent();
			else
				nonConstThis->fVisibleExtent = SuperViewToLocal(GetFrame() & fSuperView->GetVisibleExtent());
		}
		else
		{
			nonConstThis->fViewToQDOffset.Clear();
			nonConstThis->fQDOrigin.Clear();

			nonConstThis->fVisibleExtent = GetExtent();
		}

		nonConstThis->fCoordinatesAreInvalid = false;
	}

}

//----------------------------------------------------------------------------------------
// TView::InvalidateCoordinates:
//----------------------------------------------------------------------------------------
void TView::InvalidateCoordinates()
{
	if (!fCoordinatesAreInvalid)
	{
		fCoordinatesAreInvalid = true;

		for (CSubViewIterator iter(this); iter; ++iter)
			iter->InvalidateCoordinates();
	}
}

//----------------------------------------------------------------------------------------
// TView::GetVisibleExtent:
//----------------------------------------------------------------------------------------
CViewRect TView::GetVisibleExtent() const
{
	if (fCoordinatesAreInvalid)
		UpdateCoordinates();

	return fVisibleExtent;
}

//----------------------------------------------------------------------------------------
// TView::GetQDOrigin:
//----------------------------------------------------------------------------------------
CPoint_AC TView::GetQDOrigin() const
{
	if (fCoordinatesAreInvalid)
		UpdateCoordinates();

	return fQDOrigin;
}

//----------------------------------------------------------------------------------------
// TView::GetViewToQDOffset:
//----------------------------------------------------------------------------------------
CViewPoint TView::GetViewToQDOffset() const
{
	if (fCoordinatesAreInvalid)
		UpdateCoordinates();

	return fViewToQDOffset;
}

//----------------------------------------------------------------------------------------
// TView::IsOpaque:
//----------------------------------------------------------------------------------------
bool TView::IsOpaque() const
{
	bool returnVal = fIsOpaque;

	if (!returnVal && fAdorners)
		for (CAdornerIterator iter(this); iter.Current(); ++iter)
			if (iter->DoesAdorn(this) && iter->IsOpaque())
			{
				returnVal = true;
				break;
			}

	return returnVal;
}

//----------------------------------------------------------------------------------------
// TView::ClipOpaqueSubViews:
//----------------------------------------------------------------------------------------

bool TView::ClipOpaqueSubViews(RgnHandle rRgn)
{
	bool returnVal = false;

#if qOpaqueViews
	if (IsVisible() && HasSubViews() && !::EmptyRgn(rRgn))
	{
	#if qDebug
		AssumeFocused();
	#endif

		// We won't claim subviews' territory
		bool rgnHandleWasTooBig = false;
		CTempRegion_AC subViewFrameRgn;
		CViewRect myVisExtent(GetVisibleExtent());

		for (CSubViewIterator iter(this); iter; ++iter)
		{
			if (!rgnHandleWasTooBig && iter->IsVisible() && !CViewRect(myVisExtent & iter->GetFrame()).Empty())
			{
				if (iter->IsOpaque())
				{
					iter->GetExtentRegion(subViewFrameRgn);	// Remember, the frame is in OUR
															// coordinate system
					iter->LocalToSuperView(subViewFrameRgn);
					::DiffRgn(rRgn, subViewFrameRgn, rRgn);// Remove the subview from the claimed rgn
					returnVal = true;	// did modify region

					if ((GetHandleSize((Handle)rRgn) > kRgnHandleTooBig) || (MemError() != noErr))
					{
						rgnHandleWasTooBig = true;
						break; // can't do any more after this due to size of resulting region
					}
				}
				else
				{
					// Transparent subview may have opaque subviews
					iter->Focus();
					CViewPoint offset(GetLocalOffsetInSuper());
					::MacOffsetRgn(rRgn, -offset.h, -offset.v);
					if (iter->ClipOpaqueSubViews(rRgn))
						returnVal = true;
					::MacOffsetRgn(rRgn, offset.h, offset.v);
					Focus();
				}
			}
		}
	}
#else
	#pragma unused (rRgn)
#endif

	return returnVal;
}

//----------------------------------------------------------------------------------------
// TView::ClipOpaqueSiblingViews:
//----------------------------------------------------------------------------------------

bool TView::ClipOpaqueSiblingViews(RgnHandle rRgn)
{
	bool returnVal = false;

#if qOpaqueViews
	TView*		iter = fNextView;

	if (iter && !::EmptyRgn(rRgn))
	{

#if qDebug
		AssumeFocused();
#endif

		// We won't claim sibling's territory
		bool rgnHandleWasTooBig = false;
		CTempRegion_AC sibViewFrameRgn;
		CViewRect myVisFrame(LocalToSuperView(GetVisibleExtent()));

		while (iter)
		{
			if (!rgnHandleWasTooBig
				&& iter != this
				&& iter->IsVisible()
				&& iter->IsOpaque()
				&& !CViewRect(myVisFrame & iter->GetFrame()).Empty())
			{
				iter->GetExtentRegion(sibViewFrameRgn);// Remember, the frame is in OUR superview coordinate system
				iter->LocalToSuperView(sibViewFrameRgn);
				SuperViewToLocal(sibViewFrameRgn);
				::DiffRgn(rRgn, sibViewFrameRgn, rRgn);// Remove the subview from the claimed rgn
				returnVal = true;	// did modify region

				if ((GetHandleSize((Handle)rRgn) > kRgnHandleTooBig) || (MemError() != noErr))
				{
					rgnHandleWasTooBig = true;
					break; // can't do any more after this due to size of resulting region
				}
			}
			iter = iter->fNextView;
		}
	}
#else
	#pragma unused (rRgn)
#endif

	return returnVal;
}

//----------------------------------------------------------------------------------------
// TView::ZoomByUser:
//----------------------------------------------------------------------------------------

void TView::ZoomByUser(const CViewPoint& theMouse, short partCode)
{
	#pragma unused (theMouse, partCode)
}

//------------------------------------------------------------------------------------
// Drag and Drop Methods
//------------------------------------------------------------------------------------

#if qDrag

//----------------------------------------------------------------------------------------
// TView::SetDroppable:
//----------------------------------------------------------------------------------------

void TView::SetDroppable(bool isDroppable)
{
	if (HasDragManager_AC())
	{
		TWindow * itsWindow = GetWindow();
		if (isDroppable != fDroppable)
		{
			fDroppable = isDroppable;
			if (itsWindow)
			{
				if (fDroppable)
					itsWindow->RegisterDroppableView(this);
				else if (!fDroppable)
					itsWindow->UnregisterDroppableView(this);
			}
		}
	}
}

//----------------------------------------------------------------------------------------
// TView::HandleDragCursor:
//----------------------------------------------------------------------------------------

void TView::HandleDragCursor(const CViewPoint& theMouse, RgnHandle cursorRegion)
{
	if (HasSubViews())
		for (CSubViewIterator iter(this, kIterateBackward_AC); iter; ++iter)
		{
			CViewPoint subViewPt(iter->SuperViewToLocal(theMouse));

			if (iter->ContainsMouse(subViewPt) && (iter->DoGetDragProxy()->GetDraggable() || iter->HasSubViews()))
			{
				iter->HandleDragCursor(subViewPt, cursorRegion);
				// bring the cursor region back to our coordinate system
				iter->LocalToSuperView(cursorRegion);
				break;
			}
		}

	if (EmptyRgn(cursorRegion) && Focus())
	{
		GetExtentRegion(cursorRegion);

		if (HasSubViews())
		{
			CTempRegion_AC subViewFrameRgn;

			for (CSubViewIterator iter(this); iter; ++iter)
				if (iter->DoGetDragProxy()->GetDraggable() || iter->HasSubViews())
				{
					iter->GetExtentRegion(subViewFrameRgn);
					iter->LocalToSuperView(subViewFrameRgn);
					DiffRgn(cursorRegion, subViewFrameRgn, cursorRegion);
				}
		}

		RgnHandle dragCursorRegion = NULL;
		if (!DoSetDragCursor(theMouse, cursorRegion, dragCursorRegion))
		{
			if (dragCursorRegion)
				DiffRgn(cursorRegion, dragCursorRegion, cursorRegion);
			::SetCursorToArrow_AC();
		}

		DisposeIfRgnHandle(dragCursorRegion);

		RestrictRegionToVisible(cursorRegion);
	}
}

//----------------------------------------------------------------------------------------
// TView::DoSetDragCursor:
//----------------------------------------------------------------------------------------

bool TView::DoSetDragCursor(const CViewPoint&	localPoint,
							RgnHandle			cursorRegion,
							RgnHandle&			dragCursorRegion)
{
#if qDebug
	::Assertion_AC(dragCursorRegion == NULL, "dragCursorRegion should be nil");
	AssumeFocused();
#endif

	dragCursorRegion = DoMakeDragCursorRegion();
	bool usingDragCursor = WillDrag(localPoint, dragCursorRegion);
	if (usingDragCursor)
	{
		// cursor region is the intersection of the drag region
		// and the provided cursor region
		::ThrowIfNULL_AC(dragCursorRegion);
		SectRgn(cursorRegion, dragCursorRegion, cursorRegion);
		short cursorID = GetWillDragCursorID();
		if (cursorID != kNoResource)
		{
			CursHandle aCursor = MacGetCursor(cursorID);
			::ThrowIfNULLResource_AC((Handle)aCursor);
			::SetCursor_AC(*aCursor);
		}
		else
			::SetCursorToArrow_AC();
	}

	return usingDragCursor;
}

//----------------------------------------------------------------------------------------
// TView::GetWillDragCursorID:
//----------------------------------------------------------------------------------------

short TView::GetWillDragCursorID()
{
	return kOpenHandCursor;
}

//----------------------------------------------------------------------------------------
// TView::GetIsDraggingCursorID:
//----------------------------------------------------------------------------------------

short TView::GetIsDraggingCursorID()
{
	return kClosedHandCursor;
}

//----------------------------------------------------------------------------------------
// TView::DoMakeDragCursorRegion:
//----------------------------------------------------------------------------------------

RgnHandle TView::DoMakeDragCursorRegion()
{
	RgnHandle dragCursorRegion = NULL;

	if (GetDraggable())
		dragCursorRegion = DoMakeDropHiliteRegion();// simple case

	return dragCursorRegion;
}

//----------------------------------------------------------------------------------------
// TView::WillDrag
//----------------------------------------------------------------------------------------

bool TView::WillDrag(const CViewPoint& localMouse, const RgnHandle dragCursorRegion)
{
	return dragCursorRegion && GetDraggable() ? PtInRgn(ViewToQD(localMouse), dragCursorRegion) : false;
}

//----------------------------------------------------------------------------------------
// TView::DoGetDragProxy:
//----------------------------------------------------------------------------------------

TView* TView::DoGetDragProxy()
{
	return this;								// default is to not provide a proxy
}

//----------------------------------------------------------------------------------------
// TView::HandleDrag:
//----------------------------------------------------------------------------------------

void TView::HandleDrag(const CViewPoint& theMouse,
					   TToolboxEvent* event,
					   CPoint_AC hysteresis)
{
	#pragma unused (hysteresis)

	PostCommand(DoMakeDragTracker(cDrag, theMouse, event));
}

//----------------------------------------------------------------------------------------
// TView::DoAddDragContent:
//----------------------------------------------------------------------------------------

void TView::DoAddDragContent()
{
	SubClassResponsibility();
}

//----------------------------------------------------------------------------------------
// TView::DoMakeDragOutlineRegion
//----------------------------------------------------------------------------------------

RgnHandle TView::DoMakeDragOutlineRegion()
{
	// The drag outline region will usually match the drag cursor region.
	RgnHandle dragOutlineRegion = DoMakeDragCursorRegion();
	CTempRegion_AC tempRegion;

	::MacCopyRgn(dragOutlineRegion, tempRegion);		// make it an outline
	InsetRgn(tempRegion, 1, 1);
	DiffRgn(dragOutlineRegion, tempRegion, dragOutlineRegion);

	LocalToGlobal(dragOutlineRegion);		// globalize

	return dragOutlineRegion;
}

//----------------------------------------------------------------------------------------
// TView::WillAcceptDrop:
//----------------------------------------------------------------------------------------

bool TView::WillAcceptDrop(CDragItemIterator& dragItemIterator)
{
	#pragma unused (dragItemIterator)

	SubClassResponsibility();

	return false;
}

//----------------------------------------------------------------------------------------
// TView::DoMakeDragTracker:
//----------------------------------------------------------------------------------------

TDragTracker* TView::DoMakeDragTracker(CommandNumber			itsCommandNumber,
									   const CViewPoint&		itsMouse,
									   const TToolboxEvent*		event)
{
	return TH_new TDragTracker(itsCommandNumber, this, itsMouse, event);
}

#if qDragObsolete

//----------------------------------------------------------------------------------------
// TView::DoDragEnter:
//----------------------------------------------------------------------------------------

void TView::DoDragEnter()
{
	// set up private data used to track drag
}

#endif // qDragObsolete

//----------------------------------------------------------------------------------------
// TView::DoMakeDropHiliteRegion:
//----------------------------------------------------------------------------------------

RgnHandle TView::DoMakeDropHiliteRegion()
{
	RgnHandle dropRegion = MakeNewRgn();
	::RectRgn(dropRegion, ViewToQD(GetVisibleExtent()));

	return dropRegion;
}

#if qDragObsolete

//----------------------------------------------------------------------------------------
// TView::DragWithin:
//----------------------------------------------------------------------------------------

void TView::DoDragWithin(const CViewPoint& localMouse)
{
	#pragma unused (localMouse)
	// update tracking data and visuals
}

//----------------------------------------------------------------------------------------
// TView::DoDragLeave:
//----------------------------------------------------------------------------------------

void TView::DoDragLeave()
{
	// clean up after the drag has left
}

#endif // qDragObsolete

//----------------------------------------------------------------------------------------
// TView::DoMakeDropLocationDescriptor:
//----------------------------------------------------------------------------------------

bool TView::DoMakeDropLocationDescriptor(CAEDesc_AC& dropLocationDesc)
{
	// Default implementation is to return a description of the containing window.
	// Subclasses of TView that mix MScriptable object may choose to describe themselves rather
	// than their containing window.
	bool result = false;
	TWindow * myWindow = GetWindow();

	if (myWindow)
	{
		try
		{
			result = myWindow->MakeObjectSpecifier(dropLocationDesc, formAbsolutePosition);
		}
		catch(CException_AC& theException)
		{
			DoCatchMessage_AC(theException);
		}

		// no resignal on failure
	}
	return result;
}

#if qDragObsolete

//----------------------------------------------------------------------------------------
// TView::WillDragMove:
//----------------------------------------------------------------------------------------

bool TView::WillDragMove(TView* destinationView)
{
	// test the family id's first
	bool isMove = (GetDragMoveFamily() == destinationView->GetDragMoveFamily());

	if (isMove)
	{
		switch (GetDragMoveDeterminer())
		{
			case kNeverMove:
				isMove = false;
				break;

			case kMoveWithinView:
				isMove = (this == destinationView);
				break;

			case kMoveWithinWindow:
				isMove = (GetWindow() == destinationView->GetWindow());
				break;

			case kMoveWithinContext:
				isMove = (GetContext(cDragMove) == destinationView->GetContext(cDragMove));
				break;

			case kMoveWithinApplication:		// already true.
				break;

			default:
				isMove = false;					// unknown context value
				break;
		}
	}

	return isMove;
}

//----------------------------------------------------------------------------------------
// TView::DoMakeDragDropCommand:
//----------------------------------------------------------------------------------------

TCommand* TView::DoMakeDragDropCommand(CommandNumber		itsCommandNumber,
									   CDragItemIterator&	dragItemIterator,
									   TDragTracker*		targetTracker)
{
	#pragma unused (itsCommandNumber, dragItemIterator, targetTracker)

	return NULL;								// subview responsibility
}

//----------------------------------------------------------------------------------------
// TView::DoFulfillPromise:
//----------------------------------------------------------------------------------------

void TView::DoFulfillPromise(TDragItem* promisedItem)
{
	#pragma unused (promisedItem)
	// subview responsibility
}

#endif // qDragObsolete

#endif // qDrag

//========================================================================================
// CLASS TIncludeView
//========================================================================================

MA_DEFINE_CLASS(TIncludeView);

//----------------------------------------------------------------------------------------
// TIncludeView constructor.
//----------------------------------------------------------------------------------------

TIncludeView::TIncludeView(short				includeRsrcID,
						   const CViewPoint&	itsSubViewOffset,
						   const CStr255_AC&	resourceName,
						   short				resourceAttributes)
	:	TView(gZeroVPt, gZeroVPt, sizeSuperView, sizeSuperView),
		fResourceName(resourceName),
		fItsSubViewOffset(itsSubViewOffset),
		fIncludeRsrcID(includeRsrcID),
		fResourceAttributes(resourceAttributes)
{
	fEnabled = false;
}

//----------------------------------------------------------------------------------------
// TIncludeView destructor
//----------------------------------------------------------------------------------------

TIncludeView::~TIncludeView()
{
}

//----------------------------------------------------------------------------------------
// TIncludeView::GetStandardSignature:
//----------------------------------------------------------------------------------------

IDType TIncludeView::GetStandardSignature() const
{
	return kStdIncludeAt;
}

//----------------------------------------------------------------------------------------
// TIncludeView::DoPostCreate:
//----------------------------------------------------------------------------------------

void TIncludeView::DoPostCreate(TDocument* itsDocument)
{
	TView::DoPostCreate(itsDocument);

	// It only makes sense to do this stuff if we have a view to include.
	if (fIncludeRsrcID != kNoResource)
	{
		// initially, make me "look like" my superview
		if (fSuperView)
			SetFrame(CViewRect(gZeroVPt, fSuperView->GetSize()), kDontInvalidate);

		// get the 'View' resource
		Handle viewResource = CMultiLocale_AC::GetResource('View', fIncludeRsrcID);
#if qDebug
		if (!viewResource)
		{
			viewResource = CMultiLocale_AC::GetResource('view', fIncludeRsrcID);
			if (viewResource)
			{
				::ProgramBreak_AC("Use ViewPromoter. Program contains 2.0 'view' resources");
				ReleaseResource(viewResource);
				viewResource = NULL;
			}
		}
#endif

		::ThrowIfNULLResource_AC(viewResource);

		short theID;
		ResType theType;
		CMultiLocale_AC::GetReverseMappedResInfo(viewResource, &theID, &theType, fResourceName);

		fResourceAttributes = GetResAttrs(viewResource);

		// create the included view
		TView * aView = TViewServer::fgViewServer->DoCreateViews(fDocument, this, fIncludeRsrcID, gZeroVPt);
		::ThrowIfNULL_AC(aView);

		// now, make me "look like" my subview
		SetSizeDeterminer(vSel, aView->GetSizeDeterminer(vSel));

		// •••  location determiners
		SetLocationDeterminer(vSel, aView->GetLocationDeterminer(vSel));

		SetSizeDeterminer(hSel, aView->GetSizeDeterminer(hSel));
		SetLocationDeterminer(hSel, aView->GetLocationDeterminer(hSel));
		// •••  location determiners

		SubViewChangedFrame(aView, gZeroVRect, CViewRect(fItsSubViewOffset, fItsSubViewOffset + aView->GetSize()), kDontInvalidate);
	}
}

//----------------------------------------------------------------------------------------
// TIncludeView::ReadFields:
//----------------------------------------------------------------------------------------

void TIncludeView::ReadFields(CStream_AC* aStream)
{
	TView::ReadFields(aStream);

	*aStream >> fIncludeRsrcID >> fItsSubViewOffset;
}

//----------------------------------------------------------------------------------------
// TIncludeView::WriteFields:
//----------------------------------------------------------------------------------------

void TIncludeView::WriteFields(CStream_AC* aStream) const
{
	TView::WriteFields(aStream);

	*aStream << fIncludeRsrcID << fItsSubViewOffset;
}

//----------------------------------------------------------------------------------------
// TIncludeView::WriteSubViews:
//----------------------------------------------------------------------------------------

void TIncludeView::WriteSubViews(CStream_AC* aStream) const
{
	// our subviews are "included" and therefore not writeable, so don't call Inherited
	aStream->WriteInteger(0);					// write out count of 0 subviews

	// Call into ViewServer to write out my subview to a 'View' resource with id=fIncludeRsrcID.
#if qDebugMsg
	if (CountSubViews() != 1)
		ProgramReport_AC("TIncludeView::WriteTo only supports writing of the first subview.\n");
#endif

	if (fIncludeRsrcID != kNoResource)
	{
		CStr255_AC name = fResourceName;
		TViewServer::fgViewServer->WriteViewsToResource(FirstSubView(), fIncludeRsrcID, name, fResourceAttributes);
	}
}

//----------------------------------------------------------------------------------------
// TIncludeView::SubViewChangedFrame:
//----------------------------------------------------------------------------------------

void TIncludeView::SubViewChangedFrame(TView*				theSubView,
									   const CViewRect&		aFrame,
									   const CViewRect&		newFrame,
									   bool					invalidate)
{
	#pragma unused (theSubView, aFrame)
	// Assume that TIncludeView has only 1 subview and that this view should remain the
	// same size as this one subview. We need to duplicate most of SetFrame here except
	// that we don't want to renotify our subviews that our frame has changed, especially
	// if our subview has size determiners of sizeRelSuperView.

	CViewRect oldFrame(GetFrame());

	CViewRect computedFrame(newFrame);
	computedFrame += fLocation;					// offset newFrame by my location

	if (computedFrame != oldFrame)
	{

		// update the frame stored in the view
		fLocation = computedFrame[topLeft];
		fSize = computedFrame.GetSize();

		InvalidateFocus();						// Must re-focus because frame changed
		InvalidateCoordinates();				// Re-calc all the offsets
		gDispatcher->InvalidateMouseRegions();	// Must re-calc cursor and help regions

		if (invalidate)
			InvalidateFrameDifference(oldFrame, computedFrame);

		// • Let my adorners know that my frame changed
		NotifyAdornersOfFrameChange(oldFrame, computedFrame, invalidate);

		// • Let my superview know that my frame changed
		if (fSuperView)
			fSuperView->SubViewChangedFrame(this, oldFrame, computedFrame, invalidate);
	}
}

//========================================================================================
// static functions
//========================================================================================

//----------------------------------------------------------------------------------------
// VisibleRect:
//----------------------------------------------------------------------------------------

void TView::VisibleRect(CRect_AC& rectToRestrict)
{
	CTempRegion_AC rRgn;

	RectRgn(rRgn, &rectToRestrict);
	VisibleRgn(rRgn);

	//rectToRestrict = (*(RgnHandle)rRgn)->rgnBBox;
	rectToRestrict = GetRegionBounds_AC(rRgn);	// Carbonized
}

//----------------------------------------------------------------------------------------
// DrawableRect:
//----------------------------------------------------------------------------------------

void TView::DrawableRect(CRect_AC& rectToRestrict)
{
	VisibleRect(rectToRestrict);

	CTempRegion_AC rRgn;

	RectRgn(rRgn, &rectToRestrict);
	DrawableRgn(rRgn);

	//rectToRestrict = (*(RgnHandle)rRgn)->rgnBBox;
	rectToRestrict = GetRegionBounds_AC(rRgn);	// Carbonized
}

//----------------------------------------------------------------------------------------
// VisibleRgn:
//----------------------------------------------------------------------------------------

void TView::VisibleRgn(RgnHandle rgn)
{
	if (!gPrinting && !gDrawingPictScrap)
	{
#if !qCarbon
		//SectRgn(rgn, TWindow::GetVisRegion(qd.thePort), rgn);
		SectRgn(rgn, GetGrafPtr_AC()->visRgn, rgn);
#else
		SectRgn(rgn, GetPortVisibleTempRegion_AC(), rgn);
#endif
	}
}

//----------------------------------------------------------------------------------------
// DrawableRgn:
//----------------------------------------------------------------------------------------

void TView::DrawableRgn(RgnHandle rgn)
{
#if !qCarbon
	//SectRgn(rgn, GetClipRegion(qd.thePort), rgn);
	SectRgn(rgn, GetGrafPtr_AC()->clipRgn, rgn);
#else
	SectRgn(rgn, GetPortClipTempRegion_AC(), rgn);
#endif
}

//----------------------------------------------------------------------------------------
// IsPtVisible:
//----------------------------------------------------------------------------------------

bool TView::IsPtVisible(CPoint_AC pt)
{
#if !qCarbon
	//return PtInRgn(pt, TWindow::GetVisRegion(qd.thePort));
	return PtInRgn(pt, GetGrafPtr_AC()->visRgn);
#else
	return PtInRgn(pt, GetPortVisibleTempRegion_AC());
#endif
}

//----------------------------------------------------------------------------------------
// IsPtDrawable:
//----------------------------------------------------------------------------------------

bool TView::IsPtDrawable(CPoint_AC pt)
{
#if !qCarbon
	//return IsPtVisible(pt) && PtInRgn(pt, GetClipRegion(qd.thePort));
	return IsPtVisible(pt) && PtInRgn(pt, GetGrafPtr_AC()->clipRgn);
#else
	return IsPtVisible(pt) && PtInRgn(pt, GetPortClipTempRegion_AC());
#endif
}

//----------------------------------------------------------------------------------------
// IsRectVisible:
//----------------------------------------------------------------------------------------

bool TView::IsRectVisible(const CRect_AC& r)
{
#if !qCarbon
	//return RectInRgn(&r, TWindow::GetVisRegion(qd.thePort));
	return RectInRgn(&r, GetGrafPtr_AC()->visRgn);
#else
	return RectInRgn(&r, GetPortVisibleTempRegion_AC());
#endif
}

//----------------------------------------------------------------------------------------
// IsRectDrawable:
//----------------------------------------------------------------------------------------

bool TView::IsRectDrawable(const CRect_AC& r)
{
#if !qCarbon
	//return IsRectVisible(r) && RectInRgn(&r, GetClipRegion(qd.thePort));
	return IsRectVisible(r) && RectInRgn(&r, GetGrafPtr_AC()->clipRgn);
#else
	return IsRectVisible(r) && RectInRgn(&r, GetPortClipTempRegion_AC());
#endif
}

//----------------------------------------------------------------------------------------
// GetFocus:
//----------------------------------------------------------------------------------------

void TView::GetFocus(FocusRec& theFocusRec)
{
	GetViewPortInfo(theFocusRec.itsViewPortInfo);

	theFocusRec.focusedView = gFocusedView;
	theFocusRec.printing = gPrinting;
	theFocusRec.drawingPictScrap = gDrawingPictScrap;
	theFocusRec.drawingPictScrapView = gDrawingPictScrapView;
}

//----------------------------------------------------------------------------------------
// SetFocus:
//----------------------------------------------------------------------------------------

void TView::SetFocus(const FocusRec& theFocusRec)
{
	gFocusedView = theFocusRec.focusedView;
	gPrinting = theFocusRec.printing;
	gDrawingPictScrap = theFocusRec.drawingPictScrap;
	gDrawingPictScrapView = theFocusRec.drawingPictScrapView;

	SetViewPortInfo(theFocusRec.itsViewPortInfo);
}

//----------------------------------------------------------------------------------------
// GetViewPortInfo:
//----------------------------------------------------------------------------------------

void TView::GetViewPortInfo(ViewPortInfo& theViewPortInfo)
{
	GetPort(&(theViewPortInfo.port));
	GetClip(theViewPortInfo.clip);
	//theViewPortInfo.org = ((CRect_AC &)theViewPortInfo.port->portRect)[topLeft];
	theViewPortInfo.org = GetPortRect_AC(theViewPortInfo.port)[topLeft];	// Carbonized
	theViewPortInfo.isValid = true;
}

//----------------------------------------------------------------------------------------
// SetViewPortInfo:
//----------------------------------------------------------------------------------------

void TView::SetViewPortInfo(const ViewPortInfo& theViewPortInfo)
{
	if (GetGrafPtr_AC() != theViewPortInfo.port)		// be nice to accelerator cards
		::SetPort_AC(theViewPortInfo.port);
	//if (((CRect_AC &)qd.thePort->portRect)[topLeft] != theViewPortInfo.org)
	if (GetPortRect_AC(GetGrafPtr_AC())[topLeft] != theViewPortInfo.org)	// Carbonized
		SetOrigin(theViewPortInfo.org.h, theViewPortInfo.org.v);
	SetClip(theViewPortInfo.clip);
}

//----------------------------------------------------------------------------------------
// WriteFocus:
//----------------------------------------------------------------------------------------
#if qDebug

void TView::WriteFocus()
{
#if qCarbon
	//#pragma message ("TView::WriteFocus: Implement warnings.")
#else
	ProgramReport_AC("  fViewToQDOffset = %s\n", gFocusedView->fViewToQDOffset.AsText().c_str());
	ProgramReport_AC("         portRect = %s\n", ((CRect_AC &)GetGrafPtr_AC()->portRect).AsText().c_str());
	ProgramReport_AC("           visRgn = %s\n", ((CRect_AC &)(*(GetGrafPtr_AC()->visRgn))->rgnBBox).AsText().c_str());
	ProgramReport_AC("          clipRgn = %s\n", ((CRect_AC &)(*(GetGrafPtr_AC()->clipRgn))->rgnBBox).AsText().c_str());
#endif	// non-Carbon code
}
#endif

//----------------------------------------------------------------------------------------
// GetClipRegion:
//----------------------------------------------------------------------------------------

RgnHandle TView::GetClipRegion()
{
	RgnHandle clipRgn;
#if qCarbon
	TView* root = GetRootView();
	if (root)
		clipRgn = root->GetClipRegion();
	else
		clipRgn = ::NewRgn();
#else
	clipRgn = GetGrafPort()->clipRgn;
#endif
	return clipRgn;
}

//----------------------------------------------------------------------------------------
// TView::InitUView
//----------------------------------------------------------------------------------------

void TView::InitUView(bool
#if qGXViews || qGXPrinting
					  initGX
#endif
					  )
{
#if qGXViews || qGXPrinting
	if (initGX && HasQDGXGraphics_AC())
	{
		static const long kGXUsegaszRsrc = 0;	// '0' indicates that GX should use the 'gasz' rsrc in your app

		gGXGraphicsClient = GXNewGraphicsClient(NULL, kGXUsegaszRsrc, 0);

		if (gGXGraphicsClient)
			GXEnterGraphics();
	}
#endif

}

//----------------------------------------------------------------------------------------
// TView::TerminateUView
//----------------------------------------------------------------------------------------

void TView::TerminateUView()
{
#if qGXViews || qGXPrinting
	if (gGXGraphicsClient)
	{

		GXDisposeGraphicsClient(gGXGraphicsClient);
		gGXGraphicsClient = NULL;

		// Only need checking if debugging the application
		GXExitGraphics();
	}
#endif

}

#if qMSWindows

//----------------------------------------------------------------------------------------
// TView::MAViewWindowProc
//----------------------------------------------------------------------------------------

LRESULT CALLBACK TView::MAViewWindowProc(HWND hwnd, UINT message, WPARAM wParam, LPARAM lParam)
{
	LRESULT result = 0;
	switch (message)
	{
		// these (can) get called before the window strucure is fully initialized...
		// so use the gloabl gNewViewObject to point to the view object before the windows
		// structure is initialized...
		case WM_CREATE:
		case WM_MDICREATE:
		case WM_NCCREATE:
			if (gNewViewObject != NULL)
				result = gNewViewObject->HandleWindowsEvent(hwnd, message, wParam, lParam);
			else
			{
				// should never get here unless the view was created incorrectly...
				// so perhaps should throw an error?
				result = DefWindowProc(hwnd, message, wParam, lParam);
			}
			break;

		// these are called before the windows record is initialized and may also be called
		// after the record is initialized.
		case WM_GETMINMAXINFO:
		case WM_NCCALCSIZE:
			if (gNewViewObject != NULL)
				result = gNewViewObject->HandleWindowsEvent(hwnd, message, wParam, lParam);
			else
			{
				TView* view = (TView*)GetWindowLong(hwnd, GWL_USERDATA);
    			if (view != NULL)
					result = view->HandleWindowsEvent(hwnd,message,wParam,lParam);
				else
				{
					// should never get here unless the view was created incorrectly...
					// so perhaps should throw an error?
					result = DefWindowProc(hwnd, message, wParam, lParam);
				}
			}
			break;

		default:
			{
				TView* view = (TView*)GetWindowLong(hwnd, GWL_USERDATA);
				if (view != NULL)
					return view->HandleWindowsEvent(hwnd,message,wParam,lParam);
				else if (gNewViewObject != NULL) // just in case some...
					return gNewViewObject->HandleWindowsEvent(hwnd, message, wParam, lParam);
				else
				{
					// should never get here unless the view was created incorrectly...
					// throw an error?
					return DefWindowProc(hwnd, message, wParam, lParam);
				}
			}
	}
	return result;
}

//----------------------------------------------------------------------------------------
// TView::DefaultWindowProcedure
//----------------------------------------------------------------------------------------

long TView::DefaultWindowProcedure(	HWND			hwnd,
									UINT			message,
									WPARAM			wParam,
									LPARAM			lParam)
{
	const char* className = GetWindowsClassName();
	if (strcmp(className, kViewClassName) == 0)
		return ::DefWindowProc(hwnd,message,wParam,lParam);
	else
	{
		WNDCLASS	lpwc;
		if (!::GetClassInfo(NULL, className, &lpwc))
			return 0; // impossible to happen?!?!  throw an error???
		return ::CallWindowProc(lpwc.lpfnWndProc, hwnd, message, wParam, lParam);
	}
}

//----------------------------------------------------------------------------------------
// TView::FindSubViewByHWND
//----------------------------------------------------------------------------------------

TView* TView::FindSubViewByHWND(HWND itsWindow)
{
	if (fWindowsWindow == itsWindow)
    	return this;

	for (CSubViewIterator iter(this); iter; ++iter)
	{
		TView* foundSubView = iter->FindSubViewByHWND(itsWindow);
		if (foundSubView != NULL)
        	return foundSubView;
	}
	return NULL;
}

//----------------------------------------------------------------------------------------
// TView::HandleWindowsEvent
//----------------------------------------------------------------------------------------

long TView::HandleWindowsEvent(HWND hwnd, UINT message, WPARAM wParam, LPARAM lParam)
{
	long result = 0;
	switch (message)
	{
		case WM_PAINT:
			{
				PAINTSTRUCT paintingInfo;
				SetDrawingContext(new TDrawingContext(::BeginPaint(hwnd, &paintingInfo)));
				CRect_AC theRect(paintingInfo.rcPaint.left, paintingInfo.rcPaint.top, paintingInfo.rcPaint.right, paintingInfo.rcPaint.bottom);
				CViewRect area = QDToView(theRect);
				if (!IsTransparentView() && Focus())
					::EraseRect(ViewToQD(area));
				HandleDraw(area);
				SetDrawingContext(NULL);
				::EndPaint(hwnd, &paintingInfo);
			}
			break;

		case WM_LBUTTONDBLCLK:
		case WM_RBUTTONDBLCLK:
		case WM_LBUTTONDOWN:
		case WM_RBUTTONDOWN:
		case WM_LBUTTONUP:
		case WM_RBUTTONUP:
		case WM_KEYDOWN:
		case WM_CHAR:
			{
				MSG winMsg;
				winMsg.hwnd = hwnd;
				winMsg.message = message;
				winMsg.wParam = wParam;
				winMsg.lParam = lParam;
				winMsg.time = GetMessageTime();
				LONG myPoints = GetMessagePos();
				winMsg.pt.x = LOWORD(myPoints);
				winMsg.pt.y = HIWORD(myPoints);
				
				EventRecord eventRecord;
				WinEventToMacEvent(&winMsg, &eventRecord);
				
				POINT mappedPoint;
				mappedPoint.x = eventRecord.where.h;
				mappedPoint.y = eventRecord.where.v;
				::MapWindowPoints(HWND_DESKTOP, CApplication_AC::fgProcess->fChildClientWindow, (POINT*)&mappedPoint, 1);
				eventRecord.where.h = mappedPoint.x;
				eventRecord.where.v = mappedPoint.y;
				
				TToolboxEvent event(this, &eventRecord, TToolboxEvent::kDontFree);
				
				gDispatcher->HandleToolboxEvent(&event);
				result = DefaultWindowProcedure(hwnd, message, wParam, lParam);
			}
			break;

		case WM_MOUSEMOVE: // WinEventToMacEvent doesn't appear to do the right thing here, so fix it up manually
			{
				MSG winMsg;
				winMsg.hwnd = hwnd;
				winMsg.message = message;
				winMsg.wParam = wParam;
				winMsg.lParam = lParam;
				winMsg.time = GetMessageTime();
				LONG myPoints = GetMessagePos();
				winMsg.pt.x = LOWORD(myPoints);
				winMsg.pt.y = HIWORD(myPoints);
				
				EventRecord eventRecord;
				WinEventToMacEvent(&winMsg, &eventRecord);

				eventRecord.what = osEvt;
				eventRecord.message = mouseMovedMessage << 24;
				
				TToolboxEvent event(this, &eventRecord, TToolboxEvent::kDontFree);
				
				gDispatcher->HandleToolboxEvent(&event);
				result = DefaultWindowProcedure(hwnd, message, wParam, lParam);
			}
			break;

		case WM_COMMAND:
			{
				EventNumber event = LOWORD(wParam);
				TView* source = FindSubViewByHWND((HWND)lParam);
				if (source == NULL)
					source = this;
				HandleEvent(event, source, NULL);
				TMenuBarManager::InvalidateMenus();
			}
			break;

		case WM_HSCROLL:
		case WM_VSCROLL:
			// we really want the scroll bar to handle these
			// windows sends these events to the window the scrollbar is
			// inside of instead of to the scroll bar itself.
			// so lets just send it straight to the scroll bar
			result = SendMessage((HWND)lParam, message, wParam, (LPARAM)hwnd);
			break;

		default:
			result = DefaultWindowProcedure(hwnd, message, wParam, lParam);
        	break;
	}
	return result;
}

//----------------------------------------------------------------------------------------
// TView::SetWindowsWindow
//----------------------------------------------------------------------------------------

void TView::SetWindowsWindow(HWND windowsWindow)
{
	fWindowsWindow = windowsWindow;
	if (fWindowsWindow != NULL)
	{
		SetWindowLong(fWindowsWindow, GWL_USERDATA, (long)this);
		SetWindowLong(fWindowsWindow, GWL_WNDPROC, (LONG)MAViewWindowProc);
		fGrafPort = ::CreatePortAssociation(windowsWindow, NULL, 0);
	}
	else
		fGrafPort = NULL;
}

//----------------------------------------------------------------------------------------
// TView::CreateWindowsWindow
//----------------------------------------------------------------------------------------

void TView::CreateWindowsWindow()
{
	if (fNeedsOwnWindowsWindow)
	{
		if (fWindowsWindow != NULL)
			return; // throw an error? doesn't make any sense to be calling this if the windows window already exists
		HWND superWindow = NULL;
		TView* superView = fSuperView;
		while (superView != NULL)
		{
			if (superView->NeedsOwnWindowsWindow())
			{
				superWindow = superView->GetWindowsWindow();
				break;
			}
			superView = superView->fSuperView;
		}

		if (superWindow == NULL)
			return; // throw an error?

		DWORD style = fWindowStyle;
		//if (!IsEnabled())
	    	//style |= WS_DISABLED;
		CViewPoint size = fSize;
		CViewRect superRect = fSuperView->GetVisibleRect();
		for (VHSelect vhs = vSel; vhs <= hSel; vhs++)
		{
			switch (fSizeDeterminer[vhs])
			{
				case sizeRelSuperView:
				case sizeSuperView:
					size[vhs] = superRect.GetSize()[vhs] - fLocation[vhs];
					break;
			}
		}
		gNewViewObject = this;
		short int xOrigin = 0;
		short int yOrigin = 0;
		xOrigin = GetScrollPos(superWindow,SB_HORZ);
		yOrigin = GetScrollPos(superWindow,SB_VERT);
		DWORD exStyle = 0;
		if (fSubView)
			exStyle |= WS_EX_CONTROLPARENT;
		if (IsTransparentView())
			exStyle |= WS_EX_TRANSPARENT;
		SetWindowsWindow(::CreateWindowEx(exStyle, GetWindowsClassName(), NULL, style, fLocation.h - xOrigin, fLocation.v - yOrigin,
				size.h, size.v, superWindow, NULL, CApplication_AC::sfInstance, NULL));
		gNewViewObject = NULL;
	}
}

//----------------------------------------------------------------------------------------
// TView::DeleteWindowsWindow
//----------------------------------------------------------------------------------------

void TView::DeleteWindowsWindow()
{
	HWND window = GetWindowsWindow();
	if (window != NULL)
	{
		::DestroyPortAssociation((CGrafPtr)fGrafPort);
		SetWindowsWindow(NULL);
		::DestroyWindow(window);
    }
}

//----------------------------------------------------------------------------------------
// TDrawingContext::SetWindowsWindowStyle
//----------------------------------------------------------------------------------------

void TView::SetWindowsWindowStyle(DWORD windowStyle)
{
	fWindowStyle = windowStyle;
}

//----------------------------------------------------------------------------------------
// TDrawingContext::GetWindowsWindowStyle
//----------------------------------------------------------------------------------------

DWORD TView::GetWindowsWindowStyle()
{
	return fWindowStyle;
}

//----------------------------------------------------------------------------------------
// TDrawingContext::SetDrawingContext
//----------------------------------------------------------------------------------------

void TView::SetDrawingContext(TDrawingContext* drawingContext)
{
	delete fDrawingContext;
	fDrawingContext = drawingContext;
}

//----------------------------------------------------------------------------------------
// TDrawingContext::GetDrawingContext
//----------------------------------------------------------------------------------------

TDrawingContext* TView::GetDrawingContext()
{
	return fDrawingContext;
}

//----------------------------------------------------------------------------------------
// TDrawingContext::NeedsCurrentPen
//----------------------------------------------------------------------------------------

TDrawingContext::TDrawingContext(HDC drawingContext)
	:	fDrawingContext(drawingContext),
		fCurrentForeColor(RGB(0,0,0)),
		fSelectedPenColor(RGB(0,0,0)),
		fSelectedBrushColor(RGB(255,255,255)),
		fOriginalPen(NULL),
		fOriginalBrush(NULL),
		fCurrentPenSize(1),
		fSelectedPenSize(1)
{
	fCurrentPosition.h = 0;
	fCurrentPosition.v = 0;
}

//----------------------------------------------------------------------------------------
// TDrawingContext::NeedsCurrentPen
//----------------------------------------------------------------------------------------

TDrawingContext::~TDrawingContext()
{
	Done();
}

//----------------------------------------------------------------------------------------
// TDrawingContext::NeedsCurrentPen
//----------------------------------------------------------------------------------------

void TDrawingContext::Done()
{
	if (fOriginalPen != NULL)
	{
		HGDIOBJ oldPen = SelectObject(fDrawingContext, fOriginalPen);
		DeleteObject(oldPen);
		fOriginalPen = NULL;
		fSelectedPenColor = RGB(0,0,0);
		fSelectedPenSize = 1;
	}
	if (fOriginalBrush != NULL)
	{
		HGDIOBJ oldBrush = SelectObject(fDrawingContext, fOriginalBrush);
		DeleteObject(oldBrush);
		fOriginalBrush = NULL;
		fSelectedBrushColor = RGB(255,255,255);
	}
}

//----------------------------------------------------------------------------------------
// TDrawingContext::NeedsCurrentPen
//----------------------------------------------------------------------------------------

void TDrawingContext::SetPenSize(Byte penSize)
{
	fCurrentPenSize = penSize;
}

//----------------------------------------------------------------------------------------
// TDrawingContext::NeedsCurrentPen
//----------------------------------------------------------------------------------------

void TDrawingContext::RGBForeColor(const RGBColor& newColor)
{
	fCurrentForeColor = RGB(newColor.red/256, newColor.green/256, newColor.blue/256);
	NeedsCurrentPen();
}

//----------------------------------------------------------------------------------------
// TDrawingContext::NeedsCurrentPen
//----------------------------------------------------------------------------------------

void TDrawingContext::PaintRect(const CRect_AC& aRect)
{
	NeedsCurrentBrush();
	HPEN nullPen = (HPEN)GetStockObject(NULL_PEN);
	HPEN oldPen = (HPEN)SelectObject(fDrawingContext, nullPen);

	// need to expand rectangle by 1 pixel right and down to match quickdraw drawing
	::Rectangle(fDrawingContext, aRect.left, aRect.top, aRect.right+1, aRect.bottom+1);

	SelectObject(fDrawingContext, oldPen);
}

//----------------------------------------------------------------------------------------
// TDrawingContext::NeedsCurrentPen
//----------------------------------------------------------------------------------------

void TDrawingContext::FrameRect(const CRect_AC& aRect)
{
	NeedsCurrentPen();
	HBRUSH nullBrush = (HBRUSH)GetStockObject(NULL_BRUSH);
	HBRUSH oldBrush = (HBRUSH)SelectObject(fDrawingContext, nullBrush);
	bool drewLine = false;
	if (fCurrentPenSize == 1) // have to special case this because rectangles must be at least 2 pixels in each direction to draw
	{
		if (aRect.left == aRect.right)
		{
			::MoveToEx(fDrawingContext, aRect.left, aRect.top, NULL);
			::LineTo(fDrawingContext, aRect.left, aRect.bottom);
			drewLine = true;
		}
		else if (aRect.top == aRect.bottom)
		{
			::MoveToEx(fDrawingContext, aRect.left, aRect.top, NULL);
			::LineTo(fDrawingContext, aRect.right, aRect.top);
			drewLine = true;
		}
	}
	if (!drewLine)
	{
		CRect_AC framedRect = aRect;
		short shiftUp = fCurrentPenSize/2;
		short shiftDown = (fCurrentPenSize+1)/2;
		if (aRect.left < aRect.right)
		{
			framedRect.top -= shiftUp;
			framedRect.bottom += shiftDown;
		}
		if (aRect.top < aRect.bottom)
		{
			framedRect.left -= shiftUp;
			framedRect.right += shiftDown;
		}
		::Rectangle(fDrawingContext, framedRect.left, framedRect.top, framedRect.right, framedRect.bottom);
	}
	SelectObject(fDrawingContext, oldBrush);
}

//----------------------------------------------------------------------------------------
// TDrawingContext::NeedsCurrentPen
//----------------------------------------------------------------------------------------

void TDrawingContext::SetOrigin(short x, short y)
{
	POINT oldOrg;
	SetViewportOrgEx(fDrawingContext, x, y, &oldOrg);
}

//----------------------------------------------------------------------------------------
// TDrawingContext::NeedsCurrentPen
//----------------------------------------------------------------------------------------

void TDrawingContext::MoveTo(short x, short y)
{
	fCurrentPosition.h = x;
	fCurrentPosition.v = y;
}

//----------------------------------------------------------------------------------------
// TDrawingContext::NeedsCurrentPen
//----------------------------------------------------------------------------------------

void TDrawingContext::LineTo(short x, short y)
{
	NeedsCurrentPen();
	::MoveToEx(fDrawingContext, fCurrentPosition.h, fCurrentPosition.v, NULL);
	::LineTo(fDrawingContext, x, y);
	fCurrentPosition.h = x;
	fCurrentPosition.v = y;
}

//----------------------------------------------------------------------------------------
// TDrawingContext::NeedsCurrentPen
//----------------------------------------------------------------------------------------

void TDrawingContext::NeedsCurrentBrush()
{
	if (fSelectedBrushColor != fCurrentForeColor)
	{
		HBRUSH newBrush = ::CreateSolidBrush(fCurrentForeColor);
		HBRUSH oldBrush = (HBRUSH)::SelectObject(fDrawingContext, newBrush);
		if (fOriginalBrush == NULL)
			fOriginalBrush = oldBrush;
		else
			DeleteObject(oldBrush);
		fSelectedBrushColor = fCurrentForeColor;
	}
}

//----------------------------------------------------------------------------------------
// TDrawingContext::NeedsCurrentPen
//----------------------------------------------------------------------------------------

void TDrawingContext::NeedsCurrentPen()
{
	if ((fSelectedPenSize != fCurrentPenSize) || (fSelectedPenColor != fCurrentForeColor))
	{
		HPEN newPen = ::CreatePen(PS_INSIDEFRAME, fCurrentPenSize, fCurrentForeColor);
		HPEN oldPen = (HPEN)::SelectObject(fDrawingContext, newPen);
		if (fOriginalPen == NULL)
			fOriginalPen = oldPen;
		else
			DeleteObject(oldPen);
		fSelectedPenSize = fCurrentPenSize; 
		fSelectedPenColor = fCurrentForeColor; 
	}
}

#endif // qMSWindows

//----------------------------------------------------------------------------------------
// End of UView.cpp

/*
	Historical Change Record:
		----- R13 -----
		07/25/97	When updating with platinum appearance we were not respecting the window's content
							region color. We needed to set the background color for the window when focusing.
							However, to allow drawing environments to provide alternate coloration we also needed
							to call TView::SetupDrawingEnvironment() when focusing. TWhiteBackgroundAdorner installs
							a DrawingEnvironment to cause the color environment to change to the desired one.
		07/17/97	Added accessors for opacity
		07/16/97	Changed some ProgramBreak_AC to ProgramReport_AC
		07/14/97	[1665220] (Cursor/Sleep) Cursor regions seem to be broken/latent
		07/14/97	[1615635] (Printing) Disable checkbox, radio button & popup aren't printed.
							Got rid of TControl::AsPictForPrinting abomination too.
		07/13/97	[1385305] (Printing) Problems printing non-visible views
		07/13/97	[1615633] (TTEView -Clone) Clone crashed at mouse click
		07/11/97	Prefer TemporaryAllocation terminology over PermAllocation.
		07/11/97	Changed 7/9's changes to use TempObjectAllocation.
		07/09/97	Replaced AllocateObjectsFromPerm with TempAllocation.
		07/08/97	[1617477] Changed logic in TView::SetDroppable.  DoPostCreate no
							longer registers the view if it is droppable since done by AddSubView
							(indirectly).
		07/01/97	Added DeleteAllAdorners to stop memory leaking with adorners (TEditText).
		06/30/97	Fixed TView::Focus so it returns false when it can't focus
		06/30/97	[1353169] fprinf(stderr, blah) to ProgramBreak_AC(blah)
		06/24/97	Added frameInvalidateDeterminer code to SetFrame.
		06/25/97	Removed excessive blank lines.
		06/17/97	[1387523] Focus now sets the port if it's not the expected port
							rather than doing a user break and returning false.
		06/23/97	Minor fixes for qWriteTemplateViews.
		06/22/97	Minor changes for VC++.
		06/22/97	Added static_cast.
		06/17/97	Fixed logic in DoSetCursor so cursor still gets set when Drag manager isn't present.
		06/13/97	Backed out fixes for [1338821] in AddSubView, RemoveSubView; fixed it in TDialogTEView::InstallEditText
		06/11/97	Tweak the error handling in TView::HandleDraw a little more.
		06/11/97	[1615653] In RestrictRegionToVisible, don't further restrict to clip region,
							it may have accumulated invalidated views and won't set the cursor correctly.
		06/11/97	Call TView::DrawFailed when TView::Draw fails
		06/10/97	Need to use dynamic_cast not dynamic_cast_AC
		06/09/97	Use dynamic_cast_AC where we expected dynamic_cast to always work.
		05/30/97	[114851] Added call to AddedToView in HandlePostCreate, so adorners know when they've been added.
		05/22/97	Remove Imaging dependency from Streams, part II.
		05/22/97	Partial streams fixes.
		05/05/97	Changes for new streaming.
		04/28/97	ReadFrom and WriteTo include guard size in case of failure.
		04/23/97	ReadFields methods don't free themselves on failure.
		04/22/97	Make the global adorners static members of TAdorner
		04/18/97	Oops, forgot to dereference typeid parameter to get dynamic type!
		04/14/97	Update for real xxx_cast operators.
		04/14/97	More const for TView/TWindow.
		04/13/97	Update List and Dependency names for ACS.
		04/11/97	Moved SetTarget/GetTarget/fTarget to TEventHandler (as statics), IsTarget a simple
							Inline and removed the need for TEditText to lie in a (former) override of IsTarget.
							Instead, TEditText::WantsToBeTarget only wants to be the target if its fTEView isn't
		04/09/97	properly use dynamic casting for all down/side casts
		04/08/97	Made TView::HandleDraw even smarter about clipping of subviews
		04/08/97	Update for TAdorner/TBehavior/TEventHandler/TCommandHandler/TCommand/
							TFileBasedDocument/TSection/TEditionDocument protected fields.
		04/04/97	Update for TView/TWindow protected fields.
		04/02/97	Update for TView view coordinate tranform methods.
		04/02/97	In TView::Clip[Sub/Sibling]Views skip views that are outside the VISIBLE extent/frame of the view being processed
		03/31/97	Fix egregious drawing bug. Do the removal of opaque subviews at HandleDraw time.
		03/27/97	Make it go with new streaming
		03/25/97	AC_ to _AC Name change.
		03/24/97	Migrated Dependencies and Lists to ACS
		03/21/97	kMaxCoord was missing from templatized coords, changed to kMaxQDCoord.
		03/21/97	Migrated to CViewRect, CViewPoint, ViewCoordinate.
		03/11/97	Update exception support to latest.
		03/07/97	Massive Changes: Use Exceptions_AC, new to TH_new, use Blah_AC,
							Update Copyright, Moved Obsolete APIs into Compatibility.h, etc..
		03/05/97	Added TView::DoUnsetCursor and supporting methods
		02/15/97	Fleshed out copy constructor.
		02/12/97	[1615704] Check IsEnabled() before calling UpdateSelection
							in HandleMouseDown.
		01/28/97	Moved FindParentView and FindPeerView from TBaseSizer to TView.
		01/17/97	Updated qMSWindows conditionals.
		01/13/97	Updated qWindows conditionals.
		10/14/96	[1392270] GetUserSelection checks for NULL.
		09/30/96	Fix cloning by turning clone methods into copy constructors
		09/12/96	[1386438] Fixed BeInDocument to be NULL-friendly.
		08/28/96	Remove superview/document arguments to TView (and derived) constructors.
		08/16/96	Use constructors for all TView descendents
		08/12/96	Use constructors for all CDynamicArray_AC descendents
		08/10/96	Fixed -noload compiles, made more datamembers auto_ptrs, FreeIfObject->delete
		08/08/96	Reduce number of orphaned objects at quit-time by using CAutoPtr_AC with static pointers
		08/07/96	Goodbye TObject!
		08/07/96	Removed more TObject ancestry.
		07/18/96	Use CAutoPtr_AC based pointers for many instance variables.
		07/18/96	Change TView::fDrawingEnvironment/fAdorners to CAutoPtr_AC based.
		07/17/96	define template CAutoPtr_AC and use it in place of CTempObject
		07/17/96	Scoping of Window, QuickDraw, Cursor, TickCount and some TE globals.
		07/16/96	Removed MAVolatile
		07/16/96	Replacing Failxxx with Throwxx procs
		07/16/96	Scoped try/catch block
		07/16/96	Changed references to failinfos to references of CException_AC
		07/16/96	Goodbye Exception Macros (TRY, CATCH_ALL, ENDTRY)
		07/16/96	Now include UExceptions.h instead of UFailure.h
		07/15/96	Boolean->bool
		----- R11 -----
		06/26/96	Changed nil back to NULL.
		06/26/96	[1290384] Overhauled BeInDocument.
		06/26/96	Install release marker.  Scope many globals.  Change TRUE/FALSE/NULL.
		06/26/96	==/!=NULL to implicit tests, except in the case of assignment to or passing/returning as bool/bool.
		06/19/96	[1357770] TView::LocalToGlobalRegion no longer transforms the region
							according to the view offset.  See new comment in function.
		06/19/96	Found and removed some more declarations in while loops by turning
							on "ARM conformance" in CW. This disables the ability to declare in the expression of a while.
		06/19/96	SCpp and MrCpp can't handle declarations in the expression portion of while loops
							so we just changed them all to for loops
		06/13/96	In TAssociation::KeyAt incorrectly assigned to keyStr twice!! (second assignment was
							wrong value), also changed local Booleans to bool.
		06/09/96	Removed UStreamable to a separate file from UObject
		06/09/96	Added update of fDocument in AddSubView and RemoveSubView, adding new routine
							RemoveFromDocument.  Fixes 1338821.
		05/09/96	Adjust the Failure Handling macros to allow for easy switching to native exceptions.
		05/03/96	fix bug introduced in ~TView
		05/03/96	Use FailNonObject for object testing diagnostics.
		05/02/95	Call FreeIfObject, don't call Free directly since it will eventually be removed.
		04/30/96	Call Changed with mFrameChanged in TView::SetFrame.
		04/29/96	Create and use functions that return their data as results for:
							TStream::ReadCharacter/CViewPoint/Rect/CViewRect/RGBColor/String. Create compatible inlines
							so users don't have to change their code.
		 4/26/96	Made C/CViewPoint/Rect default constructors set the point/rect to a cleared value. Made
		 					clearing very fast/compact. Eliminated the now unnecessary hand clearing of C/CViewPoint/Rects.
		04/26/96	Made TControl::ControlArea/ControlQDArea non virtual. Made TView/TControl::GetAdornExtent
							return their CViewRect as function results
		04/23/96	Use CTempObject/Handle/Region/Ptr, etc.
		04/23/96	Update iterators to be OD stylish.
		04/18/96	Use post-increment with iterators in while loops
		04/16/96	Corrected problem with Adorner deletion introduced with "while" style iter.
		04/16/96	Use "while" style iteration
		----- R10 -----
		04/04/96	TView::Focus failed to set the return value when focusing for drawingpictscrap
		 3/31/96	Inlined TView::InvalidateFocus
		 3/31/96	Made some judicious inlining for CSubViewIterator
		03/28/96	CalcMinFrame now returns a CViewRect
		03/28/96	DoCalcPageStrips/DoCalcViewPerPage/GetPrintExtent return VPoints/VRects now
							Dragging accessors are inlines. IsFocused is inline
		03/27/96	made a couple CSubViewIterator methods inline
		 3/27/96	Account for GetClassName able to return a char*.
		03/26/96	Cleanup all functions to have a single return. This is important to reducing generated
							code for routines with destructors. Conditioned TView::AssumeFocuesed on qDebug
		03/26/96	Cleanup references to gEmptyString and ""
		03/26/96	coerce CStrxxx_AC to const char* to get copies of the strings as c style strings
		 3/22/96	Removed TView::DrawsWithQDGX
		03/22/96	Eliminate a compiler warning
		03/19/96	even more respect for qGXViews and qGXPrinting
		 3/19/96	Respect qGXViews and qGXPrinting
		 3/19/96	Respect qGXViews and qGXPrinting
		 3/19/96	Changed parameter to TView::InitUView to be more intuitive
		 3/18/96	Made better use of TView calls that return CRect_AC/CViewPoint/CViewRect
		 3/15/96	More tweeking of code that uses [U]Geometry.h
		 3/14/96	Redefine many (non virtual) functions to return CRects and VRects as
		 					function results, and leave the old function overloaded to point to
							the new one.
		 3/14/96	Added TVew::DrawsWithQDGX which you override if your view draws with
		 					QDGX commands.
		 3/06/96	Corrected misaligned guard flag for qDrag in TView::DoSetCursor
		 3/04/96	Removed inlining for CSubViewIterator::FirstSubView/NextSubView to
		 					reduce code bulk.
		03/04/96	[1325889] Remove bogus comments refering to SetDynamicSize
							and 2.0 compatiblity.
		 3/01/96	Re-arranged data members of TView, natural alignment results in
		 					16 bytes per view less storage. Also, gave the collected bool fields a
		 					bitfield attribute which results in add'l savings of 14 bytes per view
		 					but increases code size by 280 bytes. Is paid for by the time you use 20
		 					views. Also, made all global variables and functions in this interface
		 					static TView members.
		 1/18/96	Made GetWindow const.
		02/20/96	[1326035] UpdateCoordinates minor temporary removed.
		02/15/96	[1322386] Fixed DragSupport on non-Drag enabled systems by checking
							for DragManager in DoPostCreate,SetDroppable,HandleMouseDown, and
							DoSetCursor. Changed Copyright to 1996.
		  1/23/95	[1301894] (Views) DeleteSubview can crash - MATest.
		  1/18/95	Made GetWindow const.
		12/20/95	Add RevealUndoRedo.
		 12/8/95	Split up includes for modular MacApp.
		----- 3.3 -----
		 11/21/95	[1302767] (Views) Contains Subview not optimal
		 11/9/95	[1260351] (Display) Non-Rectangular Regions in MacApp. The support
		 					in TView::ContainsMouse and TControl::ContainsMouse for GetExtentRegion
							was left out when Non-Rectangular Region support was originally checked-in.
							Or it was lost during an integration. Anyway, the support has been
							re-integrated and Non-Rectangular views work now.
		 11/1/95	Make drag cursor and script idle code resident.
		10/20/95	Handle kNoResource as result of GetWillDragCursorID and
							GetIsDraggingCursorID.
		10/17/95	TView::HandleMouse returns true if attempting to target
							the view fails. This prevents superviews from attempting
							to handle the event.
		10/13/95	Add TView::GetWillDragCursorID, GetIsDraggingCursorID.
							Add TToolboxEvent parameter to UpdateSelection.
		----- 3.3b1 -----
		 8/30/95	TView::DoFulfillPromise and DoMakeDragDropCommand do not
		 					call SubClassResponsibility() since they are called within
		 					a callback.
		 8/22/95	TView::HandleMouseDown doesn't set the target before
		 					looking at subviews (TEditText also changed).
		 8/08/95	Restore DoCheckPrinter to Add/RemovePrintHandle and BeInPort.
							Make DoCheckPrinter smarter.
		  8/5/95	1270673	sizeFillPages limits view dimension to 30000 pixels.
		  8/4/95	Change IsVisible to always return false if the view is not shown.
		  8/4/95	Cosmetic.
		  8/3/95	Move UpdateSelection implementation from .h file.
		  					HandleDragCursor calls DoGetDragProxy to test draggability.
							Don't register draggable views.
		  8/2/95	HandleDragCursor removes dragCursorRegion from cursorRegion
		  					and sets cursor to arrow.
		  8/2/95	Fix HandleDragCursor bugs: not iterating over views correctly.
		07/31/95	Use GetClipRegion
		07/30/95	Made fViewPerPage, fDeviceRes protected and added accessors.
		  8/1/95	Fix to compile with -noDrag.
		 7/31/95	Split DoSetDragCursor off of DoSetCursor and removed the
							EMouseDownType argument.
		 7/31/95	ClickThrough: HandleMouseDown and DoSetCursor take EMouseDownType
		 					params. Add fHandlesFirstClick.
		07/29/95	Added TWindow::BeginUpdate and EndUpdate as well as the global functions:
							GetUpdateRegion and GetVisRegion. Proper usage of these makes MacApp
							able to use the BeginUpdate and EndUpdate Traps. This allows using QD GX in MacApp
		07/27/95	combine cases for sizeVariable and default in ComputeFrame
		07/26/95	change fLastPrinterName to gLastPrinterName of static CStr255_AC, it doesn't need to be
							in the freestore and it is shared for the whole application.
							Removed RedoIt method of TPrintStyleChangeCommand and added default
							Parameter to IPrintStyleChangeCommand for isUndoable. The command is
							created and executed in all cases now. Changed PrinterDriverHasChanged
							to HasPrinterDriverChanged.
							StripToPage now takes a CViewPoint to identify the strip.
							Created a TPrinter object and a TPrintInfo object
		 7/28/95	Add configuration functions to use instead of gConfiguration.
		 6/26/95	HandleMouseDown didn't inval mouse rgns if view was disabled
		 5/18/95	TView::MakeLastSubView was inserting the view first.(Kevin Redden)
		 5/17/95	Some DragDrop methods call SubClassResponsibility.
		 					Remove support for automatically installing a 'View' flavor
		 					when dragging.
		 5/15/95	DoMakeDragOutlineRegion globalizes the region. It was being done
		 					in HandleDrag.
		 					TView doesn't promise and provide 'View' flavor anymore.
		 					Some drag methods call SubClassResponsibility.
		 5/15/95	Remove support for pre-system 7.
		 4/12/95	Conditionalize printf on qDebugMsg.
		 4/10/95	Include UStream.
		  4/9/95	Fix to the fix to the fix to HandleDraw.
		  4/3/95	HandleDraw only called HighlightAdorners and CompletedDrawing
		  					if the view being draw had subviews.
		 3/30/95	Replace AddDragContent with DoAddDragContent.
		 					Replace DoDrag with HandleDrag.
		 					Call DoGetDragProxy.
		 					Change FulfillPromise to DoFulfillPromise.
		 					Change DragEnter to DoDragEnter.
		 					Change DragWithin to DoDragWithin.
		 					Change DragLeave to DoDragLeave.
		 					Change IsDragMove to WillDragMove.
		 					Change MakeDragDropCommand to DoMakeDragDropCommand.
		 					Change GetDropLocationDescriptor to DoMakeDropLocationDescriptor.
		 					Change MakeDropHiliteRegion to DoMakeDropHiliteRegion.
		 					Change MakeDragCursorRegion to DoMakeDragCursorRegion.
		 					Change Make DragOutlineRegion to DoMakeDragOutlineRegion.
		 3/30/95	Fixed dragCursorRegion disposal in HandleMouseDown.
		 3/28/95	Change fDragMoveZone to fDragMoveDeterminer. Changed
		 					dragMoveZone constants to dragWithin constants.
		 3/28/95	HandleMouseDown wasn't removing dragCursorRegion when
		 					click was outside of drag region.
							Changed MakeDragTestRegion to MakeDragCursorRegion.
							WillDrag accepts a dragCursorRegion to reduce number of
							times MakeDragCursorRegion gets called.
							HandleMouseDown invals global mouse regions the view
							is draggable, since mouse downs are likely to affect the
							dragCursorRegion.
		 3/23/95	DoSetCursor handles NULL results from MakeDragTestRegion.
		 					Default MakeDragTestRegion returns nil.
		 3/22/95	Droppable views call RegisterDroppableView and
		 					UnregisterDroppableView instead of RegisterDragDropView
		 					and UnregisterDragDropView.
		 3/18/95	Use kNoZone instead of kNeverMove (undefined).
		 3/17/95	Update for new drag drop data. Remove constrainToWindow and
		 					constrainToScroller. Add dragMoveZone and dragMoveFamily.
		 3/17/95	MAVolatile.
		03/08/95	(SPEED) Rewrote HandleDraw.
							Add fCoordinatesAreInvalid, InvalidateCoordinates,
							GetVisibleExtent, GetQDOrigin, GetViewToQDOffset.
							Change ClipFurtherTo and OffsetAndClipFurtherTo to
							take a region instead of a rect.
		 3/16/95	Drag and drop cleanup.
		 3/16/95	Use CFlavorFlags.
		 3/15/95	Drag and drop face lift.
		 3/13/95	Change Free methods to destructors.
		 3/10/95	TView sends view stream as drop data.
		  3/9/95	IsDragMove returns true if the source and target are
		  					local. This is temporary.
		  3/6/95	Check if we have subviews before iterating over them.
							Change TView::Free so subviews can remove themselves safely
							while we are iterating over them.
		  3/7/95	Add LocalToWindowRegion for drop target hiliting.
		  3/5/95	Remove ReceiveDropCopy & ReceiveDropMove. Add
		  					MakeDragDropCommand.
		02/22/95	(SPEED) MacApp doesn't need to use lists to link subviews.
		 2/23/95	Split ReceiveDrop into ReceiveDropCopy and ReceiveDropMove.
		 2/19/95	Make parameter to WantsToDrag const.
		 2/19/95	Fix DoPostCreate and DoSetCursor to compile when !qDrag.
		02/13/95	Remove unnecessary initialization of static variables. See ARM §8.4
		02/07/95	1208481 InvalidateMouseRegions when moving a view.
		 2/17/95	Change the drag accessors so they can be called when
							qDrag is false.
							Use || instead of | for booleans.
		 2/17/95	TView::HandlesCursor returns true if the view is draggable
							whether or not it is enabled.
		 2/17/95	TView::HandleMouseDown sets the dragging cursor
							immediately after the click.  Disabled views can now
							drag.
		 2/16/95	TView::SetIsDroppable could have crashed if the view
							had a superview, but didn't live in a window.
		 2/14/95	GetDropLocationDescriptor now returns a bool.
		  2/9/95	Modify TView::DoSetCursor to set drag cursor when
							appropriate.
		  2/9/95	TView::HandleMouseDown initiates drags when appropriate.
		  2/8/95	Add TView::GetGlobalDragHiliteRegion.
		  2/6/95	TView::CanAcceptDrop tested if the mouse was in the view's
							extent rect. It now tests against the visible rect.  This
							fixes false hits on views like TTEView whose extents may
							be only partially visible.
		  2/3/95	Add the following to TView: WantsToDrag, GetDragRegion,
							DoAddDragFlavors, SendDragData.
		 1/24/95	Add TView::GetDropLocationDescriptor. Provides an AEDesc
							describing the drop target.
		  1/4/95	Add fDraggable, fDroppable, fConstrainToView,
							and fConstrainToWindow to TView.  Add accessors for each
							of the new data members.
		----- 3.5d3 Release -----
		11/12/94	Get rid of "not used" warnings in TrackDragInView
							and BecomeDropTarget.
		11/11/94	Conditionally compile in drag support when qDrag
							is true.
		   10/94	GSF		Remove TView::GetDragRegion and TView::DragFeedback
							as part of the transition to newer Drag design.
							Add the following to TView: CanAcceptDrop,
							CanAcceptFlavors, TrackDragInView, BecomeDropTarget,
							ResignDropTarget, ReceiveDrop.
		 9/23/94	Made TView::FindSubView "const" per David Gradwell's
							request.
		 9/13/94	Added TView::GetDragRegion and TView::DragFeedback.
							Modified TView::DoPostCreate to call PostCreate
							method of any attached behaviors.  This change
							involves the addition of the DoPostCreate
							method to behaviors.  All changes were per
							Eric Hanig's MADrag additions.
		 7/12/94	Fix GetDefaultHelpRegion to call the correct function
							(HandlesHelp instead of HandlesCursor).  Remove redundant
							call to LetsSubViewsHandleHelp. Fix suggested by Jeff
							Amfahr of Pharos. Also remove redundant call to
							LetsSubViewsHandleCursor in GetDefaultCursorRegion.
*/