//----------------------------------------------------------------------------------------
// UCommand.cpp
// Copyright © 1985-2001 by Apple Computer, Inc. All rights reserved.
//----------------------------------------------------------------------------------------

/*
	Change History
		07/20/01	[C] Write the clip view to the desk scrap. 
		05/21/01	Organize includes. 
		04/23/01	Protected gClipboardMgr fields. 
		01/02/01	Update copyright.
		11/10/00	Cosmetic.
		11/08/00	Fix old-style ProgramBreak, caught by PB. 
		10/11/00	Add PerformSelfSendCommand for use by the OSA dispatcher. 
					Postpone deleting the command until the OSA dispatcher returns
					to us. 
					Don't let a command be deleted while it is still owned by
					an undo handler. 
		09/07/00	Added embedded documentation.
		09/01/00	Stripped dead code.  Cosmetic and pragma unused's.
		06/02/00	[1685328] Remove try block in TServerCommand::Process.
		05/23/00	[2279264] Remove false from ProgramReport_AC. 
		03/31/00	[G] reinterpret_cast command, not static_cast, in PerformCommandAppleEvent.
		07/23/99	[C] ResumeAndFreeMessage creation change.
		03/24/99	Update copyright notice.
		03/19/99	Rename GetMessage to GetExceptionMessage
					since it conflicts with a Windows define.
		01/15/99	CAEDesc_AC is now in ACS. 
		10/08/98	Add DontUndo. 
					PerformUndoableCommand had two definitions of 'undoHandler' so
					it mistakenly thought the command went away. 
					Add AddActionToHistory. Fall back to PerformSimpleCommand if
					the command has no undo handler (context is application). 
					Copy methods from MPurgeable instead of mixing it in. Avoids
					overhead that is unnecessary because we're not dynamic casting. 
					Add comment warning about command deletion. 
					Add DeleteEvent. Add fDelete, CPostponeDelete. 
					MPurgeable. 
					PerformCommand and PerformCommandAppleEvent are now static
					functions in TCommand. Split up PerformCommand into three
					simpler functions. 
					Undo context. 
					Merge TCommandHandler into TEventHandler. 
					fContext and fHandler are the same. 
					Move fPriority to TCommand. 
					Move fFreeOnCompletion to TEvent. 
*/

#ifndef __UCOMMAND__
#include "UCommand.h"
#endif

// MacApp

#ifndef __UCLIPBOARDMGR__
#include "UClipboardMgr.h"
#endif

#ifndef __UCOMMANDHANDLER__
#include "UCommandHandler.h"
#endif

#ifndef __UCOREERRORMGR__
#include "UCoreErrorMgr.h"
#endif

#ifndef __UCOREGLOBALS__
#include "UCoreGlobals.h"
#endif

#ifndef __UCOREUTILITIES__
#include "UCoreUtilities.h"
#endif

#ifndef __UDEBUG__
#include "UDebug.h"
#endif

#ifndef __UDISPATCHER__
#include "UDispatcher.h"
#endif

#ifndef __UDOCUMENT__
#include "UDocument.h"
#endif

#ifndef __UGEOMETRY__
#include "UGeometry.h"
#endif

#ifndef __UMACAPPGLOBALS__
#include "UMacAppGlobals.h"
#endif

#ifndef __UMACAPPUTILITIES__
#include "UMacAppUtilities.h"
#endif

#ifndef __UMEMORY__
#include "UMemory.h"
#endif

#if qAppleEventAware
	#ifndef __USCRIPTING__
	#include "UScripting.h"
	#endif
#endif

#ifndef __UUNDO__
#include "UUndo.h"
#endif

#ifndef __UVIEW__
#include "UView.h"
#endif

// ACS

#ifndef __CDependencies_AC__
#include "CDependencies_AC.h"
#endif

// Toolbox

#ifndef __EVENTS__
#include <Events.h>
#endif

#ifndef __LOWMEM__
#include <LowMem.h>
#endif

// ANSI

#ifndef __STDIO__
#include <stdio.h>
#endif

#ifndef __STDLIB__
#include <stdlib.h>
#endif

//========================================================================================
// CLASS TCommand
//========================================================================================

//----------------------------------------------------------------------------------------
// TCommand constructor
//----------------------------------------------------------------------------------------

TCommand::TCommand(CommandNumber	itsCommandNumber,
				   TEventHandler*	itsContext,
				   bool				canUndo,
				   bool				causesChange,
				   MDependable_AC*	objectToNotify)
	:	TEvent(itsCommandNumber, NULL, itsContext ? itsContext : gDispatcher),
		fObjectToNotify(objectToNotify),
		fUndoHandler(NULL),
		fClipboardView(NULL),
		fUndoClipboardView(NULL),
		fUndoClipboardViewContext(NULL),
		fValidationError(noErr),				// Hasn't failed yet...
		fPriority(kPriorityNormal),				// Don't worry, be happy! 
		fCommandDone(false),
		fCanUndo(canUndo),
		fCausesChange(causesChange),
		fReadyToExecute(true),					// Always executable by default
		fRecurring(false),						// Command is a one-shot deal
		fUseAppleEvent(false),
		fChangesClipboard(false),
		fDelete(false)
{
}

//----------------------------------------------------------------------------------------
// TCommand destructor
//----------------------------------------------------------------------------------------

TCommand::~TCommand()
{
	if (fChangesClipboard)
	{
		AbandonClipboardView();
		AbandonUndoClipboardView();
	}

	if (fUndoHandler)
	{
		fUndoHandler->RemoveCommandAction(this);
		fUndoHandler = NULL;
	}

#if qDebug
	if (gDispatcher)
	{
		TCommandList* commandList = gDispatcher->GetCommandList();
		if (commandList && commandList->GetIdentityItemNo(this))
			ProgramBreak_AC("You are trying to free an command that is still on the command queue.");
	}
#endif
}

//----------------------------------------------------------------------------------------
// TCommand::AbandonClipboardView
//----------------------------------------------------------------------------------------

void TCommand::AbandonClipboardView()
// The AbandonClipboardView method releases the clipboard view held by this 
// object, unless it is the view owned by the clipboard manager in gClipboardMgr, in
// which case this method simply removes its pointer to the view.
// This method calls TView::FreeFromClipboard, which allows other views to 
// prevent the view from being deleted if they still have references to the
// clipboard view.
//
// Call?		Seldom.
// Override?	Seldom.
{
//	fClipboardView is owned by this command, which created it, unless it
//	is the current clipboard, in which case it is owned by gClipboardMgr.

// Note:: TView::FreeFromClipboard calls gClipboardMgr->Changed
// so that if another command has a reference to this fClipboardView
// in its fUndoClipboardView field, it can NULL it.

	if (fClipboardView)
	{
		if (fClipboardView == gClipboardMgr->GetClipView())
			gClipboardMgr->ResetClipContext();
		else
		{
			fClipboardView->FreeFromClipboard();
			fClipboardView = NULL;
		}
	}
}

//----------------------------------------------------------------------------------------
// TCommand::AbandonClipboardView
//----------------------------------------------------------------------------------------

void TCommand::AbandonUndoClipboardView()
// The AbandonUndoClipboardView method releases the undo clipboard view held 
// by this object, unless it is the view owned by the clipboard manager in gClipboardMgr.
// This method calls TView::FreeFromClipboard, which allows other views to 
// prevent the view from being deleted if they still have references to the
// clipboard view.
//
// Call?		Seldom.
// Override?	Seldom.
{
// Note:: TView::FreeFromClipboard calls gClipboardMgr->Changed
// so that if another command has a reference to this fUndoClipboardView
// in its fClipboardView field, it can NULL it.

	if (fUndoClipboardView
		&& (fUndoClipboardView != gClipboardMgr->GetClipView())
		&& (!fUndoClipboardViewContext || (fUndoClipboardViewContext == fContext))	)
	{
		fUndoClipboardView->FreeFromClipboard();
		fUndoClipboardView = NULL;
	}
}

//----------------------------------------------------------------------------------------
// TCommand::PrepareForUndoRedo:
//----------------------------------------------------------------------------------------

void TCommand::PrepareForUndoRedo()
{
	if (fContext)
		fContext->PrepareForUndoRedo(this);
}

//----------------------------------------------------------------------------------------
// TCommand::FinishUndoRedo:
//----------------------------------------------------------------------------------------

void TCommand::FinishUndoRedo()
{
	if (fChangesClipboard)
		UndoRedoClipboard();

	fCommandDone = !fCommandDone;
	DoNotification();
}

//----------------------------------------------------------------------------------------
// TCommand::RevealUndoRedo:
//----------------------------------------------------------------------------------------

void TCommand::RevealUndoRedo()
{
	if (fContext)
		fContext->RevealUndoRedo(this);
}

//----------------------------------------------------------------------------------------
// TCommand::Completed:
//----------------------------------------------------------------------------------------

void TCommand::Completed()
// Completed is intended to perform any action necessary after the command 
// has been done (and committed if the command was undoable), or any actions
// necessary if failure occurs during the DoIt-UndoIt-RedoIt cycle. TCommand::Completed
// is an empy method; it must be overridden to take action.
//
// Call?		Seldom.
// Override?	As needed.
{
}

//----------------------------------------------------------------------------------------
// TCommand::DoIt:
//----------------------------------------------------------------------------------------

void TCommand::DoIt()
{
}

//----------------------------------------------------------------------------------------
// TCommand::GetChangeID:
//----------------------------------------------------------------------------------------

ChangeID_AC TCommand::GetChangeID()
{
	return fIdentifier;
}

//----------------------------------------------------------------------------------------
// TCommand::IsReadyToExecute:
//----------------------------------------------------------------------------------------

bool TCommand::IsReadyToExecute()
{
	return fReadyToExecute;
}

//----------------------------------------------------------------------------------------
// TCommand::IsRecurring:
//----------------------------------------------------------------------------------------

bool TCommand::IsRecurring()
{
	return fRecurring;
}

#if qAppleEventAware

//----------------------------------------------------------------------------------------
// TCommand::MakeAppleEvent:
//----------------------------------------------------------------------------------------

TAppleEvent* TCommand::MakeAppleEvent()
{
	return NULL;
}

#endif

//----------------------------------------------------------------------------------------
// TCommand::DontUndo:
//----------------------------------------------------------------------------------------

void TCommand::DontUndo()
{
	fCanUndo = false;
	if (fUndoHandler)
	{
		fUndoHandler->RemoveCommandAction(this);
		fUndoHandler = NULL;
	}
}

//----------------------------------------------------------------------------------------
// TCommand::DoNotification:
//----------------------------------------------------------------------------------------

void TCommand::DoNotification()
{
	// Notify the proper object that a change has occurred
	if (WillCauseChange() && fObjectToNotify)
	{
		ChangeID_AC theChange;
		if (fCommandDone)
			theChange = GetChangeID();
		else
			theChange = cUndo;
		fObjectToNotify->Changed(theChange, this);
	}
}

//----------------------------------------------------------------------------------------
// TCommand::SetupDependencies:
//----------------------------------------------------------------------------------------

void TCommand::SetupDependencies()
{
	if (CanBeUndone())
	{
		fContext->AddDependent(this);
		if (fChangesClipboard || (fIdentifier == cPaste))
			gClipboardMgr->AddDependent(this);
	}
}

//----------------------------------------------------------------------------------------
// TCommand::DoUpdate:
//----------------------------------------------------------------------------------------

void TCommand::DoUpdate(ChangeID_AC				theChange,
						MDependable_AC*			changedObject,
						void*					changeData,
						CDependencySpace_AC*	dependencySpace)
{
	#pragma unused (dependencySpace)

	switch (theChange)
	{
		case mClipViewChanged:
			// This code appears to be there to support Paste commands
			// whose RedoIt methods go back to the clipboard document for the
			// data to paste. *** This won't work with multiple undo. ***
			// From now on, commands need to save all the data needed for
			// their UndoIt and RedoIt methods.

			//	if ((changedObject == gClipboardMgr) &&
			//		(fIdentifier == cPaste))
			//		fContext->CommitLastCommand();
			break;

		case mFreeClipboardView:
			if (changedObject == gClipboardMgr)
				if (changeData == fUndoClipboardView)
				{
					fUndoClipboardView = NULL;
					fUndoClipboardViewContext = NULL;
				}
				else if (changeData == fClipboardView)
					fClipboardView = NULL;
			break;

		case mClosed:
			if ((changedObject == fContext)
				|| (theChange == mScrapChanged))
				fContext->CommitLastCommand();
			break;
	}
}

//----------------------------------------------------------------------------------------
// TCommand::RedoIt:
//----------------------------------------------------------------------------------------

void TCommand::RedoIt()
{
	DoIt();
}

//----------------------------------------------------------------------------------------
// TCommand::ShouldFreeOnCompletion:
//----------------------------------------------------------------------------------------

bool TCommand::ShouldFreeOnCompletion()
{
	return (fFreeOnCompletion && !fRecurring && !fUndoHandler);
}

//----------------------------------------------------------------------------------------
// TCommand::UndoIt:
//----------------------------------------------------------------------------------------

void TCommand::UndoIt()
{
}

//----------------------------------------------------------------------------------------
// TCommand::Process:
//----------------------------------------------------------------------------------------

void TCommand::Process()
{
	PerformCommand(this);
	
	// WARNING: 'this' may be deleted inside PerformCommand! 
	// It is NOT safe to access any fields or call any functions 
	// of the command after this point. 
}

//----------------------------------------------------------------------------------------
// TCommand::SetValidationError:
//----------------------------------------------------------------------------------------

void TCommand::SetValidationError(OSErr	validationError)
{
	fValidationError = validationError;
}

//----------------------------------------------------------------------------------------
// TCommand::Abort:
//----------------------------------------------------------------------------------------

void TCommand::Abort()
{
	// Try to remove the command in case it is no longer recurring.
	gDispatcher->RemoveCommand(this);

	if (gClipboardMgr->GetClipView() && gClipboardMgr->GetClipView() == fClipboardView)
	{
		gClipboardMgr->SetClipView(fUndoClipboardView, fUndoClipboardViewContext);
		fUndoClipboardView = NULL;
#if qCarbon
		// In Carbon we want to make the clip data available right away.
		gClipboardMgr->WriteToDeskScrap();
#endif
	}

	if (fCommandDone && CanBeUndone())
	{
		UndoIt();
		if (fChangesClipboard)
			UndoRedoClipboard();
		fCommandDone = false;
		DoNotification();
	}

	Completed();
}

//----------------------------------------------------------------------------------------
// TCommand::ClaimClipboard:
//----------------------------------------------------------------------------------------

void TCommand::ClaimClipboard(TView* clipboardView)
// ClaimClipboard method acquires the view specified by clipboardView 
// as the current clipboard view and updates the undo information for the clipboard.
//
// clipboardView:	Specifies the view object to claim.
//
// Call?		As needed.
// Override?	Seldom.
{
	// For RedoIt only
	AbandonUndoClipboardView();

	fUndoClipboardView = gClipboardMgr->GetClipView();	// Copy current clipboard contents to the
														// Undo side
	fUndoClipboardViewContext = fContext;				// gClipboardMgr->fClipContext;
	if (clipboardView)
	{
		gClipboardMgr->SetClipView(clipboardView, fContext);			// Will install it as fClipView
		fClipboardView = clipboardView;
#if qCarbon
		// In Carbon we want to make the clip data available right away.
		gClipboardMgr->WriteToDeskScrap();
#endif
	}
#if qDebugMsg
	else
		ProgramBreak_AC("Claiming clipboard with NULL view");
#endif
}

//----------------------------------------------------------------------------------------
// TCommand::UndoRedoClipboard:
//----------------------------------------------------------------------------------------

void TCommand::UndoRedoClipboard()
{
	if (fCommandDone)
	{
		// Undoing
		if (fUndoClipboardView && (gClipboardMgr->GetClipContext() == fContext))
		{
			gClipboardMgr->SetClipView(fUndoClipboardView, fUndoClipboardViewContext);
#if qCarbon
			// In Carbon we want to make the clip data available right away.
			gClipboardMgr->WriteToDeskScrap();
#endif
		}
	}
	else if (fValidationError == noErr)
	{
		// Redoing
		ClaimClipboard(fClipboardView);
	}
}

//----------------------------------------------------------------------------------------
// TCommand::TotalSize: 
//----------------------------------------------------------------------------------------

Size TCommand::TotalSize(bool justLocked) const
{
	#pragma unused (justLocked)

	return 0;
}

//----------------------------------------------------------------------------------------
// TCommand::Purge: 
//----------------------------------------------------------------------------------------

Size TCommand::Purge(Size needed)
{
	#pragma unused (needed)

	return 0;
}

//----------------------------------------------------------------------------------------
// TCommand::AddToHistory:
//----------------------------------------------------------------------------------------

bool TCommand::AddToHistory()
{
	if (fCanUndo && !fUndoHandler && fContext)
	{
		TUndoHandler* undoHandler = fContext->GetUndoHandler();
		if (undoHandler)
		{
			undoHandler->AddActionToHistory(this, fIdentifier);
			fUndoHandler = undoHandler;
		}
	}

	return fUndoHandler;
}

//----------------------------------------------------------------------------------------
// TCommand::PerformCommand:
//----------------------------------------------------------------------------------------

void TCommand::PerformCommand(TCommand* command)
{
#if qDebug
	ThrowIfNonObject_AC(command);
#endif
	// A command can't have an error before it is performed. 
	command->SetValidationError(noErr);

#if qDebugMsg
	if (gIntenseDebugging)
		ProgramReport_AC("The Command to perform: %s\n", typeid(*command).name());
#endif

#if qAppleEventAware
	// Postpone deleting the command until the OSA dispatcher returns to us. 
	CPostponeDelete holdit(command);

	// Try performing the command as an Apple Event
	if (command->GetUseAppleEvent() && PerformCommandAppleEvent(command))
	{
		// The command has been successfully converted to an Apple Event
		// and performed as an Apple Event. We don't need it any more. 
		CompleteCommand(command);
	}
	else
#endif // qAppleEventAware
	if (command->CanBeUndone() && command->AddToHistory())
	{
		PerformUndoableCommand(command);
	}
	else
	{
		PerformSimpleCommand(command);
	}
}

//----------------------------------------------------------------------------------------
// TCommand::CompleteCommand
//----------------------------------------------------------------------------------------

TCommand* TCommand::CompleteCommand(TCommand* command)
{
	if (command)
	{
#if qDebug
		ThrowIfNonObject_AC(command);
#endif
		//	if (command->fCommandDone)
		//		command->Commit();

		command->Completed();
		command = DeleteCommand(command);
	}

	return command;
}

//----------------------------------------------------------------------------------------
// TCommand::DeleteCommand
//----------------------------------------------------------------------------------------

TCommand* TCommand::DeleteCommand(TCommand* command)
{
	// Delete the command if it is to be freed on completion
	command = reinterpret_cast<TCommand*>(DeleteEvent(command));

	// Maybe the command can't be deleted now because it is in use,
	// so mark it for later deletion. 
	if (command)
		command->fDelete = true;

	return command;
}

//----------------------------------------------------------------------------------------
// TCommand::PerformSelfSendCommand:
//----------------------------------------------------------------------------------------

void TCommand::PerformSelfSendCommand(TCommand* command)
{
#if qDebug
	ThrowIfNonObject_AC(command);
#endif
	// A command can't have an error before it is performed. 
	command->SetValidationError(noErr);

	if (command->CanBeUndone() && command->AddToHistory())
	{
		PerformUndoableCommand(command);
	}
	else
	{
		PerformSimpleCommand(command);
	}
}

#if qAppleEventAware

//----------------------------------------------------------------------------------------
// TCommand::PerformCommandAppleEvent:
//----------------------------------------------------------------------------------------

bool TCommand::PerformCommandAppleEvent(TCommand* command)
{
	OSErr dispatchError = noErr;
	long processError = 0L;
	
	CAutoPtr_AC<TAppleEvent> sendEvent;
	CAutoPtr_AC<TAppleEvent> resultEvent;
	
	try
	{
		sendEvent = command->MakeAppleEvent();
		if (sendEvent)
		{
#if qDebug
			Assertion_AC(sendEvent->GetSendingMode() != kAEQueueReply,
						 "Command-based apple events must be sent synchronously");
#endif

#if qOptimizeSelfSendAevt
			sendEvent->SetTransactionID(reinterpret_cast<long>(command));
			COptimizeCommand optimizeSendEvent(command);
#endif
			TAppleEvent* tempEvent = resultEvent;
			dispatchError = sendEvent->SendEvent(tempEvent);
			resultEvent = tempEvent;
		}
	}
	catch(CException_AC& theException)
	{
		DoCatchMessage_AC(theException);
		dispatchError = theException.GetError();
	}
	
	
	if (dispatchError == noErr && resultEvent)
	{
		try
		{
			if (resultEvent->HasParameter(keyErrorNumber))
				processError = resultEvent->ReadLong(keyErrorNumber);
		}
		catch(CException_AC& theException)
		{
			DoCatchMessage_AC(theException);
			// ignore the error
		}
	}
	
	return dispatchError == noErr && !processError;
}

#endif // qAppleEventAware

//----------------------------------------------------------------------------------------
// TCommand::PerformUndoableCommand:
//----------------------------------------------------------------------------------------

void TCommand::PerformUndoableCommand(TCommand* command)
{
#if qDebug
	ThrowIfNonObject_AC(command);
#endif

	TUndoHandler* undoHandler = command->GetUndoHandler();
	ThrowIfNonObject_AC(undoHandler);

	try
	{
		// Don't proceed if we've already had an error
		ThrowIfOSErr_AC(command->GetValidationError());

		// Purge the undo stack in case the command puts it over its maximum
		undoHandler->AboutToDo(command);

		command->DoIt();

#if qDebugMsg
		// Check if the command made itself go away
		if (!undoHandler->Contains(command))
			ProgramReport_AC("Command made itself go away. Don't do that!");
#endif
		command->SetCommandDone(true);
	}
	catch(CException_AC& theException)
	{
		DoCatchMessage_AC(theException);
#if qDebugMsg
		if (!undoHandler->Contains(command))
			ProgramReport_AC("Command made itself go away. Don't do that!");
#endif
		command->SetValidationError(theException.GetError());

		// Save the ID because the command is going away. 
		short id = command->GetIdentifier();

		// Abort the current transaction in the undo handler. 
		undoHandler->Abort();
		command = NULL;	// Abort deletes all the commands in the transaction
		
		ThrowNewMessage_AC(theException.GetError(), theException.GetExceptionMessage(), CException_AC::BuildMessage(id, messageCommandError));
	}

	// This is done after DoIt, so DoIt can change the fCausesChange flag. 
	command->DoNotification();
	
	// Try to remove the command in case it is no longer recurring.
	gDispatcher->RemoveCommand(command);
	
	// Set up for undo
	command->SetupDependencies();
}

//----------------------------------------------------------------------------------------
// TCommand::PerformSimpleCommand:
//----------------------------------------------------------------------------------------

void TCommand::PerformSimpleCommand(TCommand* command)
{
#if qDebug
	ThrowIfNonObject_AC(command);
#endif

	try
	{
		// Don't proceed if we've already had an error
		ThrowIfOSErr_AC(command->GetValidationError());

		command->DoIt();
		command->SetCommandDone(true);
	}
	catch(CException_AC& theException)
	{
		DoCatchMessage_AC(theException);

		command->SetValidationError(theException.GetError());
		
		// Save the ID because the command is going away. 
		short id = command->GetIdentifier();

		// Try to remove the command in case it is no longer recurring.
		gDispatcher->RemoveCommand(command);

		DeleteCommand(command);
		
		ThrowNewMessage_AC(theException.GetError(), theException.GetExceptionMessage(), CException_AC::BuildMessage(id, messageCommandError));
	}

	// This is done after DoIt, so DoIt can change the fCausesChange flag. 
	command->DoNotification();
	
	// Try to remove the command in case it is no longer recurring.
	gDispatcher->RemoveCommand(command);
	
	// Done, so get rid of it
	CompleteCommand(command);
}


//========================================================================================
// CLASS CPostponeDelete
//========================================================================================

//----------------------------------------------------------------------------------------
// CPostponeDelete constructor
//----------------------------------------------------------------------------------------

CPostponeDelete::CPostponeDelete(TCommand* command)
	:	fCommand(command),
		fOldFreeOnCompletion(false)
{
	set(fCommand);
}

//----------------------------------------------------------------------------------------
// CPostponeDelete constructor
//----------------------------------------------------------------------------------------

CPostponeDelete::CPostponeDelete(const CPostponeDelete& toCopy)
	:	fCommand(toCopy.release()),
		fOldFreeOnCompletion(false)
{
	set(fCommand);
}

//----------------------------------------------------------------------------------------
// CPostponeDelete::operator =
//----------------------------------------------------------------------------------------

void CPostponeDelete::operator = (TCommand* command)
{
	if (fCommand != command)
	{
		reset();
		set(command);
	}
}

//----------------------------------------------------------------------------------------
// CPostponeDelete::operator =
//----------------------------------------------------------------------------------------

CPostponeDelete& CPostponeDelete::operator = (const CPostponeDelete& command)
{
	if (this != &command)
	{
		if (*this != command)
			reset();
	
		set(command.release());
	}
	return *this; 
}

//----------------------------------------------------------------------------------------
// CPostponeDelete::reset
//----------------------------------------------------------------------------------------

void CPostponeDelete::reset()
{
	if (fCommand)
	{
		fCommand->SetFreeOnCompletion(fOldFreeOnCompletion);
		if (fCommand->GetDelete())
			fCommand = TCommand::DeleteCommand(fCommand);
	}
}

//----------------------------------------------------------------------------------------
// CPostponeDelete::release
//----------------------------------------------------------------------------------------

TCommand* CPostponeDelete::release() const
{
	TCommand* old = fCommand;
	const_cast<CPostponeDelete*>(this)->fCommand = NULL;
	if (old)
		old->SetFreeOnCompletion(fOldFreeOnCompletion);
	return old;
}

//----------------------------------------------------------------------------------------
// CPostponeDelete::set
//----------------------------------------------------------------------------------------

void CPostponeDelete::set(TCommand* command)
{
	fCommand = command;
	if (fCommand)
		fOldFreeOnCompletion = fCommand->SetFreeOnCompletion(false);
}


#if qAppleEventAware

//========================================================================================
// CLASS TAppleCommand
//========================================================================================

//----------------------------------------------------------------------------------------
// TAppleCommand destructor
//----------------------------------------------------------------------------------------

TAppleCommand::~TAppleCommand()
{
}

//----------------------------------------------------------------------------------------
// TAppleCommand::FreeTheMessage:
//----------------------------------------------------------------------------------------

void TAppleCommand::FreeTheMessage()
{
	fMessage.reset();
	fReply.reset();
}

//----------------------------------------------------------------------------------------
// TAppleCommand::TotalSize: 
//----------------------------------------------------------------------------------------

Size TAppleCommand::TotalSize(bool justLocked) const
{
	Size totalSize = TCommand::TotalSize(justLocked);

	if (fMessage)
		totalSize += fMessage->TotalSize(justLocked);

	if (fReply)
		totalSize += fReply->TotalSize(justLocked);

	return totalSize;
}

//========================================================================================
// CLASS TServerCommand
//========================================================================================

//----------------------------------------------------------------------------------------
// TServerCommand constructor
//----------------------------------------------------------------------------------------

TServerCommand::TServerCommand(CommandNumber	itsCommandNumber,
							   TEventHandler*	itsContext,
							   bool				canUndo,
							   bool				causesChange,
							   MDependable_AC*	objectToNotify,
							   TAppleEvent*		itsMessage,
							   TAppleEvent*		itsReply,
							   bool				suspendTheEvent)
	:	TAppleCommand(itsCommandNumber, itsContext, canUndo, causesChange, objectToNotify,
					  itsMessage, itsReply),
		fRequiresUserInteraction(false),
		fSuspendTheEvent(suspendTheEvent),
		fReplySent(false)
{
	// Inform the AppleEvent manager that this event will be processed asynchronously.
	// Any reply that needs to be returned will be returned in TServerCommand::Completed().
	if (fSuspendTheEvent)
		AESuspendTheCurrentEvent(fMessage);
}

//----------------------------------------------------------------------------------------
// TServerCommand constructor
//----------------------------------------------------------------------------------------

TServerCommand::TServerCommand(CommandNumber		itsCommandNumber,
							   TEventHandler*		itsContext,
							   bool					canUndo,
							   bool					causesChange,
							   MDependable_AC*		objectToNotify,
							   const AppleEvent&	itsMessage,
							   const AppleEvent&	itsReply,
							   bool					suspendTheEvent)
	:	TAppleCommand(itsCommandNumber, itsContext, canUndo, causesChange, objectToNotify,
					  TH_new TAppleEvent(itsMessage, false), TH_new TAppleEvent(itsReply, false)),
		fRequiresUserInteraction(false),
		fSuspendTheEvent(suspendTheEvent),
		fReplySent(false)
{
	// Inform the AppleEvent manager that this event will be processed asynchronously.
	// Any reply that needs to be returned will be returned in TServerCommand::Completed().
	if (fSuspendTheEvent)
		AESuspendTheCurrentEvent(fMessage);
}

//----------------------------------------------------------------------------------------
// TServerCommand destructor
//----------------------------------------------------------------------------------------

TServerCommand::~TServerCommand()
{
}

//----------------------------------------------------------------------------------------
// TServerCommand::Completed:
//----------------------------------------------------------------------------------------

void TServerCommand::Completed()
{
	if (!fMessage.IsNULL() && !fReply.IsNULL())
		ResumeAndFreeMessage();
}

//----------------------------------------------------------------------------------------
// TServerCommand::Process:
//----------------------------------------------------------------------------------------

void TServerCommand::Process()
{
	if (fRequiresUserInteraction)
	{
		try
		{
			ThrowIfOSErr_AC(MAInteractWithUser());
		}
		catch(CException_AC& theException)
		{
			DoCatchMessage_AC(theException);
			SetValidationError(theException.GetError());
			throw;
		}
	}

	TAppleCommand::Process();
}

//----------------------------------------------------------------------------------------
// TServerCommand::ResumeAndFreeMessage:
//----------------------------------------------------------------------------------------

void TServerCommand::ResumeAndFreeMessage()
{
	// If the event has been suspended then resume it and free the message.
	if (fSuspendTheEvent)
	{
		// Inform the AppleEvent manager that we are through processing the event. If an error
		// has occurred the default reply will contain the error number and error string.
#if !qMSWindows && !qCarbon
		AEEventHandlerUPP dispatcher = static_cast<AEEventHandlerUPP>(kAENoDispatch);
#else
		// VC++ Can't handle the conversion from enum to AEEventHandlerUPP.
		AEEventHandlerUPP dispatcher = NULL;
#endif

		AEResumeTheCurrentEvent(fMessage, fReply, dispatcher, 0);
		fReplySent = true;
	}
	// Free the message and its reply since they are no longer valid
	FreeTheMessage();
}

//----------------------------------------------------------------------------------------
// TServerCommand::SetValidationError:
//----------------------------------------------------------------------------------------

void TServerCommand::SetValidationError(OSErr error)
{
	if (error != noErr)
	{
		// The finder passes a null reply with required events
		// so don't try to stuff any info into the reply
		if (!fReply.IsNULL() && fReply->descriptorType != typeNull)
			fReply->WriteOSError(error);
	}
	TAppleCommand::SetValidationError(error);
}

//========================================================================================
// CLASS TClientCommand
//========================================================================================

//----------------------------------------------------------------------------------------
// TClientCommand constructor
//----------------------------------------------------------------------------------------

TClientCommand::TClientCommand(CommandNumber itsCommandNumber,
							   TEventHandler* itsContext,
							   bool canUndo,
							   bool causesChange,
							   MDependable_AC* objectToNotify,
							   TAppleEvent* theMessage)
	:	TAppleCommand(itsCommandNumber, itsContext, canUndo, causesChange, objectToNotify,
					  theMessage),
		fMessageSent(false)
{
}

//----------------------------------------------------------------------------------------
// TClientCommand destructor
//----------------------------------------------------------------------------------------

TClientCommand::~TClientCommand()
{
}

//----------------------------------------------------------------------------------------
// TClientCommand::GetReturnID:
//----------------------------------------------------------------------------------------

long TClientCommand::GetReturnID()
{
	return !fMessage.IsNULL() ? fMessage->GetReturnID() : 0;
}

//----------------------------------------------------------------------------------------
// TClientCommand::IsReadyToPost:
//----------------------------------------------------------------------------------------

bool TClientCommand::IsReadyToPost()
{
	bool ready = true;

	if (!fMessage.IsNULL())
	{
		if (!fMessageSent)
		{
			if ((fMessage->GetSendingMode() & kAEReplyModeMask) == kAEWaitReply)
			{
				TAppleEvent* theReply = NULL;

				theReply = SendMessage();
				ProcessReply(theReply);
			}
			else if ((fMessage->GetSendingMode() & kAEReplyModeMask) == kAEQueueReply)
			{
				SendMessage();	// No reply will be returned
				TOSADispatcher::fgDispatcher->PostPendingReplyCommand(this);
				ready = false;
			}
		}
		else if (((fMessage->GetSendingMode() & kAEReplyModeMask) == kAEQueueReply)
				 && fReply.IsNULL())
			ready = false;				// Even though the message has been sent we still
										// haven't received our reply so don't post it yet.
	}
	return ready;
}

//----------------------------------------------------------------------------------------
// TClientCommand::SendMessage:
//----------------------------------------------------------------------------------------

TAppleEvent* TClientCommand::SendMessage()
{
	TAppleEvent* returnVal = NULL;

	if (!fMessage.IsNULL())
	{
		fMessageSent = true;
		returnVal = fMessage->Send();
	}

	return returnVal;
}

//----------------------------------------------------------------------------------------
// TClientCommand::ProcessReply:
//----------------------------------------------------------------------------------------

void TClientCommand::ProcessReply(TAppleEvent* theReply)
{
	fReply = theReply;

	// Check for errors in the reply.
	long 	errorNumber;
	CStr255_AC	errorString;
	theReply->ReadError(errorNumber, errorString);

	if ((errorNumber != noErr) || !errorString.IsEmpty())
	{
		if (gDispatcher)
			gDispatcher->ReportReplyError(fIdentifier, (OSErr)errorNumber, errorString);
	}
}

//----------------------------------------------------------------------------------------
// TClientCommand::DoIt:
//----------------------------------------------------------------------------------------

void TClientCommand::DoIt()
{
	if (!fMessage.IsNULL()
		&& ((fMessage->GetSendingMode() & kAEReplyModeMask) == kAENoReply))
		SendMessage();
}

#endif	// #if qAppleEventAware

//----------------------------------------------------------------------------------------
// End of UCommand.cpp


/*
	Historical Change Record:
		----- R11 -----
		06/26/96	Changed nil back to NULL.
		06/26/96	Install release marker.  Scope many globals.  Change TRUE/FALSE/NULL.
		06/26/96	==/!=NULL to implicit tests, except in the case of assignment to or passing/returning as bool/bool.
		05/09/96	Adjust the Failure Handling macros to allow for easy switching to native exceptions.
		05/08/96	Made TAppleEvent derive from CAEDesc_AC as well as TObject.
		05/03/96	Use FailNonObject for object testing diagnostics.
		04/30/96	Make all constructors use initialization lists if they weren't already
							doing do. Switch several more empty constructors to inlines.
		04/23/96	Use CTempObject/Handle/Region/Ptr, etc.
		04/15/96	Made TCommand MDependable_AC
		----- R10 -----
		04/03/96	OSEvents.h merged into Events.h.
		03/26/96	Cleanup references to gEmptyString and ""
		12/20/95	Add PrepareForUndoRedo, FinishUndoRedo and RevealUndoRedo.
		12/19/95	Commit is not compatible with multiple undo. Developers
							should move their Commit code to the command destructors.
							Add Abort method.
		12/18/95	Remove fLinkedCommand, fLinkIdentity and LinkToSecondary.
		12/08/95	Bring back MAInteractWithUser.
		11/29/95	Move TTracker to UTracker.
							Move TInvalCursorCommand to UCommand.
							Split up includes for modular MacApp.
		----- 3.3 -----
		11/01/95	Use kMacAppTimeout in calls to InteractWithUser.
		10/10/95	Call gDispatcher->InteractWithUser.
		10/03/95	Replaced use of obsoleted trackRelease with trackEnd.
		----- 3.3b1 -----
		09/06/95	Added another IAppleCommand.
		08/30/95	Added ResumeAndFreeMessage.
		08/30/95	Add TInvalCursorCommand.
		08/22/95	Add TCommand::LinkToSecondary, SetValidationError and
		 					fValidationError. Remove fValidationFailed.
		08/22/95	Replaced most of ReportError with a call to WriteOSError.
							Replaced TServerCommand::ReportError with SetValidationError.
		08/22/95	Add TCommand::linkIdentity.
		08/22/95	Had to make accomodations in TServerCommand::Process
		 					for not passing on errors already reported to an AE client
							and to catch the user cancelled error.
		08/14/95	Add overloaded initializers for TServerCommand.
							IServerCommand replaces InitializeFromAppleEvent.
		08/08/95	Don't free recurring commands in TCommand::ShouldFreeOnCompletion.
		07/30/95	Cleaned up TCommand::DoUpdate
		07/30/95	Include UWindow to get GetVisRegion.
		07/29/95	Added TWindow::BeginUpdate and EndUpdate as well as the global functions:
							GetUpdateRegion and GetVisRegion. Proper usage of these makes MacApp
							able to use the BeginUpdate and EndUpdate Traps. This allows using QD GX in MacApp
		07/28/95	Add configuration functions to use instead of gConfiguration.
		07/26/95	Move TExecuteScriptCommand to UOSAScript.
		06/29/95	TClientCommand::ProcessReply calls TAppleEvent::ReadError.
		06/28/95	Change DoMakeDoItAppleEvent to MakeAppleEvent.
		 					Change fUseDoItAppleEvent to fUseAppleEvent.
		05/17/95	#Include for USegments
		06/12/95	Support TOSADispatcher::fgDispatcher,  TAppleEvent::fgIdleProc,
		 					COSAScript::GetGlobalScript
							Add TCommand::DoMakeDoItAppleEvent() and fUseDoItAppleEvent (names may change)
		05/25/95	TCommand::TCommand uses meminitializer list
		05/16/95	WindowRef
		03/15/95	Check if gDispatcher is there before calling it.
		03/13/95	Change Free methods to destructors.
		03/10/95	Add fValidationFailed. Add CommitACommand.
		03/07/95	TCommand::Free sets fLinkedCommand->fLinkedCommand to nil.
		03/05/95	Add fLinkedCommand.
		02/14/95	Second batch of attachability changes.
							TExecuteScriptCommand:: DoIt now runs the command
							through the global script if there is one.
		01/26/95	Add TExecuteScriptCommand.
		11/07/94	Added qSegments.
		09/26/94	Removed TClientCommand::ProcessReply local variables
							typeCode and actualSize.  They were causing unused
							variable warnings in CFront.
		09/23/94	Modified to support new TScriptEventDispatcher
							object.
		09/14/94	Changed TServerCommand to not suspend incoming
							events by default.
*/