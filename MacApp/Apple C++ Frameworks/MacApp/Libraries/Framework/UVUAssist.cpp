// UVUAssist.cpp
// Copyright © 1991-2001 by Apple Computer, Inc., all rights reserved.

//	Contains:	VU assistance methods
//	Version: 2.0d1 - MacApp 3.1 compatible version

/*
	Change History
		03/01/01	Don't include Windows_AC. 
		01/02/01	Update copyright.
		12/08/99	Fixed file name in banner.
		07/23/99	Use CountMenuItems instead of CountMItems.
		03/24/99	Update copyright notice.
*/

/*
Historical Note:  References to the "Mole" are equivalent to references to "Agent VU".
"Agent VU" was previously called the "Mole".

The mole sees MacApp windows as plain windows that are empty.  MacApp
doesn't put its controls in the control list, so V.U. won't even see standard
Control Manager controls.  The assistance proc updates the mole buffer before
it is sent back to the V.U. host, telling it that there are items in the windows, 
and telling it about each item.  We tell it that the windows are dialogs, 
because V.U. looks for a wider range of user interface items in dialogs.

V.U. has its own hierarchy of user interface items, based largely on the types of 
interface items defined in Inside Mac which V.U. can obtain information about
in non-MacApp applications.  MacApp's user interface element hierarchy is the view hierarchy.  
Since the two hierarchies are not the same, VUAssist must perform a mapping between the
two hierarchies.  Many of these mappings are straight-forward, but a few require some
explanation.  The V.U. interface item hierarchy is as follows.  

				|___ staticText
				|					   
				|___ editText					   
				|					   				   
				|___ picture
contentItem-----|
				|___ icon					   
				|					   				   
				|___ userItem
				|
				|___ control-----|___ button
							 	 |					   
							 	 |___ checkBox
								 |
								 |___ radioButton
							 	 |					   
							 	 |___ scrollBar
								 |					   
							 	 |___ popup
								 
All V.U. interface items are considered contentItems.  Some of these contentItems are 
typically found only in Dialog Manager dialogs in non-MacApp applications.  These would 
be staticText, editText, picture, icon, and userItem.  Controls are Control Manager controls
which may appear in any window.

The list of TView descendants which are mapped to V.U. interface items and the V.U. item
to which they are mapped by V.U. by way of VUAssist is shown below.

TStaticText ---------> staticText
TEditText 	---------> editText
TPicture 	---------> picture
TIcon 		---------> icon
TButton 	---------> button
TCheckbox 	---------> checkBox
TRadio 		---------> radioButton
TScrollBar 	---------> scrollBar
TPopup 		---------> popup
TTextEdit 	---------> editText
(cells of TGridView -> contentItem)  - an optional feature

The last item, "cells of TGridView", deserves some explanation. TGridViews are a 
problem because unlike all the other items mentioned above, where there is exactly one 
MacApp object for each user interface item, there are many user interface items for a 
single TGridView object.  V.U. does not yet directly support gridView types of objects.  
So there is special case code for TGridViews.  Each cell in a grid is passed back as a 
"CUSTOM_ITEM".  To V.U., a CUSTOM_ITEM is a user interface item which does not fall into
any category more specific than contentItem.  So from a V.U. script writer's perspective,
cells in TGridView objects are V.U. contentItems.

Note that the mapping of TGridView cells to contentItems is a feature which can be disabled.
TVUAssist's IVUAssist method takes a bool argument gridItemSupport.  By passing 'false'
to this method, the cells of TGridViews are invisible to V.U..  You may want to do this if 
your application has large gridviews or many gridviews.  In this case treating each cell as
an interface item may bog down V.U. in such a way that performance is not acceptable. 

You'll also note in the code that we include TPopup descriptions in response to V.U.'s requests 
for information about controls.  This is because V.U. can normally only support popups which 
are implemented through the use of the popup CDEF found in System 7.0 or in the Mac Communications 
Toolbox.  So V.U. expects them to be controls. */

/*========================================== TVUAssist ================================*/

#if qNeedsVU

/* ----------------- VUAssist includes -------------------- */

#ifndef __UVUASSIST__
#include "UVUAssist.h"
#endif

// MacApp

#ifndef __UAPPLICATION__
#include "UApplication.h"
#endif

#ifndef __UBUTTON__
#include "UButton.h"
#endif

#ifndef __UCHECKBOX__
#include "UCheckbox.h"
#endif

#ifndef __UDIALOG__
#include "UDialog.h"
#endif

#ifndef __UEDITTEXT__
#include "UEditText.h"
#endif

#ifndef __UGRIDVIEW__
#include "UGridView.h"
#endif

#ifndef __UICON__
#include "UIcon.h"
#endif

#ifndef __UPICTURE__
#include "UPicture.h"
#endif

#ifndef __UPOPUP__
#include "UPopup.h"
#endif

#ifndef __URADIO__
#include "URadio.h"
#endif

#ifndef __USTATICTEXT__
#include "UStaticText.h"
#endif

#ifndef __UWINDOW__
#include "UWindow.h"
#endif

// Toolbox

#ifndef __DEVICES__
#include <Devices.h>
#endif

#ifndef __FILES__
#include <Files.h>
#endif

#ifndef __MACWINDOWS__
#include <MacWindows.h>
#endif

#ifndef __TOOLUTILS__
#include <ToolUtils.h>
#endif

/* ----------------- VUAssist typedefs -------------------- */

typedef TCtlMgr* TCtlMgrPtr;
typedef TControl* TControlPtr;
typedef TStaticText* TStaticTextPtr;
typedef TEditText* TEditTextPtr;
typedef TGridView* TGridViewPtr;
typedef TTEView* TTEViewPtr;
typedef TGridView* TGridViewPtr;
typedef TPopup* TPopupPtr;
typedef TTextGridView* TTextGridViewPtr;
typedef TGridItem* TGridItemPtr;

//========================================================================================
// GLOBAL
//========================================================================================

static long MAMoleHook(long select,
					   Ptr input,
					   Ptr output,
					   short* outputSize,
					   long result);


/* ----------------- VUAssist global -------------------- */

CAutoPtr_AC<TVUAssist> TVUAssist::fgVUAssist;
MoleHookUPP gMoleHookUPP = NewMoleHookProc(MAMoleHook);

/* ----------------- VUAssist macros -------------------- */

// pascal string length

inline short VUPLstrlen(void* s)
{
	return static_cast<short>(*(unsigned char*)s);
}

//========================================================================================
// CLASS TVUAssist
//========================================================================================
/* TVUAssist initializes fMoleRefNum.  fMoleRefNum contains the reference number of the 
  mole driver, or 0 if no mole driver has been found yet. Also initializes VUAssist as an EventHandler
  and initializes fGridItemSupport according to input argument gridItemSupport.*/

TVUAssist::TVUAssist(bool gridItemSupport) : 
	fGridItemSupport(gridItemSupport),
	fMoleRefNum(0)
{
	fgVUAssist = this;

	OpenMoleDriver();
	
	try
	{
		gApplication->AddDependent(this);
	}
	catch(CException_AC& theException)
	{
		DoCatchMessage_AC(theException);

#if qDebug
		::ProgramBreak_AC("Can't initialize the virtual user assist object!");
#endif
		// we don't fail if we have no VU support
		// Don't ReSignal
	}
}

//----------------------------------------------------------------------------------------
// TVUAssist destructor
//----------------------------------------------------------------------------------------
TVUAssist::~TVUAssist()
{
}

//----------------------------------------------------------------------------------------
// MAMoleHook
// MAMoleHook accepts the call from the mole with a C interface, and then calls
// TVUAssist::MoleAssist.
//----------------------------------------------------------------------------------------

long MAMoleHook(long select,
				Ptr input,
				Ptr output,
				short* outputSize,
				long result)
{
#if q68K
	long oldA5 = SetCurrentA5();
#endif

	MoleError aMoleError = TVUAssist::fgVUAssist->MoleAssist(select, input, output, outputSize, result);
#if q68K
	SetA5(oldA5);
#endif

	return aMoleError;
}

//----------------------------------------------------------------------------------------
// TVUAssist::DoUpdate: 
//----------------------------------------------------------------------------------------
void TVUAssist::DoUpdate(ChangeID_AC theChange,
					   MDependable_AC* changedObject,
					   void* changeData,
					   CDependencySpace_AC* dependencySpace)
{
	if (fMoleRefNum)
		switch (theChange)
		{
		case mAboutToLoseControl:
			SuspendMole();
			break;
		
		case mRegainControl:
			ResumeMole();
			break;

		default:
			MDependable_AC::DoUpdate(theChange, changedObject, changeData, dependencySpace);
		}
}

/* Try to open the mole driver if there is one. */

void TVUAssist::OpenMoleDriver()
{
	ParamBlockRec aPBRec;
	short Err;

	aPBRec.ioParam.ioCompletion = NULL;
	aPBRec.ioParam.ioNamePtr = (StringPtr)StripAddress("\p.Mole");
	aPBRec.ioParam.ioPermssn = fsCurPerm;
	Err = PBOpenSync(&aPBRec);
	if (Err == noErr)
	{
		fMoleRefNum = aPBRec.ioParam.ioRefNum;
		ResumeMole();
	}
}

/* Call this routine when the application is suspended by Multifinder, to let
  the mole know we are no longer the frontmost app. */

void TVUAssist::SuspendMole()
{
	SetDebuggerHook(NULL);
}


/* Call this routine when MultiFinder puts us back into the foreground. */

void TVUAssist::ResumeMole()
{
	SetDebuggerHook(gMoleHookUPP);
}


/* This is the routine called by MAMoleHook.  It dispatches out to the routines
  which actually assist the mole. */

MoleError TVUAssist::MoleAssist(long select,
								Ptr input,
								Ptr output,
								short* outputSize,
								long intResult)
{
	MoleError ret = MoleError(intResult);
	MoleError result = MoleError(intResult);

	switch (select)
	{

		case SMenuInfo:
			ret = DoMenuInfo(input, output, outputSize, result);
			break;

		case SMenuItems:
			ret = DoMenuItems(input, output, outputSize, result);
			break;

		case SWindInfo:
			ret = DoSendWindowInfo(input, output, outputSize, result);
			break;

		case SFindCtl:
			ret = DoFindControl(input, output, outputSize, result);
			break;

		case SCtlInfo:
			ret = DoSendControlInfo(input, output, outputSize, result);
			break;

		case SDItemInfo:
			ret = DoSendDlogItemInfo(input, output, outputSize, result);
			break;

		case SetMItemKey:
		case SFrontWind:
		case SFindWind:
		case SFindDItem:
		default:
			break;
	}
	return ret;
}


#define SET_ASSIST 100

/* Tell the mole the address of our assistance procedure.*/

void TVUAssist::SetDebuggerHook(MoleHookUPP theNewHook)
{
	if (fMoleRefNum)
	{
		ParamBlockRec aPBRec;

		aPBRec.cntrlParam.ioCompletion = NULL;
		aPBRec.cntrlParam.ioVRefNum = 0;
		aPBRec.ioParam.ioRefNum = fMoleRefNum;
		aPBRec.cntrlParam.csCode = SET_ASSIST;
		*(reinterpret_cast_AC(long* , &(aPBRec.cntrlParam.csParam[0]))) = static_cast_AC(long, theNewHook);

		::PBControlAsync(&aPBRec);
#if qDebug
		if (aPBRec.cntrlParam.ioResult)
			::ProgramBreak_AC("Error sending Agent VU control call");
#endif

	}
}



/* ------------------------------------------------------------------------------------ */
/* the routines for handling individual mole requests.  Each routine handles
  exactly one mole request. */

/*
  |	Handle a request for specific menu items.  The Mole can get info on menus in the
  |	menu bar, but we have to supply info on popup menus. If the Input data specifies
  |	a non-zero menu ID, use the ID to determine the popup menu.  Otherwise, if the 
  |	the menu rank input parameter is 0 (unspecified) use the menu handle input parameter
  |	directly to identify the popup menu. We do not deal with menus specified by non-zero
  |	rank parameter (where the menu ID parameter is 0.
*/
MoleError TVUAssist::DoMenuItems(Ptr input,
								 Ptr output,
								 short* outputSize,
								 MoleError result)
{
	SendMenuItemsParamsPtr menuReqPtr;
	MoleDataBlockPtr menuDescPtr;
	TPopup * popup;
	MenuRef theMenuRef;

	if (result != mNoErr)						/* only do the work if agent needs help */
	{
		menuReqPtr = SendMenuItemsParamsPtr(input);
		menuDescPtr = MoleDataBlockPtr(output);
		theMenuRef = NULL;

		if (menuReqPtr->menu_ID)
		{
			popup = MenuIDToPopup(menuReqPtr->menu_ID);
			if (popup)
				theMenuRef = popup->GetMenuRef();
		}
		else if (!menuReqPtr->menu_rank)
		{
			if (menuReqPtr->menu_hdl)
				theMenuRef = menuReqPtr->menu_hdl;
		}

		if (theMenuRef)
			result = FillPopupItemDesc(theMenuRef, menuReqPtr->start_item, menuReqPtr->stop_item, menuDescPtr, outputSize);
	}
	return result;
}


/*
  |	Handle a request for menu info.  The Mole can get info on menus in the
  |	menu bar, but we have to supply info on popup menus. If the Input data specifies
  |	a non-zero menu ID, use the ID to determine the popup menu.  Otherwise, if the 
  |	the menu rank input parameter is 0 (unspecified) use the menu handle input parameter
  |	directly to identify the popup menu. We do not deal with menus specified by non-zero
  |	rank parameter (where the menu ID parameter is 0.
*/
MoleError TVUAssist::DoMenuInfo(Ptr input,
								Ptr output,
								short* outputSize,
								MoleError result)
{
	SendMenuInfoParamsPtr menuReqPtr;
	MoleMenuInfoPtr menuDescPtr;
	TPopup * popup;
	MenuRef theMenuRef;

	if (result != mNoErr)						/* only do the work if agent needs help */
	{
		menuReqPtr = SendMenuInfoParamsPtr(input);
		menuDescPtr = MoleMenuInfoPtr(output);
		theMenuRef = NULL;

		if (menuReqPtr->menu_ID)
		{
			popup = MenuIDToPopup(menuReqPtr->menu_ID);
			if (popup)
				theMenuRef = popup->GetMenuRef();
		}
		else if (!menuReqPtr->menu_rank)
		{
			if (menuReqPtr->menu_hdl)
				theMenuRef = menuReqPtr->menu_hdl;
		}

		if (theMenuRef)
		{
			FillPopupDesc(theMenuRef, RANK_OF_THE_INVISIBLE, menuDescPtr, outputSize);
			result = mNoErr;
		}
	}
	return result;
}


/* Revise the values of the controlCount and numItems fields of the MoleWDescPtr, given
  knowledge of MacApp views. Also update validFlags and windowKind fields. WindowKind is set 
  to dialogKind so that V.U. will look for things that it can normally only see in dialogs 
  (such as icons and pictures) */

MoleError TVUAssist::DoSendWindowInfo(Ptr input,
									  Ptr output,
									  short* ,
									  MoleError result)
{
	DWindReqPtr windReqPtr;
	MoleWDescPtr windDescPtr;
	TWindow * window;

	windReqPtr = DWindReqPtr(input);
	windDescPtr = MoleWDescPtr(output);
	window = RankToWindow(*windReqPtr);
	if (window)
	{
		windDescPtr->validFlags |= (VCTLCNT_MASK | VITEMCNT_MASK);
		windDescPtr->windowKind = dialogKind;
		windDescPtr->controlCount = ViewCount(window, false);
		windDescPtr->numItems = ViewCount(window, true);
		/* outputSize is filled in by the mole */
		return mNoErr;
	}

	return result;
}


/* The mole sends us a point location in global coordinates.  We need to figure out
  which window and which control that point is in (if any), and send back info about
  that control. V.U. utilizes this routine for theControl Manager controls (TCtlMgr) only.*/

MoleError TVUAssist::DoFindControl(Ptr input,
								   Ptr output,
								   short* outputSize,
								   MoleError result)
{
	SendFindControlParamPtr ctrlReqPtr;
	MoleCDescPtr ctrlDescPtr;
	SendFindControlParam targetPoint;
	short part;
	WindowRef wind;
	WindowRef windowPtr;
	GrafPtr savePort;
	TCtlMgr * theControl;
	short rank;
	ControlRef saveCtlList;
	ControlRef WhichCtl;
	TWindow * window;
	CViewPoint VPt;

	ctrlReqPtr = SendFindControlParamPtr(input);
	targetPoint = *ctrlReqPtr;
	ctrlDescPtr = MoleCDescPtr(output);

	part = ::FindWindow(targetPoint, &windowPtr);
	wind = windowPtr;

	/* The mole also tests for part=inSysWindow, but we'll let the mole handle those cases */
	if (wind && (part == inContent))
	{
		window = TWindow::WMgrToWindow(WindowRef(wind));
		if (window)
		{
			theControl = PointToControl(window, targetPoint, &rank);
			if (theControl)
			{
				part = -1;
				/* Get the control part code.  Controls are not kept in the controllist,
				  so we temporarily put them in there.  Also, they are in their subviews
				  local coordinate system, so we must convert targetpoint. */
				::GetPort(&savePort);
				::SetPort(WindowRef(wind));
				if (window->Focus())
				{
					saveCtlList = ((WindowPeek)wind)->controlList;
					((WindowPeek)wind)->controlList = theControl->fCMgrControl;
					GlobalToWindow(window, targetPoint, &VPt);
					WindowToView(theControl, &VPt, &targetPoint);
					part = FindControl(targetPoint, WindowRef(wind), &WhichCtl);
					((WindowPeek)wind)->controlList = saveCtlList;
				}
				::SetPort(savePort);

				if (FillCtrlDesc(ctrlDescPtr, part, WindowToRank(wind), rank, theControl, outputSize))
					return mNoErr;
			}
		}
	}

	return result;
}


/* Read the input parameter to see which control V.U. wants info on, then
  fill in the SendCtlInfoParamsPtr record.  The mole can't gather any info about
  MacApp controls without our help, so we fill in the whole record, except for part, 
  which doesn't apply.*/

MoleError TVUAssist::DoSendControlInfo(Ptr input,
									   Ptr output,
									   short* outputSize,
									   MoleError result)
{
	SendCtlInfoParamsPtr ctrlReqPtr;
	MoleCDescPtr ctrlDescPtr;
	TWindow * window;
	TControl * theControl;
	TGridItem * gridItem;

	gridItem = NULL;
	ctrlReqPtr = SendCtlInfoParamsPtr(input);
	ctrlDescPtr = MoleCDescPtr(output);

	window = RankToWindow(ctrlReqPtr->window_rank);
	if (window)
	{
		theControl = TControlPtr(RankToItem(window, ctrlReqPtr->control_rank, false, gridItem));
		if (theControl)
		{
			if (FillCtrlDesc(ctrlDescPtr, -1, ctrlReqPtr->window_rank, ctrlReqPtr->control_rank, theControl, outputSize))
				return mNoErr;
		}
	}

	return result;
}


/* Read the input to see which dialog item in which window V.U. wants data on, and
  fill in the dialogiteminfo record. */
MoleError TVUAssist::DoSendDlogItemInfo(Ptr input,
										Ptr output,
										short* outputSize,
										MoleError result)
{
	SendDItemInfoPtr dlogReqPtr;
	MoleDItemInfoPtr dlogDescPtr;
	TWindow * window;
	TView * view;
	TGridItem * gridItem;

	gridItem = NULL;
	dlogReqPtr = SendDItemInfoPtr(input);
	dlogDescPtr = MoleDItemInfoPtr(output);

	window = RankToWindow(dlogReqPtr->window_rank);
	if (window)
	{
		view = RankToItem(window, dlogReqPtr->item_num, true, gridItem);
		if (view)
		{
			FillDlogItemDesc(dlogDescPtr, window, dlogReqPtr->window_rank, dlogReqPtr->item_num, view, outputSize, gridItem);
			return mNoErr;
		}
	}

	return result;
}

/* ------------------------------------------------------------------------------------ */
/* routines for filling in mole data structures */

/* Given a TPopup object, fill in the mole's menu descriptor record. */

void TVUAssist::FillPopupDesc(MenuRef theMenuHdl,
							  short menuRank,
							  MoleMenuInfoPtr menuDescPtr,
							  short* outputSize)
{
	menuDescPtr->num_items = ::CountMenuItems(theMenuHdl);
	menuDescPtr->rank = menuRank;
	menuDescPtr->left_edge = 0;
	menuDescPtr->menuID = (**theMenuHdl).menuID;
	menuDescPtr->menuWidth = (**theMenuHdl).menuWidth;
	menuDescPtr->menuHeight = (**theMenuHdl).menuHeight;
	menuDescPtr->enableFlags = (**theMenuHdl).enableFlags;
	BlockMove_AC((**theMenuHdl).menuData, menuDescPtr->menuTitle.text, VUPLstrlen((**theMenuHdl).menuData) + 1);

	/* this ugly thing computes the length (bytes used) of MoleMenuInfo */
	*outputSize = sizeof(MoleMenuInfo) - (255 - VUPLstrlen((**theMenuHdl).menuData));
}


/* this function depends upon Ptr being a pointer to a single byte */

static Ptr SeekMenuItem(short ItemNum,
						MenuRef MenuHdl)
{
	Ptr seekPtr = Ptr(&((**MenuHdl).menuData) + VUPLstrlen((**MenuHdl).menuData) + 1);
	short seekNum = 1;

	while ((seekNum < ItemNum) && *seekPtr)
	{
		seekPtr += *seekPtr + ADDITIONAL_MENU_ITEM_DATA;
		++seekNum;
	}

	return seekPtr;
}


/* Given a TPopup object and a menu handle, fill in the mole's menuitem descriptor record. */
MoleError TVUAssist::FillPopupItemDesc(MenuRef theMenuHdl,
									   short start,
									   short stop,
									   MoleDataBlockPtr menuItemDescPtr,
									   short* outputSize)
{
	Ptr startPtr;
	Ptr stopPtr;
	MoleError ret = mNoErr;

	if ((start > ::CountMenuItems(theMenuHdl)) || (start < 1))
		return mBadMenuItemIndex;

	if (stop > ::CountMenuItems(theMenuHdl))
	{
		stop = ::CountMenuItems(theMenuHdl);
		ret = mBadLastMenuItemIndex;
	}

	startPtr = SeekMenuItem(start, theMenuHdl);
	stopPtr = SeekMenuItem(stop + 1, theMenuHdl);
	if (!(startPtr && stopPtr))
		return mBadMenuItemIndex;

	menuItemDescPtr->blockLength = stop - start + 1;
	BlockMove_AC(startPtr, &menuItemDescPtr->dataBlock[0], stopPtr - startPtr);

	/* this ugly thing computes the length (bytes used) of MoleDataBlock */
	*outputSize = sizeof(short) + (stopPtr - startPtr);

	return ret;
}


/* Fill in a mole control descriptor record.  Valid descendants of TControl are descendants of
  TCtlMgr and TPopup. Will return false if TControl is not a descendant of TCtlMgr or TPopup.*/

bool TVUAssist::FillCtrlDesc(MoleCDescPtr ctrlDescPtr,
								short thePart,
								short windowRank,
								short ControlRank,
								TControl* theControl,
								short* outputSize)
{
	ControlRef ControlHdl;
	CViewRect aVRect;
	CRect_AC aCRect;
	MenuRef theMenuHdl;
	unsigned char* theExtraDataPtr;
	bool itsOdd;
	short outputSizeAdjustor;
	short titleLength;

	if (dynamic_cast_AC(TPopup*,theControl))
	{
		theMenuHdl = TPopupPtr(theControl)->GetMenuRef();

		ctrlDescPtr->validFlags = VALL_C_MASK;
		if (thePart == -1)						/* indicate that part code is not valid */
			ctrlDescPtr->validFlags = ctrlDescPtr->validFlags & ~VCPART_MASK;

		ctrlDescPtr->owner_rank = windowRank;
		aVRect = theControl->GetExtent();
		aCRect = aVRect.ToRect();
		SetRect(&ctrlDescPtr->ctlRect, aCRect.left, aCRect.top, aCRect.right, aCRect.bottom);
		ViewRectToWindowRect(&ctrlDescPtr->ctlRect, theControl);

		ctrlDescPtr->ctlValue = TPopupPtr(theControl)->GetCurrentItem();
		ctrlDescPtr->ctlMin = 1;
		ctrlDescPtr->ctlMax = ::CountMenuItems(theMenuHdl);
		ctrlDescPtr->ctlHilite = 0;
		if (thePart == -1)
			ctrlDescPtr->part = 0;
		else
			ctrlDescPtr->part = thePart;

		ctrlDescPtr->ctlRank = ControlRank;
		ctrlDescPtr->ctlDefID = POPUP_CDEF * 16;
		ctrlDescPtr->ctlData.popupMenuID = TPopupPtr(theControl)->GetMenuID();
		titleLength = VUPLstrlen((**theMenuHdl).menuData);
		BlockMove_AC((**theMenuHdl).menuData, ctrlDescPtr->ctlTitle.text, titleLength + 1);

		/* 
		  |	For 7.1, we need to add the menu handle at the first even byte boundary beyond
		  |	end of the text_name field.  This determines the location for the
		  |	menu handle. 
		*/
		theExtraDataPtr = ctrlDescPtr->ctlTitle.text + titleLength + 2;
		if (::Odd_AC(theExtraDataPtr))
		{
			itsOdd = true;
			--theExtraDataPtr;
		}
		else
			itsOdd = false;

		/* Tack the menu handle on the end of the CtrlDescPtr */
		BlockMove_AC(&theMenuHdl, theExtraDataPtr, sizeof(MenuRef));

		/* compute the length (bytes used) of CtrlDescPtr */
		outputSizeAdjustor = itsOdd ? 1 : 2;

		/* this ugly thing computes the length (bytes used) of ctrlDescPtr */
		*outputSize = sizeof(MoleControlDescriptor) - (255 - titleLength) + outputSizeAdjustor;
		return true;
	}
	else if (dynamic_cast_AC(TCtlMgr*,theControl))
	{
		ControlHdl = TCtlMgrPtr(theControl)->fCMgrControl;
		ctrlDescPtr->validFlags = VALL_C_MASK;
		if (thePart == -1)					/* indicate that part code is not valid */
			ctrlDescPtr->validFlags = ctrlDescPtr->validFlags & ~VCPART_MASK;

		ctrlDescPtr->owner_rank = windowRank;
		ctrlDescPtr->ctlRect = (**ControlHdl).contrlRect;
		ViewRectToWindowRect(&ctrlDescPtr->ctlRect, theControl);
		ctrlDescPtr->ctlValue = (**ControlHdl).contrlValue;
		ctrlDescPtr->ctlMin = (**ControlHdl).contrlMin;
		ctrlDescPtr->ctlMax = (**ControlHdl).contrlMax;
		ctrlDescPtr->ctlHilite = (**ControlHdl).contrlHilite;
		if (thePart == -1)
			ctrlDescPtr->part = 0;
		else
			ctrlDescPtr->part = thePart;

		ctrlDescPtr->ctlRank = ControlRank;

		/* Special case TScrollBar to have ctlDefID of 16 so VU views it as a standard scroll bar */
		if (dynamic_cast_AC(TScrollBar*,theControl))
			ctrlDescPtr->ctlDefID = 16;
		else
			ctrlDescPtr->ctlDefID = ::GetControlVariant(ControlHdl);

		ctrlDescPtr->ctlData.popupMenuID = 0;
		BlockMove_AC((**ControlHdl).contrlTitle, ctrlDescPtr->ctlTitle.text, VUPLstrlen((**ControlHdl).contrlTitle) + 1);

		/* this ugly thing computes the length (bytes used) of ctrlDescPtr */
		*outputSize = sizeof(MoleControlDescriptor) - (255 - VUPLstrlen((**ControlHdl).contrlTitle));

		return true;
	}

	return false;
}


void TVUAssist::ViewRectToWindowRect(Rect* aRect,
									 TView* aView)
{
	*aRect = aView->LocalToRootView(*aRect).ToRect();
}

/* Fill in a mole dialog item descriptor record */

void TVUAssist::FillDlogItemDesc(MoleDItemInfoPtr dlogDescPtr,
								 TWindow* window,
								 short windowRank,
								 short itemRank,
								 TView* item,
								 short* outputSize,
								 TGridItem* gridItem)
{
	CViewRect aVRect;
	CRect_AC aCRect;
	long textLen;
	Handle textHdl;
	ViewItems itemKind;
	GridCell aCell;
	CStr255_AC theText;

	itemKind = GetItemType(item, true, true);

	/* fill in box, itemType, item_enabled, has_text and text_name here */
	switch (itemKind)
	{

		case VINotMember:
			break;

		case VIButton:
			dlogDescPtr->itemType = btnCtrlItem;
			dlogDescPtr->item_enabled = ((TCtlMgrPtr)(item))->IsCMgrVisible() && item->IsActive();
			dlogDescPtr->has_text = true;
			theText = ((TCtlMgrPtr)(item))->GetText();
			theText.CopyTo(dlogDescPtr->itemData.text);
			break;

		case VIRadio:
			aVRect = ((TCtlMgrPtr)(item))->ControlArea();
			dlogDescPtr->itemType = radCtrlItem;
			dlogDescPtr->item_enabled = ((TCtlMgrPtr)(item))->IsCMgrVisible() && item->IsActive();
			dlogDescPtr->has_text = true;
			theText = ((TCtlMgrPtr)(item))->GetText();
			theText.CopyTo(dlogDescPtr->itemData.text);
			break;

		case VICheckBox:
			aVRect = ((TCtlMgrPtr)(item))->ControlArea();
			dlogDescPtr->itemType = chkCtrlItem;
			dlogDescPtr->item_enabled = ((TCtlMgrPtr)(item))->IsCMgrVisible() && item->IsActive();
			dlogDescPtr->has_text = true;
			theText =((TCtlMgrPtr)(item))->GetText();
			theText.CopyTo(dlogDescPtr->itemData.text);
			break;

		case VIScrollBar:
			aVRect = ((TCtlMgrPtr)(item))->ControlArea();
			dlogDescPtr->itemType = resCtrlItem;
			dlogDescPtr->item_enabled = ((TCtlMgrPtr)(item))->IsCMgrVisible() && item->IsActive();
			dlogDescPtr->has_text = true;
			theText = ((TCtlMgrPtr)(item))->GetText();
			theText.CopyTo(dlogDescPtr->itemData.text);
			break;

		case VIStatText:
			aVRect = item->GetExtent();
			dlogDescPtr->itemType = statText;
			dlogDescPtr->item_enabled = false;
			dlogDescPtr->has_text = true;
			theText = ((TStaticTextPtr)(item))->GetText();
			theText.CopyTo(dlogDescPtr->itemData.text);
			break;

		case VIEditText:
			aVRect = item->GetExtent();
			dlogDescPtr->itemType = editText;
			dlogDescPtr->item_enabled = item->IsActive();
			dlogDescPtr->has_text = true;
			theText = ((TEditTextPtr)(item))->GetText();
			theText.CopyTo(dlogDescPtr->itemData.text);
			break;

		case VIIcon:
			aVRect = item->GetExtent();
			dlogDescPtr->itemType = iconItem;
			dlogDescPtr->item_enabled = item->IsActive();
			dlogDescPtr->has_text = false;
			dlogDescPtr->itemData.item_text_ptr = NULL;
			break;

		case VIPopup:
			aVRect = item->GetExtent();
			dlogDescPtr->itemType = resCtrlItem;
			dlogDescPtr->item_enabled = item->IsActive();
			dlogDescPtr->has_text = false;
			dlogDescPtr->itemData.item_text_ptr = NULL;
			break;

		case VIPicture:
			aVRect = item->GetExtent();
			dlogDescPtr->itemType = picItem;
			dlogDescPtr->item_enabled = item->IsActive();
			dlogDescPtr->has_text = false;
			dlogDescPtr->itemData.item_text_ptr = NULL;
			break;

		case VITextEdit:
			aVRect = item->GetExtent();
			dlogDescPtr->itemType = editText;
			dlogDescPtr->item_enabled = item->IsActive();
			dlogDescPtr->has_text = true;
			textHdl = TTEViewPtr(item)->ExtractText();
			textLen = ::GetHandleSize(textHdl);
			if (textLen > 255)
				textLen = 255;
			BlockMove_AC(*textHdl, dlogDescPtr->itemData.text, textLen);
			break;

		case VIGridItem:
			gridItem->GetExtent(aVRect);
			dlogDescPtr->itemType = CUSTOM_ITEM;
			dlogDescPtr->item_enabled = gridItem->fGridView->IsActive();
			if (dynamic_cast_AC(TTextGridView*,item))
			{
				dlogDescPtr->has_text = true;
				aCell.v = static_cast<short>(gridItem->fRow);
				aCell.h = static_cast<short>(gridItem->fColumn);
				theText = TTextGridViewPtr(gridItem->fGridView)->GetText(aCell);
				theText.CopyTo(dlogDescPtr->itemData.text);
			}
			else
			{
				dlogDescPtr->has_text = false;
				dlogDescPtr->itemData.item_text_ptr = NULL;
			}
			break;
	}

	aCRect = aVRect.ToRect();
	::SetRect(&dlogDescPtr->box, aCRect.left, aCRect.top, aCRect.right, aCRect.bottom);
	ViewRectToWindowRect(&dlogDescPtr->box, item);

	/* fill in ctlRank, owner_rank, and item_num here */
	dlogDescPtr->ctlRank = ItemToRank(window, item, false);
	dlogDescPtr->owner_rank = windowRank;
	dlogDescPtr->item_num = itemRank;

	/* this ugly thing computes the length (bytes used) of MoleDItemInfo */
	if (itemKind != VINotMember)
		*outputSize = sizeof(MoleDItemInfo) - (255 - dlogDescPtr->itemData.text[0]);

	delete gridItem;
}


/* ------------------------------------------------------------------------------------ */
/* routines for searching through the view tree to find particular views */

/* Given the rank (z-order) of a window, return the window object.  Invisible
  windows are not considered to be in the window list, for ranking purposes. */

TWindow* TVUAssist::RankToWindow(short rank)
{
	short i = 1;
	WindowRef window = ::FrontWindow();

	while (window)
	{
		if (IsWindowVisible(window))
		{
			if (i == rank)
				return TWindow::WMgrToWindow(window);
			++i;
		}
		window = GetNextWindow_AC(window);
	}

	return NULL;
}


/* Given a window ptr, return the window's rank (z-order) */

short TVUAssist::WindowToRank(WindowRef WindToFind)
{
	short i = 1;
	WindowRef window = ::FrontWindow();

	while (window)
	{
		if (IsWindowVisible(window))
		{
			if (WindToFind == window)
				return i;
			++i;
		}
		window = GetNextWindow_AC(window);
	}

	return 0;
}


/* Convert a point in global coordinates to window coordinates. */

void TVUAssist::GlobalToWindow(TWindow* window,
							   Point Pt,
							   CViewPoint* VPt)
{
	(*VPt).Clear();

	GrafPtr savePort;
	::GetPort(&savePort);
	::SetPort(window->GetGrafPort());
	if (window->Focus())
	{
		CPoint_AC targetPoint(Pt);
		GlobalToLocal(&targetPoint);
		*VPt = window->QDToView(targetPoint);
	}
	::SetPort(savePort);
}


/* Convert a point in window coordinates to a subview's coordinates. Return both a
  CViewPoint and a QDPoint. */

void TVUAssist::WindowToView(TView* view,
							 CViewPoint* VPt,
							 Point* Pt)
{
	*Pt = (view->Focus()) ? view->ViewToQD(view->RootViewToLocal(*VPt)) : gZeroPt;
}


/* In the front (active) window, given the menu ID of a popup item, return the  
  popup menu object and its rank. */

static TView* FoundView_MenuIDToPopup = NULL;
static short MenuID_MenuIDToPopup;

static bool TestSubID_MenuIDToPopup(TView* theSubView,
									   TVUAssist* self)
{
	if (theSubView->IsShown())
	{
		if (self->GetItemType(theSubView, false, false) == VIPopup)
			if (TPopupPtr(theSubView)->fMenuID == MenuID_MenuIDToPopup)
				FoundView_MenuIDToPopup = theSubView;

		if (!FoundView_MenuIDToPopup)
			for (CSubViewIterator iter(theSubView); iter; ++iter)
				if (TestSubID_MenuIDToPopup(iter, self))
					break;
	}

	return FoundView_MenuIDToPopup != NULL;
}


TPopup* TVUAssist::MenuIDToPopup(short menuID)
{
	FoundView_MenuIDToPopup = NULL;
	MenuID_MenuIDToPopup = menuID;

	TWindow * window = gApplication->GetActiveWindow(true);

	if (window && window->IsShown())
		for (CSubViewIterator iter(window); iter; ++iter)
			if (TestSubID_MenuIDToPopup(iter, this))
				break;

	return TPopupPtr(FoundView_MenuIDToPopup);
}


/* Given a window object and a point in global coordinates,
  find the control which is under that point. Only descendants of
  TCtlMgr are considered.*/

static TView* FoundView_PointToControl;
static CViewPoint VPt_PointToControl;

static bool TestSubView_PointToControl(TView* theSubView,
										  TVUAssist* self)
{

	if (theSubView->IsShown())
	{
		if (dynamic_cast_AC(TCtlMgr*,theSubView))
		{
			CViewPoint testPoint = VPt_PointToControl;
			Point dummyPoint;
			self->WindowToView(theSubView, &testPoint, &dummyPoint);
			if (theSubView->ContainsMouse(testPoint))
				FoundView_PointToControl = theSubView;
		}

		if (!FoundView_PointToControl)
			for (CSubViewIterator iter(theSubView); iter; ++iter)
				if (TestSubView_PointToControl(iter, self))
					break;
	}

	return FoundView_PointToControl != NULL;
}


TCtlMgr* TVUAssist::PointToControl(TWindow* window,
								   Point Pt,
								   short* rank)
{
	FoundView_PointToControl = NULL;
	GlobalToWindow(window, Pt, &VPt_PointToControl);

	if (window->IsShown())
		for (CSubViewIterator iter(window); iter; ++iter)
			if (TestSubView_PointToControl(iter, this))
				break;

	*rank = ItemToRank(window, FoundView_PointToControl, false);

	return TCtlMgrPtr(FoundView_PointToControl);
}


static short ItemCount_ViewCount = 0;

static void DoToSubView_ViewCount(TView* theSubView,
								  TVUAssist* self,
								  bool dlogViewItems)
{
	if (theSubView->IsShown())
	{
		ViewItems ItemType = self->GetItemType(theSubView, dlogViewItems, dlogViewItems);
		if (ItemType != VINotMember)
		{
			if (ItemType == VIGridItem)
				ItemCount_ViewCount += self->CountGridItems(dynamic_cast_AC(TGridView*,theSubView));
			else
				++ItemCount_ViewCount;
		}

		for (CSubViewIterator iter(theSubView); iter; ++iter)
			DoToSubView_ViewCount(iter, self, dlogViewItems);
	}
}


/* Walk the view hierarchy tree, counting the number of user interface items.
  Only visible views and items are counted. */

short TVUAssist::ViewCount(TWindow* window,
						   bool dlogViewItems)
{
	ItemCount_ViewCount = 0;

	if (window->IsShown())
		for (CSubViewIterator iter(window); iter; ++iter)
			DoToSubView_ViewCount(iter, this, dlogViewItems);

	return ItemCount_ViewCount;
}


/* Given a control or dialog item (view), and the window its in (window), return its rank. */

static short ItemCount_ItemToRank;
static short Rank_ItemToRank;
static TView* View_ItemToRank;

static bool TestSubView_ItemToRank(TView* theSubView,
									  TVUAssist* self,
									  bool dlogViewItems)
{
	if (theSubView->IsShown())
	{

		ViewItems ItemType = self->GetItemType(theSubView, dlogViewItems, dlogViewItems);
		if (ItemType != VINotMember)
		{
			if (ItemType == VIGridItem)
			{
				if (dynamic_cast_AC(TGridItem*,View_ItemToRank) && (theSubView == TGridItemPtr(View_ItemToRank)->fGridView))
					Rank_ItemToRank = ItemCount_ItemToRank + static_cast<short>(TGridItemPtr(View_ItemToRank)->fRank);
				else
					ItemCount_ItemToRank += self->CountGridItems(TGridViewPtr(theSubView));
			}
			else
			{
				++ItemCount_ItemToRank;
				if (theSubView == View_ItemToRank)
					Rank_ItemToRank = ItemCount_ItemToRank;
			}
		}

		if (!Rank_ItemToRank)
			for (CSubViewIterator iter(theSubView); iter; ++iter)
				if (TestSubView_ItemToRank(iter, self, dlogViewItems))
					break;
	}
	return Rank_ItemToRank != 0;
}


short TVUAssist::ItemToRank(TWindow* window,
							TView* view,
							bool dlogViewItems)
{
	Rank_ItemToRank = 0;
	ItemCount_ItemToRank = 0;
	View_ItemToRank = view;

	if (window->IsShown())
		for (CSubViewIterator iter(window); iter; ++iter)
			if (TestSubView_ItemToRank(iter, this, dlogViewItems))
				break;

	return Rank_ItemToRank;
}


static TView* FoundView_RankToItem;
static short ItemCount_RankToItem;
static short Rank_RankToItem;
static bool DlogViewItems_RankToItem;

/* Given a window object and the rank (z-order) of an item, return the item object. If
  the item is a cell of a TGridView object, return that object in gridItem.*/

static bool TestSubView_RankToItem(TView* theSubView,
									  TVUAssist* self,
									  TGridItem*& gridItem)
{
	if (theSubView->IsShown())
	{
		ViewItems ItemType = self->GetItemType(theSubView, DlogViewItems_RankToItem, DlogViewItems_RankToItem);
		if (ItemType != VINotMember)
		{
			if (ItemType == VIGridItem)
			{
				short GridCount = self->CountGridItems(TGridViewPtr(theSubView));
				if ((Rank_RankToItem > ItemCount_RankToItem) && (Rank_RankToItem <= ItemCount_RankToItem + GridCount))
				{
					gridItem = TH_new TGridItem(TGridViewPtr(theSubView), Rank_RankToItem - ItemCount_RankToItem);
					FoundView_RankToItem = theSubView;
				}
				ItemCount_RankToItem += GridCount;
			}
			else
			{
				++ItemCount_RankToItem;
				if (ItemCount_RankToItem == Rank_RankToItem)
					FoundView_RankToItem = theSubView;
			}
		}

		if (!FoundView_RankToItem)
			for (CSubViewIterator iter(theSubView); iter; ++iter)
				if (TestSubView_RankToItem(iter, self, gridItem))
					break;
	}

	return FoundView_RankToItem != NULL;
}


TView* TVUAssist::RankToItem(TWindow* window,
							 short rank,
							 bool dlogViewItems,
							 TGridItem*& gridItem)
{
	FoundView_RankToItem = NULL;
	ItemCount_RankToItem = 0;
	Rank_RankToItem = rank;
	DlogViewItems_RankToItem = dlogViewItems;

	if (window->IsShown())
		for (CSubViewIterator iter(window); iter; ++iter)
			if (TestSubView_RankToItem(iter, this, gridItem))
				break;

	return FoundView_RankToItem;
}


/* Report the number of items in a TGridView.  This is here so it can
  be easily overridden if you only want rows or columns to show up as
  seperate user interface items, instead of each cell. */

short TVUAssist::CountGridItems(TGridView* theGridView)
{
	return theGridView->GetNumOfRows() * theGridView->GetNumOfCols();
}


/* Given a view item and the control/dialog item flag, decide if this
  view object is a control if the flag=ControlsOnly, or if its a dialog
  item if the flag=DialogItems, or if its neither.  Of course, MacApp 
  doesn't have a concept of dialog items, so we improvise.  Here are the criteria.
  Any descendent of TCtlMgr is a control.  Descendants of TPopup are also classified
  as contols because V.U. can normally only deal with popups which utilize the popup
  CDEF.  So V.U. expects popups to be controls.
  Descendents of TTEView and some descendants of TControl (specifically TEditText, 
  TStaticText, TIcon, TPicture, and TGridView) are considered to be DialogItems for V.U.'s sake.  
  gridViewItems are considered along with other dlogViewItems only if gridViewItems parameter 
  is true.*/

ViewItems TVUAssist::GetItemType(TView* item,
								 bool dlogViewItems,
								 bool gridViewItems)
{
	if (dynamic_cast_AC(TPopup*,item))
		return VIPopup;
	if (dynamic_cast_AC(TRadio*,item))
		return VIRadio;
	if (dynamic_cast_AC(TCheckBox*,item))
		return VICheckBox;
	if (dynamic_cast_AC(TScrollBar*,item))
		return VIScrollBar;
	if (dynamic_cast_AC(TButton*,item))
		return VIButton;

	if (dlogViewItems)
	{
		if (dynamic_cast_AC(TEditText*,item))
			return VIEditText;
		if (dynamic_cast_AC(TStaticText*,item))
			return VIStatText;
		if (dynamic_cast_AC(TIcon*,item))
			return VIIcon;
		if (dynamic_cast_AC(TPicture*,item))
			return VIPicture;
		if (dynamic_cast_AC(TTEView*,item) && !dynamic_cast_AC(TDialogTEView*,item))
			return VITextEdit;
		if (fGridItemSupport && gridViewItems)
		{
			if (dynamic_cast_AC(TGridView*,item))
				return VIGridItem;
		}
	}

	return VINotMember;
}

/*========================================== TGridItem ================================*/

/* Instantiate a TGridItem object, and fill in its fields..  This is here 
  so it can be overridden if you only want rows or columns to show 
  up as seperate user interface items, instead of each individual cells. */

TGridItem::TGridItem(TGridView* theGridView,
						  short rank) :
	fGridView(theGridView),
	fRank(rank),
	fRow((rank - 1) / theGridView->GetNumOfCols() + 1),
	fColumn((rank - 1) % theGridView->GetNumOfCols() + 1)
{
}

/* Provide the bounding rect of a griditem */

void TGridItem::GetExtent(CViewRect& itsExtent)
{
	GridCell aCell(static_cast_AC(short, fColumn), static_cast_AC(short, fRow));
	fGridView->CellToVRect(aCell, itsExtent);
}


/* call the LocalToWindow method of the GridView associated with the griditem */

void TGridItem::LocalToWindow(CViewPoint* thePoint)
{
	*thePoint = fGridView->LocalToRootView(*thePoint);
}

#endif // of #if qNeedsVU

//----------------------------------------------------------------------------------------
// End of UVUAssist.cp

/*
	Historical Change Record:
		----- R11 -----
		06/27/96	Make conditional tests implicit as in if(x) instead of if(x != 0).
		06/26/96	Changed nil back to NULL.
		06/26/96	Install release marker.  Scope many globals.  Change TRUE/FALSE/NULL.
		06/26/96	==/!=NULL to implicit tests, except in the case of assignment to or passing/returning as bool/bool.
		06/19/96	SCpp and MrCpp can't handle declarations in the expression portion of while loops
							so we just changed them all to for loops
		05/02/95	Call FreeIfObject, don't call Free directly since it will eventually be removed.
		04/26/96	Made C/CCoordPoint_AC/Rect default constructors set the point/rect to a cleared value. Made
		 					clearing very fast/compact. Eliminated the now unnecessary hand clearing of C/CCoordPoint_AC/Rects.
		04/26/96	Made TControl::ControlArea/ControlQDArea non virtual. Made TView/TControl::GetAdornExtent
							return their CCoordRect_AC as function results
		04/24/96	Use PRE-Increment/Decrement operators whenever possible for eff.
		04/18/96	More Use post-increment with iterators in while loops
		----- R10 -----
		03/30/96	Make change in GridItem->GetExtent call so it will compile
							with Steve's changes.
		03/18/96	Made better use of TView calls that return CRect_AC/CCoordPoint_AC/CCoordRect_AC
		07/06/95	Use PBOpenSync instead of PBOpen(,false). 
		  					Include Files.h to get the old location. 
		05/31/95	WindowRef doesn't provide access to controlList. 
	 	05/17/95	More WindowRef changes. 
	 	05/16/95	ControlRef, MenuRef, WindowRef
		03/15/95	Move destructor methods to where they belong. 
		03/13/95	Change Free methods to destructors. 
		02/23/95	Change to use MA_MEMBER macro in UClassDesc. 
		02/22/95	1222850 MacApp should use BlockMove_AC and BlockMoveOverlap_AC everywhere
		02/19/95	Change VUPstrlen from a macro to an inline function. 
							Change the Member macro to be more efficient. 
		02/07/95	Create missing prototypes for static functions used internally.
		02/07/95	1185542 Use upp for molehook
 		02/16/95	MoleHook saves and restores A5 only in 68k world.
 		 					Tests for 68k changed from !qModelCFM to qPowerPC because
 		 					qModelCFM was false in MW PPC builds.
 		02/16/95	Replace calls to PLstrlen with new, local macro VUPstrLength.
 							Remove #include <PLStringFuncs.h>
 		02/16/95	Add StripAddress call to OpenMoleDriver.
 		02/15/95	Created MoleHookUPP.  Created static instance of this
 		 					UPP and use it as the MoleHook. Fixes PPC incompatibility.
 		02/14/95    GSF		MAMoleHook treats all params as 4-byte longs. This fixes
 		 					an incompatibility with Metrowerks.
		02/28/94	Added IObject call in IGridItem
    	11/19/93	Adapted to MacApp B1 and PowerPC B3
		10/25/93	Bugs in untested port fixed
		09/15/93	Ported to C++ by Jeroen Schalk
		02/13/92	indicate 3.0 compatibility, change version
		01/28/92	Make debugging writeln in SetDebuggerHook conditionally compiled
		01/28/92	Removed cohandler install and setting of idle freq from IVUAssist
		01/27/92	Removed call to FailNil in RankToItem
		11/25/91	Remove call to Initialize in IVUAssist
 		10/04/91	indicate 3.0b2 compatibility, change version
		09/10/91	indicate 3.0b2PQR compatibility, change version
		08/21/91	adjust comments, change version
		08/20/91	fix syntax error
		08/20/91	  	remove debugging code
		08/19/91	Revise comments, change case of GridItemSupport to
		 					gridItemSupport
		08/15/91	Add GridItemSupport argument to IVUAssist
		08/13/91	Revise comments
		08/13/91	Change made in GetItemType so that kIncludeGridItems 
							will determine whether TGridItems are ever identified for use 
		08/13/91	Make changes in IVUAssist since VUAssist is now a descendant
		 					of TEvtHandler (sets idle frequency and installs cohandler).
		08/13/91	Changes in TGridItem implementation
		08/13/91	Use FirstSubViewThat in place of EachSubView wherever applicable
		08/06/91		JAS		Clean up change history
		08/06/91		JAS		Check for gridViewItems in GetItemType only if dlogViewItems is
							true, remove TVUAssist::DoFindWindowInfo (not needed)

	Written by:	David Shayer
*/