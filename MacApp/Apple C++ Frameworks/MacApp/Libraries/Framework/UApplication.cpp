//----------------------------------------------------------------------------------------
// UApplication.cpp 
// Copyright � 1984-2001 by Apple Computer, Inc. All rights reserved.
//
//	Our sincere thanks to George Varga & Juergen A. Mayrbaeurl of ARTMA Biomedical who
//  allowed us to pattern MacApp's Navigation Services support on their recommendations.
//----------------------------------------------------------------------------------------

/*
	Change History
		08/15/01	Throw an error in the TPDocCommand ctor if no printer has been
					selected.  Detect that gPrintHandler has not been setup in
					PrintDocuments and bypass printing (emit debug message).  Include
					PMDefinitions.h (for kPMNoDefaultPrinter).
		07/30/01	[C] Handle a kHICommandQuit command as if it were cQuit. 
		07/24/01	Use Lock_AC and Unlock_AC.  Cast to handle using static_cast.
		06/15/01	Initialize validRecord to false when making a NavReplyRecord. 
		05/16/01	Second call to objectFilter in CanOpenDocument shouldn't have "!" as NavServices
					wants the return value to be TRUE if the file CAN be displayed
					(opposite of the return value for StdFile).
		05/07/01	Comment out pragma messages for Carbon. 
		05/02/01	Use sizeof CFSSpec_AC for creating a new AEDesc in CanOpenDocument.
		04/23/01	Protected gClipboardMgr fields. 
		04/06/01	GetNavFileTypes needs to detach navTypeList. 
					CanOpenDocument needs to call the objectFilter with the value
					of the callBackUD, not its address. 
		03/04/01	Clean up string casting. 
		01/29/01	Reverse the interpretation of the filter proc results for NavSvcs
					in CanOpenDocument.
		01/11/00	Use CString_AC instead of CStr255_AC.
		12/28/00	Modified method in which UntitledName is called in two places.
		01/02/01	Update copyright.
		12/21/00	Bracket TOSADispatcher references with qAppleEventAware. 
		12/12/00	Changed CTempDesc_AC intialization in ChooseFolderWithNavSvcs,
					ChooseVolumeWithNavSvcs and CreateFolderWithNavSvcs.
		11/27/00	Back out casting of gEmptyString--no longer needed.
		11/27/00	DoScriptCommand was posting recordable commands. Workaround is
					to check the OSA dispatch level before turning on Apple Events
					for the new and open commands. 
		11/10/00	Cosmetic.
		11/09/00	Ticks are unsigned. 
					[PB] Change initialization order to match declaration. 
					[PB] Suppress GCC warnings about unused return variables. 
					Remove declaration of DoSetupTheMenus which is not defined or used in this unit. 
		11/07/00	If Carbon's CanOpenDocument, correctly fill in the NavFileOrFolderInfo
					"fileInfo" variable.
		11/03/00	[C] Don�t include DiskInit.h or EPPC.h.  Cast gEmptyString
					to const unsigned char*.
		11/01/00	[PB] Include MacErrors instead of Errors. 
		10/20/00	Reworked GetNavSvcsFileParameters and CanOpenDocument, making
					them more Carbon-compatible.
		10/13/00	[W] Undefine pascal and fix about box.
		09/22/00	[W] Cannot use dialog proc in DoAboutBox.
		09/20/00	[W] GetFileTypeList returns empty list.
		09/06/00	Added embedded documentation.
		08/15/00	Add a convenience macro for generating temp UPP classes. 
		08/17/00	[W] Ignore originalText in 2nd place in DoAboutBox.
		07/31/00	Eliminated obsoleted code.  [W] Accomodated string differences.  Added
					some Windows-specific event handling.  Removed some this->s.
		07/24/00	CW Pro 6: namespacing. 
		06/14/00	Call CMultiLocale_AC::GetResource instead of MAGetResource in GetNavFileTypes.
					Scope multilocale calls with CMultiLocale_AC.  Do not specify
					script in about box.
		06/02/00	[2476498] Loop twice in DoCloseInWindowOrder closing document
					windows first and then documentless and toolbox windows.  Moved
					implementation of GetWindowToClose into DoCloseInWindowOrder
					and eliminated GetWindowToClose.
		06/01/00	Simplify GetNavFileTypes by having it retrieve the bundle
					resource.  ChooseDocumentWithNavSvcs now releases the bundle
					resource.  Simplify GetFileTypeList now that it is not used
					by GetNavFileTypes.
		04/18/00	Include UPrintMgr.h instead of UPrintHandler.h.
		02/22/00	[W] Cannot auto-scroll in DoShowAboutAppFilter.
		01/13/00	Changed ChooseApplication to remove warning of unused arg.
		12/27/99	Minor cosmetic cleanup.
		12/08/99	Set fWantsNavigationServices to false for SCPP.
		12/14/99	[2415891] AliasHandles not disposed. 
		10/25/99	PRAGMA_ALIGN_SUPPORTED now PRAGMA_STRUCT_ALIGN.
		10/11/99	Carbon: Take back out PPCBrowser, as its availability was a header change,
					not an actual one.
		10/07/99	Use TemplateTempUPP_AC instead of TmplTmpRtnDescrptr.
		10/04/99	Carbon: Put back PPCBrowser, as its now available.
		09/23/99	Carbon: Change TmplTmpRtnDescrptr to TmplTmpOpaqueRtnDescrptr.
		03/24/99	Update copyright notice.
		03/19/99	Rename GetMessage to GetExceptionMessage
					since it conflicts with a Windows define.
					[W] Pass NULL to MacAppAlert for filter.
		03/04/99	[2306549] Fix allocation of hNavTypeList in GetNavFileTypes.
		02/04/99	[C] Cleaned up some unused and messages.
		01/15/99	CAEDesc_AC is now in ACS. 
		11/13/98	[2279264] Fixed improper parms passed to ProgramReport_AC.
		10/29/98	Include Navigation Services stuff only if qNavigation.
		10/15/98	[2279098] When defaultLocation is deleted also delete its AEDesc.
		10/27/98	Carbonize - no Std File support in Carbon
*/

#ifndef __UAPPLICATION__
#include "UApplication.h"
#endif

// MacApp

#ifndef __PLATFORMMEMORY__
#include "PlatformMemory.h"
#endif

#ifndef __UBEHAVIOR__
#include "UBehavior.h"
#endif

#ifndef __UCLIPBOARDMGR__
#include "UClipboardMgr.h"
#endif

#ifndef __UDEBUG__
#include "UDebug.h"
#endif

#if qDebug
	#ifndef __UDEBUGVIEW__
	#include "UDebugView.h"
	#endif
#endif

#ifndef __UDESIGNATOR__
#include "UDesignator.h"
#endif

#ifndef __UDOCUMENT__
#include "UDocument.h"
#endif

#ifndef __UERRORMGR__
#include "UErrorMgr.h"
#endif

#ifndef __UFILE__
#include "UFile.h"
#endif

#ifndef __FLOATWINDOW__
#include "FloatWindow.h"
#endif

#ifndef __UGEOMETRY__
#include "UGeometry.h"
#endif

#ifndef __UMACAPPGLOBALS__
#include "UMacAppGlobals.h"
#endif

#ifndef __UMACAPPUTILITIES__
#include "UMacAppUtilities.h"
#endif

#ifndef __UMEMORY__
#include "UMemory.h"
#endif

#ifndef __UMENUMGR__
#include "UMenuMgr.h"
#endif

#ifndef __UPATCH__
#include "UPatch.h"
#endif

#ifndef __UPERFORM__
#include "UPerform.h"
#endif

#ifndef __UPOINTEROBJECT__
#include "UPointerObject.h"
#endif

#ifndef __UPrintMgr__
#include "UPrintMgr.h"
#endif

#ifndef __UOSASCRIPT__
#include "UOSAScript.h"
#endif

#ifndef __USCRIPTING__
#include "UScripting.h"
#endif

#if qPublishSubscribe
	#ifndef __USECTIONMGR__
	#include "USectionMgr.h"
	#endif
#endif

#ifndef __USTREAM__
#include "UStream.h"
#endif

#ifndef __UTABBEHAVIORS__
#include "UTabBehaviors.h"
#endif

#ifndef __UVIEWSERVER__
#include "UViewServer.h"
#endif

#if qNeedsVU
#ifndef __UVUASSIST__
#include "UVUAssist.h"
#endif
#endif

#ifndef __UWINDOW__
#include "UWindow.h"
#endif

// ACS

#ifndef __CDependencies_AC__
#include "CDependencies_AC.h"
#endif

#ifndef __CTempGrafPort_AC__
#include "CTempGrafPort_AC.h"
#endif

#ifndef __TemplateUPP_AC__
#include "TemplateUPP_AC.h"
#endif

// Toolbox

#ifndef __AEREGISTRY__
#include <AERegistry.h>
#endif

#ifndef __DEVICES__
#include <Devices.h>
#endif

#if !qCarbon
	#ifndef __DISKINIT__
	#include <DiskInit.h>
	#endif
#endif

// For TargetIDHdl
#if !qCarbon
	#ifndef __EPPC__
	#include <EPPC.h>
	#endif
#endif

#ifndef __IMAGECOMPRESSION__
#include <ImageCompression.h>
#endif

#ifndef __LOWMEM__
#include <LowMem.h>
#endif

#ifndef __MACERRORS__
#include <MacErrors.h>
#endif

#ifndef __RESOURCES__
#include <Resources.h>
#endif

#ifndef __PMDEFINITIONS__
#include <PMDefinitions.h>
#endif

#ifndef __TOOLUTILS__
#include <ToolUtils.h>
#endif

#ifndef __TRANSLATION__
#include <Translation.h>
#endif

// ANSI

#ifndef __STDIO__
#include <stdio.h>
#endif

#include <vector>
#include <set>

using std::set;
using std::vector;

//----------------------------------------------------------------------------------------
// type definitions
//----------------------------------------------------------------------------------------

#if PRAGMA_STRUCT_ALIGN
#pragma options align=mac68k
#endif

struct RSRCopen		// the 'open' resource format for the translation manager.
{
	OSType	signature;
	short	filler;
	short	numTypes;
	OSType	types[1];
};

#if PRAGMA_STRUCT_ALIGN
#pragma options align=reset
#endif

typedef RSRCopen *RSRCopenPtr, **RSRCopenHdl;

//----------------------------------------------------------------------------------------
// Constant definitions
//----------------------------------------------------------------------------------------

// Constants to use with GetSysDirection() and SetSysDirection().
enum SystemJustification
{
	smSysJustLeft = 0, smSysJustRight = -1
};


//----------------------------------------------------------------------------------------
// Global variable definitions.
//----------------------------------------------------------------------------------------

TApplication*	gApplication;

bool			hadCreditsStringList;	// does the rsrc 'STR#' == kDefaultCredits exist ?
short			lastCreditsStringIndex;	// the last CPascalStr_AC in the STR# to be displayed
unsigned long	lastCreditsShownTicks;	// the tickcount when the last Credit was Shown

#if qMSWindows
CStr255_AC		originalText;			// no SetString in windows, so just use a little extra memory here
#else
StringHandle	originalText;			// the about box's original text (prior to credits)
#endif
unsigned short	waitTicks;				// how long to wait between credits 

//========================================================================================
// GLOBAL Procedures
//========================================================================================


#if qMSWindows && defined(pascal)
	// In some situations pascal will be defined at this point.
	#undef pascal
	#define pascal
#endif

static pascal Boolean DoShowAboutAppFilter(DialogRef theDialog,
										   EventRecord* theEvent,
										   short* itemHit);
//static void DoSetupTheMenus(void* yourDataPtr);

//----------------------------------------------------------------------------------------
// DoShowAboutAppFilter: 
//----------------------------------------------------------------------------------------

pascal Boolean DoShowAboutAppFilter(DialogRef theDialog,
									EventRecord* theEvent,
									short* itemHit)
{
	//��� This whole method needs to be reworked for int't character support
	bool		returnValue = false;
	CRect_AC	box;
	Handle		item;
	short		itemType;

	switch (theEvent->what)
	{
		case keyDown:
			switch (static_cast<unsigned char>(theEvent->message & charCodeMask))
			{
				case chEnter:
				case chReturn:
					DoAlertKeyDown(theDialog, ok);
					break;
			}
			break;

		case nullEvent:
			if ((TickCount() - lastCreditsShownTicks) > waitTicks)
			{
				short itemNo = 1;

				do
				{
					item = NULL;
					GetDialogItem(theDialog, itemNo, &itemType, &item, box);
					if (((itemType) & 0x7F) == statText)// we don't care if its enabled or not 
						break;
					else
						++itemNo;
				} while (item);

				CStr255_AC s(kDefaultCredits, lastCreditsStringIndex);

				if (!s.IsEmpty())
				{
					// save the original text 
#if qMSWindows
					if ((lastCreditsStringIndex == 1) && item)
						GetDialogItemText(item, originalText);
#else
					if ((lastCreditsStringIndex == 1) && ((!**originalText) && item))
					{
						CStr255_AC	originalStr;
						GetDialogItemText(item, originalStr);
						SetString((StringHandle)originalText, originalStr);
					}
#endif
					++lastCreditsStringIndex;
					lastCreditsShownTicks = TickCount();
					if (item)
						SetDialogItemText(item, s);
					waitTicks = Min_AC(static_cast<unsigned short>(s.Length()) * 6, static_cast<unsigned short>(60));
				}
				else							// no more items 
				{
					lastCreditsStringIndex = 1;
					lastCreditsShownTicks = TickCount();
					if (item)
					{
#if qMSWindows
						SetDialogItemText(item, originalText);
#else
						CStr255_AC	originalStr = **originalText;
						SetDialogItemText(item, originalStr);
#endif
					}
					waitTicks = 6 * 60;
				}
			}
			break;
	}

	// Forward on to the standard filter 
	if (gMacAppAlertFilter)
		returnValue = gMacAppAlertFilter(theDialog, theEvent, itemHit);

	return returnValue;
}

//========================================================================================
// CLASS TQuitCommand
//========================================================================================

//----------------------------------------------------------------------------------------
// TQuitCommand::TQuitCommand: 
//----------------------------------------------------------------------------------------

TQuitCommand::TQuitCommand(CommandNumber itsCommandNumber)
	:	TCommand(itsCommandNumber, gApplication, kCantUndo, kDoesNotCauseChange, NULL)
#if qAppleEventAware
	,	fRespondingToAE(false),
		fRecord(true),
		fMessage(NULL),
		fReply(NULL)
#endif
{
	++fPriority;								// Lower our priority.
}

#if qAppleEventAware

//----------------------------------------------------------------------------------------
// TQuitCommand::TQuitCommand: 
//----------------------------------------------------------------------------------------

TQuitCommand::TQuitCommand(TAppleEvent* message, TAppleEvent* reply)
	:	TCommand(cQuit, gApplication, kCantUndo, kDoesNotCauseChange, NULL),
		fRespondingToAE(true),
		fRecord(false),
		fMessage(message),
	fReply(reply)
{
	++fPriority;								// Lower our priority.
}

#endif

//----------------------------------------------------------------------------------------
// TQuitCommand::IsReadyToExecute: 
//----------------------------------------------------------------------------------------

bool TQuitCommand::IsReadyToExecute()
{
	// Don't execute Quit if application has a dialog posed modally!
	return gApplication->InModalState() ? false : fReadyToExecute;
}

//----------------------------------------------------------------------------------------
// TQuitCommand::DoIt: 
//----------------------------------------------------------------------------------------

void TQuitCommand::DoIt()
{
	try
	{
		// Anyone who wants to know we're shutting down can ask.
		gApplication->SetDone(true);
		
		// Close all windows and documents in window order then close
		// all documentless windows.  Finally, shut down the application.
		DoCloseInWindowOrder();
		DoCloseWindowlessDocuments();
		DoCloseApplication();
	}
	catch(CException_AC& theException)
	{
		DoCatchMessage_AC(theException);
		gApplication->SetDone(false);	// We're no longer shutting down.

#if qAppleEventAware
		if (fRespondingToAE)
			throw;
		else
#endif
			if (theException.GetError() != userCanceledErr)
			gApplication->ShowError(theException.GetError(), 0);
	}
}

//----------------------------------------------------------------------------------------
// TQuitCommand::DoCloseInWindowOrder: 
//----------------------------------------------------------------------------------------

void TQuitCommand::DoCloseInWindowOrder()
{
	// This will iterate through all open windows and will close the associated
	// document if there is one or will close the window if there is no document.
	// (Ghost documents are not closed here.  But their windows are.)
	// This is done by building a set of documents with windows (we use a set so
	// that we don't get duplicates),and  a list of non-document windows.
	// Then iterating each the document list closing the documents and then we
	// iterate over the window list closing them.

	// Build the lists of windows.
	set<TDocument*>		documentList;
	vector<TWindow*>	nonDocWindowList;
	
	for (CWMgrIterator iter; iter; ++iter)
	{
		TWindow* aWindow = TWindow::WMgrToWindow(iter);
		if (aWindow && (aWindow->GetFreeOnClosing() || aWindow->IsShown()))
		{
			TDocument* windowsDocument = aWindow->GetDocument();
			if (windowsDocument && !windowsDocument->GetIsGhostDocument())
				documentList.insert(windowsDocument);
			else
				nonDocWindowList.push_back(aWindow);
		}
	}

	// Close the document with windows.
	for(set<TDocument*>::iterator doc = documentList.begin(); doc != documentList.end(); doc++)
		CloseADocument(*doc);
	
	// Close the non-document windows.
	for(vector<TWindow*>::iterator win = nonDocWindowList.begin(); win != nonDocWindowList.end(); win++)
		CloseAWindow(*win);
}

//----------------------------------------------------------------------------------------
// TQuitCommand::DoCloseWindowlessDocuments: 
//----------------------------------------------------------------------------------------

void TQuitCommand::DoCloseWindowlessDocuments()
{
	// This really doesn't care if the document is windowless or not, it's
	// just that all documents with windows should have been closed by now.
	CTempAllocation tempAllocation(true);
	CTempObjectAllocation tempObjectAllocation(true);
	
	for (CNoGhostDocsIterator iter(gApplication); iter.Current(); ++iter)
		CloseADocument(iter);
}

//----------------------------------------------------------------------------------------
// TQuitCommand::CloseAWindow: 
//----------------------------------------------------------------------------------------

void TQuitCommand::CloseAWindow(TWindow* aWindow)
{
	bool record = 
		#if qAppleEventAware
			!fRespondingToAE && fRecord && 
		#endif
			(gClipboardMgr->GetClipWindow() != aWindow)
			&& aWindow->IsShown();

	CTempAllocation tempAllocation(true);
	CTempObjectAllocation tempObjectAllocation(true);
	
	CAutoPtr_AC<TCloseWindowCommand> aCloseWindowCommand = TH_new TCloseWindowCommand(cClose, aWindow);

	if (!record)
		aCloseWindowCommand->SetUseAppleEvent(false);

	aCloseWindowCommand->Process();
	aCloseWindowCommand.release();
}

//----------------------------------------------------------------------------------------
// TQuitCommand::DoCloseDocuments: 
//----------------------------------------------------------------------------------------

void TQuitCommand::CloseADocument(TDocument* aDocument)
{
	// Closing the document will close any associated windows.
	CTempAllocation tempAllocation(true);
	CTempObjectAllocation tempObjectAllocation(true);
	
	TCloseDocCommand*		aCloseCommand = aDocument->MakeCloseCommand();

#if qAppleEventAware
	if (fRespondingToAE)
		aCloseCommand->SetUseAppleEvent(false);
#endif

	aCloseCommand->Process();
}

//----------------------------------------------------------------------------------------
// TQuitCommand::DoCloseApplication: 
//----------------------------------------------------------------------------------------

void TQuitCommand::DoCloseApplication()
{
	// Final Stage: We're ready to do the final shutdown now that 
	// all windows and documents have been closed.
	CTempAllocation tempAllocation(true);
	CTempObjectAllocation tempObjectAllocation(true);
	
	CAutoPtr_AC<TQuitAppCommand> aQuitAppCommand = TH_new TQuitAppCommand(cQuit);

#if qAppleEventAware
	if (!fRecord || fRespondingToAE)
		aQuitAppCommand->SetUseAppleEvent(false);
#endif

	aQuitAppCommand->Process();
	aQuitAppCommand.release();
}

//========================================================================================
// CLASS TQuitAppCommand
//========================================================================================

//----------------------------------------------------------------------------------------
// TQuitAppCommand::TQuitAppCommand: 
//----------------------------------------------------------------------------------------

TQuitAppCommand::TQuitAppCommand(CommandNumber itsCommandNumber)
	:	TCommand(itsCommandNumber, gApplication, kCantUndo, kDoesNotCauseChange, NULL)
{
#if qAppleEventAware
	fUseAppleEvent = true;		// The default will be to record.
#endif
}

#if qAppleEventAware

//----------------------------------------------------------------------------------------
// TQuitAppCommand::MakeAppleEvent: 
//----------------------------------------------------------------------------------------

TAppleEvent* TQuitAppCommand::MakeAppleEvent()
{
	CAutoPtr_AC<TAppleEvent> theEvent(TH_new TAppleEvent(kCoreEventClass, kAEQuitApplication, gServerAddress, kAEWaitReply));

	CAEDesc_AC mySpecifier;
	gApplication->MakeObjectSpecifier(mySpecifier, formName);
	theEvent->WriteParameter(keyDirectObject, mySpecifier);

	return theEvent.release();
}

#endif	// qAppleEventAware

//----------------------------------------------------------------------------------------
// TQuitAppCommand::IsReadyToExecute: 
//----------------------------------------------------------------------------------------

bool TQuitAppCommand::IsReadyToExecute()
{
	// Don't execute Quit if application has a dialog posed modally!
	return gApplication->InModalState() ? false : fReadyToExecute;
}

//----------------------------------------------------------------------------------------
// TQuitAppCommand::DoIt: 
//----------------------------------------------------------------------------------------

void TQuitAppCommand::DoIt()
{
	try
	{
		// ��� gApplication->SetDone(true);
		gApplication->Close();
	}
	catch(CException_AC& theException)
	{
		DoCatchMessage_AC(theException);

		// ��� gApplication->SetDone(false);
		throw;
	}
	
}

//========================================================================================
// CLASS TNewDocumentCommand
//========================================================================================

//----------------------------------------------------------------------------------------
// TNewDocumentCommand::TNewDocumentCommand: 
//----------------------------------------------------------------------------------------

TNewDocumentCommand::TNewDocumentCommand(CommandNumber itsCommandNumber)
	:	TCommand(itsCommandNumber, gApplication, kCantUndo, kDoesNotCauseChange, NULL)
{
}

//----------------------------------------------------------------------------------------
// TNewDocumentCommand::DoIt: 
//----------------------------------------------------------------------------------------

void TNewDocumentCommand::DoIt()
{
	gApplication->OpenNew(fIdentifier);
}

#if qAppleEventAware

//----------------------------------------------------------------------------------------
// TNewDocumentCommand::MakeAppleEvent: 
//----------------------------------------------------------------------------------------

TAppleEvent* TNewDocumentCommand::MakeAppleEvent()
{
	// Create a recordable apple event
	CTempDesc_AC theAppDesc;
	gApplication->MakeObjectSpecifier(theAppDesc);

	return TAppleEvent::MakeCreateElementEvent(gServerAddress, kAEWaitReply, theAppDesc, cDocument, kAEBeginning, CAEDesc_AC::fgNullDesc, CAEDesc_AC::fgNullDesc);
}

#endif	// qAppleEventAware

//========================================================================================
// CLASS TFilesCommand
//========================================================================================

//----------------------------------------------------------------------------------------
// TFilesCommand constructor
//----------------------------------------------------------------------------------------

TFilesCommand::TFilesCommand(CommandNumber itsCommandNumber, CList_AC* theDocuments)
	:
#if qAppleEventAware
		TServerCommand(itsCommandNumber, gApplication, kCantUndo, kDoesNotCauseChange, NULL),
#endif
		fFileList(theDocuments)
{
	fCausesChange = false;
}

#if qAppleEventAware

//----------------------------------------------------------------------------------------
// TFilesCommand constructor
//----------------------------------------------------------------------------------------

TFilesCommand::TFilesCommand(CommandNumber		itsCommandNumber,
							 const AppleEvent&	itsMessage,
							 const AppleEvent&	itsReply)
	:	TServerCommand(itsCommandNumber, gApplication, kCantUndo, kDoesNotCauseChange, NULL, itsMessage, itsReply),
		fFileList(NULL)
{
	fCausesChange = false;

	// Check to see what is in the direct object list
	GetFilesList();
}

#endif	// qAppleEventAware

//----------------------------------------------------------------------------------------
// TFilesCommand::Free: 
//----------------------------------------------------------------------------------------

TFilesCommand::~TFilesCommand()
{
	for (TemplateIterator_AC<TFile*> iter(fFileList); iter; ++iter)
		delete iter.Current();
}

#if qAppleEventAware

//----------------------------------------------------------------------------------------
// TFilesCommand::GetFilesList: 
//----------------------------------------------------------------------------------------

void TFilesCommand::GetFilesList()
{
	// Check to see what is in the direct object list
	CAEDesc_AC directObj;
	::ThrowIfOSErr_AC(AEGetParamDesc(fMessage, keyDirectObject, typeAEList, directObj));
	long theCount = 0;
	::ThrowIfOSErr_AC(AECountItems(directObj, &theCount));
	if (theCount > 0)
	{
		// Get the first descriptor and see what type it is
		DescType theKey;
		CTempDesc_AC theDesc;
		::ThrowIfOSErr_AC(AEGetNthDesc(directObj, 1, typeWildCard, &theKey, theDesc));
	}

	CHandleList_AC aHandleList;

	CList_AC * aFileList = NULL;
	try
	{
		aFileList = NewList_AC();

		fMessage->ReadHandleList(keyDirectObject, typeAlias, &aHandleList);

		// Block is necessary for correct failure handling
		{
			for (CHandleList_AC::Iterator iter(&aHandleList); iter; ++iter)
			{
				CAutoPtr_AC<TFile> aFile = gApplication->DoMakeFile(fIdentifier);
				::ThrowIfOSErr_AC(aFile->SpecifyWithAlias(AliasHandle(iter.Current())));

				aFileList->InsertLast(aFile);
				aFile.release();

				aHandleList.Delete(iter);// Delete it from the list so if we fail
				// we don't try to free it twice
				::DisposeIfHandle_AC(iter);
			}
		}
	}
	catch(CException_AC& theException)
	{
		DoCatchMessage_AC(theException);

		aHandleList.FreeAll();

		for (TemplateIterator_AC<TFile*> iter(aFileList); iter; ++iter)
			delete iter.Current();
		delete aFileList;

		throw;
	}

	fFileList = aFileList;
	directObj.DisposeDesc();
}

#endif	// qAppleEventAware

//========================================================================================
// CLASS TODocCommand
//========================================================================================

//----------------------------------------------------------------------------------------
// TODocCommand::DoIt: 
//----------------------------------------------------------------------------------------

void TODocCommand::DoIt()
{
	gApplication->OpenOld(fIdentifier, fFileList);
}

#if qAppleEventAware

//----------------------------------------------------------------------------------------
// TODocCommand::MakeAppleEvent: 
//----------------------------------------------------------------------------------------

TAppleEvent* TODocCommand::MakeAppleEvent()
{
	CAutoPtr_AC<TAppleEvent> theEvent(TH_new TAppleEvent(kCoreEventClass, kAEOpenDocuments, gServerAddress, kAEWaitReply));

	CTempDesc_AC theList;
	theList.CreateList();

	for (TemplateIterator_AC<TFile*> iter(fFileList); iter; ++iter)
	{
		// CFileSpec_AC::GetAlias simply calls NewAliasMinimal which makes a new
		// alias handle for us. It is not the same as the one cached by the file object. 
		// PutListItem calls AEPutDesc which copies the AEDesc data into the list. 
		// It can't take over the data handle because then it wouldn't be possible
		// to put an AEDesc more than once. This is confirmed in TN IC 5.5. 
		// Making theAliasDesc the owner of theAlias ensures that it won't leak. 
		AliasHandle theAlias = NULL;
		OSErr theErr = (*iter).GetAlias(theAlias);
		CTempDesc_AC theAliasDesc(typeAlias, (Handle)theAlias);
		if (theErr == noErr)
			theList.PutListItem(0, theAliasDesc);
	}

	theEvent->WriteParameter(keyDirectObject, theList);

	return theEvent.release();
}

#endif	// qAppleEventAware

#if qAppleEventAware
//========================================================================================
// CLASS TPDocCommand
//========================================================================================

//----------------------------------------------------------------------------------------
// TPDocCommand constructor
//----------------------------------------------------------------------------------------

TPDocCommand::TPDocCommand(CommandNumber itsCommandNumber, CList_AC* theDocuments)
	:	TFilesCommand(itsCommandNumber, theDocuments)
{
	if (TPrintHandler::gPrintHandler == NULL)
		ThrowError_AC(kPMNoDefaultPrinter);

	fRequiresUserInteraction = true;
}

//----------------------------------------------------------------------------------------
// TPDocCommand constructor 
//----------------------------------------------------------------------------------------

TPDocCommand::TPDocCommand(CommandNumber		itsCommandNumber,
						   const AppleEvent&	itsMessage,
						   const AppleEvent&	itsReply)
	:	TFilesCommand(itsCommandNumber, itsMessage, itsReply)
{
	if (TPrintHandler::gPrintHandler == NULL)
		ThrowError_AC(kPMNoDefaultPrinter);

	fRequiresUserInteraction = true;

	bool draggedToDTP = false;				// this will let us support cDragPrint

	AEDescList dtpList;
	OSErr err = AEGetAttributeDesc(&itsMessage, keyOptionalKeywordAttr, typeAEList, &dtpList);
	if (err == noErr)
	{
		draggedToDTP = true;

		AEKeyword theKeyword;
		DescType typeCode;
		Size actualSize;

		OSErr err = AEGetNthPtr(&dtpList, 1, typeFSS, &theKeyword, &typeCode, (Ptr) & fTargetPrinter, sizeof(CFSSpec_AC), &actualSize);
#if qProjectBuilder
		(void) err;
#endif
		AEDisposeDesc(&dtpList);
	}

	fIdentifier = draggedToDTP ? cDragPrint : fIdentifier;
}

//----------------------------------------------------------------------------------------
// TPDocCommand::DoIt: 
//----------------------------------------------------------------------------------------

void TPDocCommand::DoIt()
{
	gApplication->PrintDocuments(fIdentifier, fFileList, fTargetPrinter.name[0] ? &fTargetPrinter : NULL);
}

#endif	// qAppleEventAware

//========================================================================================
// CLASS TAboutBoxCommand
//========================================================================================

//----------------------------------------------------------------------------------------
// TAboutBoxCommand::IAboutBoxCommand: 
//----------------------------------------------------------------------------------------

TAboutBoxCommand::TAboutBoxCommand(CommandNumber itsCommandNumber)
	:	TCommand(itsCommandNumber, gApplication, kCantUndo, kDoesNotCauseChange, NULL)
{
}

//----------------------------------------------------------------------------------------
// TAboutBoxCommand::DoIt: 
//----------------------------------------------------------------------------------------

void TAboutBoxCommand::DoIt()
{
	::ThrowIfOSErr_AC(MAInteractWithUser());

	gApplication->DoAboutBox();
}

//========================================================================================
// CLASS TApplication
//========================================================================================

//----------------------------------------------------------------------------------------
// TApplication::TApplication: 
//----------------------------------------------------------------------------------------

TApplication::TApplication(OSType itsMainFileType, OSType itsCreator)
	:	TDispatcher(itsMainFileType, itsCreator),
#if qNavigation
#if defined(__SC__)
		fWantsNavigationServices(false),
			// Default fWantsNavigationServices to false for 68K version (at least under MPW),
			// since NavPutFile call in TFileBasedDocument::RequestFileNameByNavSvcs()
			// fails most of the time (dropped into MacsBug) under PPC system (tested under
			// OS 8.1 with NavService SDK 1.0).  It looks like it is interfering with an Appearance
			// extension MDEF or CDEF.  NavPutFile succeed only when other application is using
			// NavService, probably beause all the needed resources are loaded then.
#else
		fWantsNavigationServices(true),
#endif
#endif
		fLaunchWithNewDocument(true),
		fUseQuickTimePreview(true)
#if qDebug
		, fDebugFlagsWindow(NULL)
#endif
{
	// This is a special case.  It needs to be available as soon as possible.
	gApplication = this;

	try
	{
		// Install the default tab  behavior 
		AddBehavior(TH_new TMultiWindowTabber);

		// Register views so we can create them from templates
#if qDebug
		TDebugFlagsView::InitUDebugView();
#endif
	}
	catch(CException_AC& theException)
	{
		DoCatchMessage_AC(theException);

#if qDebug
		::ProgramBreak_AC("Can't initialize the application object!");
#endif
		gApplication = NULL;
		throw;
	}
}

//----------------------------------------------------------------------------------------
// TApplication destructor
//----------------------------------------------------------------------------------------

TApplication::~TApplication()
{
	gApplication = NULL;
}

#if qNeedsVU

//----------------------------------------------------------------------------------------
// TApplication::DoInitialState
//----------------------------------------------------------------------------------------

void TApplication::DoInitialState()
{
	TDispatcher::DoInitialState();
	
	DoMakeVUAssist();
}

//----------------------------------------------------------------------------------------
// TApplication DoMakeVUAssist
//----------------------------------------------------------------------------------------

void TApplication::DoMakeVUAssist()
{
	// The TVUAssist constructor will set the global reference
	if (!TVUAssist::fgVUAssist)
		TVUAssist* aVUAssist = TH_new TVUAssist(gUGridViewInitialized);
}

#endif // qNeedsVU

//----------------------------------------------------------------------------------------
// TApplication::CanOpenDocument: 
//----------------------------------------------------------------------------------------

bool TApplication::CanOpenDocument(CommandNumber itsCommandNumber, TFile* aFile)
// CanOpenDocument is called only when opening and existing file or printing from
// the finder and from standard file.  It simulates the filtering done by Standard
// File.  This method returns true if the document to be opened meets specified
// criteria.  MacApp calls CanOpenDocument when opening or printing documents from the 
// Finder and when using Standard File to open a document.
//
// itsCommandNumber:	A CommandNumber that indicates what is to be done with the file.
// aFile:				A pointer to a TFile that is to be printed or opened.
//
// Call?		Rarely.  Call if you come up with a special reason why file filtering
//				is required.
// Override?	As needed.

{
#if qCarbon
	bool					canOpen = false;
	CAEDesc_AC*				defaultLocation = NULL;
	NavReplyRecord			customReply;
	customReply.validRecord = false;
	NavDialogOptions		dialogOptions;
	NavEventProcPtr			eventFilter;
	NavPreviewProcPtr		previewProc;
	NavCallBackUserData		callBackUD;
	NavTypeListHandle		navTypeList = NULL;
	NavObjectFilterProcPtr	objectFilter;

	GetNavSvcsFileParameters(itsCommandNumber, defaultLocation, customReply,
							 dialogOptions, eventFilter, previewProc,
							 callBackUD, navTypeList, objectFilter);

	CStr255_AC				fileName(aFile->GetName());	// The name of the file to be examined.
	short					numTypes = 0;		// The number of file types in our list.

	if (navTypeList)
		numTypes = (*navTypeList)->osTypeCount;
	
	NavFileOrFolderInfo		fileInfo;			// For now we'll just fill this in from
	CInfoPBRec				paramBlock;			// a call to GetCatInfo.
	
	if (numTypes)
	{
		// We have a list of file types against which we can test.
		for (short i = 0; i < numTypes; ++i)
		{
			if (aFile->GetCachedFileType() == (*navTypeList)->osType[i])
			{
				if (!objectFilter)
					canOpen = true;
				else if (aFile->GetNavFileOrFolderInfo(fileInfo) == noErr)
				{
					paramBlock.hFileInfo.ioNamePtr = (StringPtr)fileName;
					CTempDesc_AC	fileDesc;
					::ThrowIfOSErr_AC(::AECreateDesc(typeFSS, aFile->GetFileSpec(), sizeof(CFSSpec_AC), fileDesc));
					// Call through the supplied filterProc
					canOpen = objectFilter(&fileDesc, &fileInfo, callBackUD, -1);
				}
				break;
			}
		}
	}
	else
	{
		if (!objectFilter)
			canOpen = true;					// no file filter then want all types
		else if (aFile->GetNavFileOrFolderInfo(fileInfo) == noErr)
		{
			paramBlock.hFileInfo.ioNamePtr = (StringPtr)fileName;
			CTempDesc_AC	fileDesc;
			::ThrowIfOSErr_AC(::AECreateDesc(typeFSS, aFile->GetFileSpec(), sizeof(CFSSpec_AC), fileDesc));
			// Call through the supplied filterProc.  
			canOpen = objectFilter(&fileDesc, &fileInfo, callBackUD, -1);
		}
		else
			canOpen = false;
	}

	navTypeList = (NavTypeListHandle)::DisposeIfHandle_AC((Handle)navTypeList);

	return canOpen;
#else
	bool					canOpen = false;
	FileFilterYDProcPtr		fileFilter;
	TypeListHandle			typeList = NULL;
	short					dlgID;
	CPoint_AC				where;
	DlgHookYDProcPtr		dlgHook;
	ModalFilterYDProcPtr	modalFilter;
	short*					activeList;
	ActivateYDProcPtr		activateProc;
	void*					yourDataPtr = NULL;

	GetStandardFileParameters(itsCommandNumber, fileFilter, typeList, dlgID, where, dlgHook, modalFilter, activeList, activateProc, NULL, yourDataPtr);

	CStr255_AC	fileName(aFile->GetName());
	CInfoPBRec paramBlock;

	short numTypes = static_cast<short>(GetHandleSize((Handle)typeList) / sizeof(ResType));
	if (!numTypes)
	{
		if (!fileFilter)
			canOpen = true;					// no file filter then want all types
		else if (aFile->GetCatInfo(paramBlock) == noErr)
		{
			paramBlock.hFileInfo.ioNamePtr = fileName;
			// Call through the supplied filterProc
			canOpen = !fileFilter(&paramBlock, NULL);
		}
		else
			canOpen = false;
	}
	else
		for (short i = 0; i < numTypes; ++i)
			if (aFile->GetCachedFileType() == (*typeList)[i])
			{
				if (!fileFilter)
					canOpen = true;
				else if (aFile->GetCatInfo(paramBlock) == noErr)
				{
					paramBlock.hFileInfo.ioNamePtr = fileName;
					// Call through the supplied filterProc
					canOpen = !fileFilter(&paramBlock, NULL);
				}
				else
					canOpen = false;
				break;
			}

	typeList = (TypeListHandle)::DisposeIfHandle_AC((Handle)typeList);

	return canOpen;
#endif
}

#if qAppleEventAware

//----------------------------------------------------------------------------------------
// TApplication::ChooseApplication: 
//----------------------------------------------------------------------------------------

bool TApplication::ChooseApplication(AEAddressDesc& theAddress)
// ChooseApplication poses a program linking dialog box that allows the user 
// to select a running application, and returns the Apple event address of
// that application. The method returns true if the user chooses an application.
//
// theAddress:	receives the Apple event address of the chosen application.
//
// Call?		As needed.
// Override?	Seldom.
{
	bool returnValue = false;

#if qCarbon
	#pragma unused (theAddress)
	//#pragma message ("TApplication::ChooseApplication PPCBrowser isn't linking to Carbon")
#else
	TargetIDHdl theTargetID;
	LocationNameRec theLoc;
	PortInfoRec thePortInfo;

	OSErr theErr = PPCBrowser(gEmptyString, gEmptyString, false, &theLoc, &thePortInfo, NULL, gEmptyString);
	if (theErr == noErr)
	{
		theTargetID = (TargetIDHdl)NewPermHandle(sizeof(TargetID));

		(*theTargetID)->location = theLoc;
		(*theTargetID)->name = thePortInfo.name;
		theAddress.descriptorType = typeTargetID;
#if qCarbon
		theAddress.dataHandle = (AEDataStorage)theTargetID;
#else
		theAddress.dataHandle = (Handle)theTargetID;
#endif
		returnValue = true;
	}
	else if (theErr != userCanceledErr)
		::ThrowIfOSErr_AC(theErr);
#endif
	return returnValue;
}

#endif	// qAppleEventAware

//----------------------------------------------------------------------------------------
// TApplication::ChooseDocument: 
//----------------------------------------------------------------------------------------

bool TApplication::ChooseDocument(CommandNumber itsCommandNumber, CList_AC** aFileList)
{
#if qCarbon
	return ChooseDocumentWithNavSvcs(itsCommandNumber, aFileList);
#else
#if qNavigation
	if (fWantsNavigationServices && ::NavServicesAvailable())
		return ChooseDocumentWithNavSvcs(itsCommandNumber, aFileList);
	else
#endif
		return ChooseDocumentWithStdFile(itsCommandNumber, aFileList);
#endif
}

#if !qCarbon

//----------------------------------------------------------------------------------------
// TApplication::ChooseDocumentWithStdFile
//----------------------------------------------------------------------------------------

bool TApplication::ChooseDocumentWithStdFile(CommandNumber	itsCommandNumber,
											 CList_AC**		aFileList)
{
	typedef SFTypeList*		SFTypeListPtr;
	typedef SFTypeListPtr*	SFTypeListHandle;

	TFile*					aFile = NULL;
	bool					fileChosen = false;

	FileFilterYDProcPtr		fileFilter;
	TypeListHandle			typeList;
	short					dlgID;
	CPoint_AC				where;
	DlgHookYDProcPtr		dlgHook;
	ModalFilterYDProcPtr	modalFilter;
	short*					activeList;
	ActivateYDProcPtr		activateProc;
	StandardFileReply		customReply;
	void*					yourDataPtr = NULL;

	GetStandardFileParameters(itsCommandNumber, fileFilter, typeList, dlgID, where, dlgHook, modalFilter, activeList, activateProc, &customReply, yourDataPtr);

	SFTypeListPtr pTypeList;
	short numTypes = static_cast<short>(GetHandleSize((Handle)typeList) / sizeof(ResType));
	if (!numTypes)
	{
		numTypes = -1;						// Tell Std File to display all types.
		pTypeList = (SFTypeListPtr) & pTypeList;// arbitrary, as long as it points to 4 bytes of valid memory
	}
	else
	{
		LockHandleHigh((Handle)typeList);	// in case Std File does allocations 
		pTypeList = *((SFTypeListHandle)typeList);
	}

	// Causes TApplication::GetEvent to call CheckRsrcUsage. 
	gRsrcCheck = 0;

	try
	{
		aFile = DoMakeFile(itsCommandNumber);

		::ThrowIfOSErr_AC(MAInteractWithUser());

		if (!yourDataPtr)
			yourDataPtr = &itsCommandNumber;

		gClipboardMgr->AboutToLoseControl(true);// so scrap gets converted

		CTempFileFilterYDUPP 	cgfFileFilter(fileFilter);
		CTempDlgHookYDUPP 		cgfDlgHook(dlgHook);
		CTempModalFilterYDUPP 	cgfModalFilter(modalFilter);
		CTempActivateYDUPP 		cgfActivateProc(activateProc);

		if (fUseQuickTimePreview && HasQuickTime_AC())
			CustomGetFilePreview(cgfFileFilter, numTypes, (*pTypeList), &customReply, dlgID, where, cgfDlgHook, cgfModalFilter, activeList, cgfActivateProc, yourDataPtr);
		else
			CustomGetFile(cgfFileFilter, numTypes, (*pTypeList), &customReply, dlgID, where, cgfDlgHook, cgfModalFilter, activeList, cgfActivateProc, yourDataPtr);

		gClipboardMgr->RegainControl(true);	// so scrap gets converted

		fileChosen = customReply.sfGood;
		if (fileChosen)
			aFile->SpecifyWithStandardFileReply(customReply);
		}
		catch(CException_AC& theException)
		{
			DoCatchMessage_AC(theException);
			typeList = (TypeListHandle)::DisposeIfHandle_AC((Handle)typeList);
			delete aFile;
			aFile = NULL;
			throw;
		}

		typeList = (TypeListHandle)::DisposeIfHandle_AC((Handle)typeList);

	if (fileChosen)
	{
		try
		{
			// Return the file(s) chosen 
			*aFileList = NewList_AC();
			(*aFileList)->InsertLast(aFile);
		}
		catch(CException_AC& theException)
		{
			DoCatchMessage_AC(theException);
			if (*aFileList)
			{
				delete *aFileList;
				*aFileList = NULL;
			}
			delete aFile;
			aFile = NULL;
			throw;
		}
	}
	else										// user canceled or something 
	{
		delete aFile;	// free the unwanted file object 
		aFile = NULL;
	}
	return fileChosen;
}

#endif

#if qNavigation

//----------------------------------------------------------------------------------------
// TApplication::ChooseDocumentWithNavSvcs
//----------------------------------------------------------------------------------------

bool TApplication::ChooseDocumentWithNavSvcs(CommandNumber itsCommandNumber, CList_AC** aFileList)
// ChooseDocumentWithNavSvcs presents a Navigation Services file picker and, if one or more
// files have been selected, returns true and the list of selected files.  Note that this
// method will allow more than one file to be selected.  You can control the kinds of files
// which are presented in the file picker via the GetFileTypeList method.  Provide a
// customization of GetNavSvcsFileParameters if you need to customize the presentation further.
// customize the NavSvcs presentation.
//
// itsCommandNumber: Specifies the command number of the command that caused
//		 ChooseDocumentWithNavSvcs to be called.
// aFileList: Receives the list of TFile objects.
//
//	Call?		Never, call ChooseDocument instead.  MacApp calls this method for you, if you
//				have Navigation Services Instaled.
//	Override?	As needed.
{
	bool					fileChosen = false;

	NavObjectFilterProcPtr	objectFilter;
	NavPreviewProcPtr		previewProc;
	NavEventProcPtr			eventFilter;
	NavReplyRecord			customReply;
	customReply.validRecord = false;
	NavCallBackUserData		callBackUD;
	CAEDesc_AC*				defaultLocation = NULL;
	NavDialogOptions		dialogOptions;
	NavTypeListHandle		typeList = NULL;

	#if qDebug
		if (!fWantsNavigationServices && !::NavServicesAvailable())
			::ProgramBreak_AC("TApplication::ChooseDocumentWithNavSvcs: called but Navigation Services not available");
	#endif

	OSErr err = ::NavGetDefaultDialogOptions(&dialogOptions);
	::ThrowIfOSErr_AC(err);

	GetNavSvcsFileParameters(itsCommandNumber, defaultLocation, customReply, dialogOptions, 
			eventFilter, previewProc, callBackUD, typeList, objectFilter);

	gRsrcCheck = 0;			// Causes TApplication::GetEvent to call CheckRsrcUsage. 

	try
	{
		::ThrowIfOSErr_AC(MAInteractWithUser());
		gClipboardMgr->AboutToLoseControl(true);	// so scrap gets converted

		CTempNavObjectFilterUPP	cgfFileFilter(objectFilter);
		CTempNavPreviewUPP		cgfPreview(previewProc);
		CTempNavEventUPP		cgfEventProc(eventFilter);

		// Safety harness for NavSvcs which crashes if there is no current port.
		{
#if !qCarbon
			CTempGrafPort_AC tempPort(gWorkPort);
#else
			CTempGrafPort_AC tempPort(gWorkCPort);
#endif
			err = ::NavGetFile(defaultLocation ? (AEDesc*)*defaultLocation : (AEDesc*)NULL,
						&customReply, &dialogOptions, cgfEventProc,
						cgfPreview, cgfFileFilter, typeList, callBackUD);
		}
		
		gClipboardMgr->RegainControl(true);			// so scrap gets reconverted
		::ThrowIfOSErr_AC(err);

		fileChosen = customReply.validRecord;

		if (fileChosen)
			GetFilesListFromNavReply(itsCommandNumber, customReply, aFileList);
	}
	catch(CException_AC& theException)
	{
		DoCatchMessage_AC(theException);
		if (userCanceledErr != theException.GetError())
		{
			if (typeList)
				ReleaseResource(reinterpret_cast<Handle>(typeList));
			if (defaultLocation)
			{
				defaultLocation->DisposeDesc();
				delete defaultLocation;
			}
			::NavDisposeReply(&customReply);
			throw;
		}
	}

	if (typeList)
		ReleaseResource(reinterpret_cast<Handle>(typeList));

	if (defaultLocation)
	{
		defaultLocation->DisposeDesc();
		delete defaultLocation;
	}
	::NavDisposeReply(&customReply);

	return fileChosen;
}

//----------------------------------------------------------------------------------------
// TApplication::ChooseFolderWithNavSvcs
//----------------------------------------------------------------------------------------

bool TApplication::ChooseFolderWithNavSvcs(CommandNumber itsCommandNumber, CFSSpec_AC& theFolder)
// ChooseFolderWithNavSvcs presents a Navigation Services folder picker and, if a folder
// has been selected, returns true and the specification of the selected folder.  This
// method will allow only one folder to be selected.  Provide a customization of
// GetNavSvcsFileParameters if you need to customize the NavChooseFolder presentation further.
//
// itsCommandNumber:	Specifies the command number of the command that caused
//		 				ChooseFolderWithNavSvcs to be called.
// theFolder:			Receives the FSSpec of the selected folder.
//
//	Call?		If you need to select a folder. There is no StdFile equivalent to this call!
//	Override?	As needed.
{
	bool					folderChosen = false;
	NavObjectFilterProcPtr	objectFilter;
	NavPreviewProcPtr		previewProc;
	NavEventProcPtr			eventFilter;
	NavReplyRecord			customReply;
	customReply.validRecord = false;
	NavCallBackUserData		callBackUD;
	CAEDesc_AC*				defaultLocation = NULL;
	NavDialogOptions		dialogOptions;
	NavTypeListHandle		typeList = NULL;

	#if qDebug
		if (!fWantsNavigationServices && !::NavServicesAvailable())
			::ProgramBreak_AC("TApplication::ChooseFolderWithNavSvcs: called but Navigation Services not available");
	#endif

	OSErr err = ::NavGetDefaultDialogOptions(&dialogOptions);
	::ThrowIfOSErr_AC(err);

	gRsrcCheck = 0;			// Causes TApplication::GetEvent to call CheckRsrcUsage. 

	try
	{
		GetNavSvcsFileParameters(itsCommandNumber, defaultLocation, customReply, dialogOptions, 
				eventFilter, previewProc, callBackUD, typeList, objectFilter);
		typeList = (NavTypeListHandle)DisposeIfHandle_AC((Handle)typeList);	// The typeList is not needed.

		::ThrowIfOSErr_AC(MAInteractWithUser());	// Make sure we can interact with user.
		gClipboardMgr->AboutToLoseControl(true);	// Forces clipboard conversion.
		
		CTempNavObjectFilterUPP		cgfFileFilter(objectFilter);
		CTempNavEventUPP			cgfEventProc(eventFilter);
		
		// Safety harness for NavSvcs which crashes if there is no current port.
		{
#if !qCarbon
			CTempGrafPort_AC tempPort(gWorkPort);
#else
			CTempGrafPort_AC tempPort(gWorkCPort);
#endif
			err = ::NavChooseFolder(defaultLocation ? (AEDesc*)*defaultLocation : (AEDesc*)NULL,
				&customReply, &dialogOptions, cgfEventProc, cgfFileFilter, callBackUD);
		}
				
		gClipboardMgr->RegainControl(true);			// Forces clipboard conversion.

		::ThrowIfOSErr_AC(err);

		folderChosen = customReply.validRecord;

		if (folderChosen)
		{
			// Convert the selected folder into an FSSpec. 
			CAEDesc_AC directObj = customReply.selection;
			CTempDesc_AC theItem(directObj.GetNthItem(1, typeFSS));
			CFSSpec_AC theFSSpec = theItem.GetFSSpec();
			theFolder = theFSSpec;
		}
	}
	catch(CException_AC& theException)
	{
		DoCatchMessage_AC(theException);
		if (userCanceledErr != theException.GetError())
		{
			if (defaultLocation)
			{
				defaultLocation->DisposeDesc();
				delete defaultLocation;
			}
			::NavDisposeReply(&customReply);
			throw;
		}
	}

	if (defaultLocation)
	{
		defaultLocation->DisposeDesc();
		delete defaultLocation;
	}
	::NavDisposeReply(&customReply);

	return folderChosen;
}

//----------------------------------------------------------------------------------------
// TApplication::ChooseVolumeWithNavSvcs
//----------------------------------------------------------------------------------------

bool TApplication::ChooseVolumeWithNavSvcs(CommandNumber itsCommandNumber, CFSSpec_AC& theVolume)
// ChooseVolumeWithNavSvcs presents a Navigation Services volume picker and, if a volume
// is selected, returns true and the specification of the selected volume.  This
// method will allow only one volume to be selected.  Provide a customization of
// GetNavSvcsFileParameters if you need to customize the NavChooseVolume presentation further.
//
// itsCommandNumber:	Specifies the command number of the command that caused
//		 				ChooseVolumeWithNavSvcs to be called.
// theFolder:			Receives the list of TFile objects.
//
//	Call?		If you need to select a volume. There is no StdFile equivalent to this call!
//	Override?	As needed.
{

	bool					volumeChosen;
	NavObjectFilterProcPtr	objectFilter;
	NavPreviewProcPtr		previewProc;
	NavEventProcPtr			eventFilter;
	NavReplyRecord			customReply;
	customReply.validRecord = false;
	NavCallBackUserData		callBackUD;
	CAEDesc_AC*				defaultLocation = NULL;
	NavDialogOptions		dialogOptions;
	NavTypeListHandle		typeList = NULL;

	#if qDebug
		if (!fWantsNavigationServices && !::NavServicesAvailable())
			::ProgramBreak_AC("TApplication::ChooseVolumeWithNavSvcs: called but Navigation Services not available");
	#endif

	OSErr err = ::NavGetDefaultDialogOptions(&dialogOptions);
	::ThrowIfOSErr_AC(err);

	gRsrcCheck = 0;

	try
	{
		GetNavSvcsFileParameters(itsCommandNumber, defaultLocation, customReply, dialogOptions, 
				eventFilter, previewProc, callBackUD, typeList, objectFilter);
		typeList = (NavTypeListHandle)DisposeIfHandle_AC((Handle)typeList);	// The typeList is not needed.

		volumeChosen = false;

		::ThrowIfOSErr_AC(MAInteractWithUser());	// Make sure user interaction is okay.
		gClipboardMgr->AboutToLoseControl(true);	// Convert the clipboard.
		
		CTempNavObjectFilterUPP		cgfFileFilter(objectFilter);
		CTempNavEventUPP			cgfEventProc(eventFilter);

		// Safety harness for NavSvcs which crashes if there is no current port.
		{
#if !qCarbon
			CTempGrafPort_AC tempPort(gWorkPort);
#else
			CTempGrafPort_AC tempPort(gWorkCPort);
#endif
			err = ::NavChooseVolume(defaultLocation ? (AEDesc*)*defaultLocation : (AEDesc*)NULL,
					&customReply, &dialogOptions, cgfEventProc, cgfFileFilter, callBackUD);
		}
				
		gClipboardMgr->RegainControl(true);

		::ThrowIfOSErr_AC(err);

		volumeChosen = customReply.validRecord;

		if (volumeChosen)
		{
			// Convert the volume info into an FSSpec. 
			CAEDesc_AC directObj = customReply.selection;
			CTempDesc_AC theItem(directObj.GetNthItem(1, typeFSS));
			CFSSpec_AC theFSSpec = theItem.GetFSSpec();
			theVolume = theFSSpec;
		}
	}
	catch(CException_AC& theException)
	{
		DoCatchMessage_AC(theException);
		if (userCanceledErr != theException.GetError())
		{
			if (defaultLocation)
			{
				defaultLocation->DisposeDesc();
				delete defaultLocation;
			}
			::NavDisposeReply(&customReply);
			throw;
		}
	}

	if (defaultLocation)
	{
		defaultLocation->DisposeDesc();
		delete defaultLocation;
	}
	::NavDisposeReply(&customReply);

	return volumeChosen;
}

//----------------------------------------------------------------------------------------
// TApplication::CreateFolderWithNavSvcs
//----------------------------------------------------------------------------------------

bool TApplication::CreateFolderWithNavSvcs(CommandNumber itsCommandNumber,
										   CFSSpec_AC& theFolderCreated)
// CreateFolderWithNavSvcs presents a Navigation Services folder maker dialog and, if a folder
// has been created, returns true and the specification of the new folder.  Provide a customization
// of GetNavSvcsFileParameters if you need to customize the NavNewFolder presentation further.
//
// itsCommandNumber:	Specifies the command number of the command that caused
//		 				CreateFolderWithNavSvcs to be called.
// theFolder:			Receives the FSSpec of the newly created folder.
//
//	Call?		If you need to create a folder. There is no StdFile equivalent to this call!
//	Override?	As needed.
{
	bool					folderCreated;
	NavObjectFilterProcPtr	objectFilter;
	NavPreviewProcPtr		previewProc;
	NavEventProcPtr			eventFilter;
	NavReplyRecord			customReply;
	customReply.validRecord = false;
	NavCallBackUserData		callBackUD;
	CAEDesc_AC*				defaultLocation = NULL;
	NavDialogOptions		dialogOptions;
	NavTypeListHandle		typeList = NULL;

	#if qDebug
		if (!fWantsNavigationServices && !::NavServicesAvailable())
			::ProgramBreak_AC("TApplication::CreateFolderWithNavSvcs: called but Navigation Services not available");
	#endif

	OSErr err = ::NavGetDefaultDialogOptions(&dialogOptions);
	::ThrowIfOSErr_AC(err);

	gRsrcCheck = 0;		// Causes TApplication::GetEvent to call CheckRsrcUsage.

	try
	{
		GetNavSvcsFileParameters(itsCommandNumber, defaultLocation, customReply, dialogOptions, 
				eventFilter, previewProc, callBackUD, typeList, objectFilter);
		typeList = (NavTypeListHandle)DisposeIfHandle_AC((Handle)typeList);	// The typeList is not needed.

		folderCreated = false;

		::ThrowIfOSErr_AC(MAInteractWithUser());	// Make sure we can interact with the user.
		gClipboardMgr->AboutToLoseControl(true);	// Force the scrap to be converted.
		
		CTempNavEventUPP	cgfEventProc(eventFilter);

		// Safety harness for NavSvcs which crashes if there is no current port.
		{
#if !qCarbon
			CTempGrafPort_AC tempPort(gWorkPort);
#else
			CTempGrafPort_AC tempPort(gWorkCPort);
#endif
			err = ::NavNewFolder(defaultLocation ? (AEDesc*)*defaultLocation : (AEDesc*)NULL,
				&customReply, &dialogOptions, cgfEventProc, callBackUD);
		}
				
		gClipboardMgr->RegainControl(false);		// so scrap gets converted

		::ThrowIfOSErr_AC(err);

		folderCreated = customReply.validRecord;

		if (folderCreated)
		{
			// Convert the created folder into an FSSpec. 
			CAEDesc_AC directObj = customReply.selection;
			CTempDesc_AC theItem(directObj.GetNthItem(1, typeFSS));
			CFSSpec_AC theFSSpec = theItem.GetFSSpec();
			theFolderCreated = theFSSpec;
		}
	}
	catch(CException_AC& theException)
	{
		DoCatchMessage_AC(theException);
		if (userCanceledErr != theException.GetError())
		{
			if (defaultLocation)
			{
				defaultLocation->DisposeDesc();
				delete defaultLocation;
			}
			::NavDisposeReply(&customReply);
			throw;
		}
	}

	if (defaultLocation)
	{
		defaultLocation->DisposeDesc();
		delete defaultLocation;
	}
	::NavDisposeReply(&customReply);

	return folderCreated;
}

//----------------------------------------------------------------------------------------
// TApplication::GetFilesListFromNavReply: 
//----------------------------------------------------------------------------------------

void TApplication::GetFilesListFromNavReply(CommandNumber itsCommandNumber,
											NavReplyRecord& itsReply,
											CList_AC** fileList)
// GetFilesListFromNavReply extracts all selected files from a Navigation Services
// Reply Record, creates a new TFile object for each of them by calling DoMakeFile,
// and stores references to the files in fileList.
//
// itsCommandNumber:	Specifies the command number of the command that caused
//						GetFilesListFromNavReply to be called.
// itsReply:			the reply returned by a Navigation Services routine
//						containing the files to extract
// fileList:			Receives a list of the TFile objects of the selected files.
//
// Call?		Seldom. If you need to extract files from a Navigation Reply.
// Override?	Never, not virtual.
{
	// Check to see what is in the direct object list
	CAEDesc_AC	directObj = itsReply.selection;
	long		theCount = directObj.CountListItems();
	CList_AC*	aFileList = NULL;
	
	try
	{
		aFileList = NewList_AC();

		// Block is necessary for correct failure handling
		{
			for (long i = 1; i <= theCount; i++)
			{
				TFile* aFile = DoMakeFile(itsCommandNumber);

				try
				{
					CTempDesc_AC theItem = directObj.GetNthItem(i, typeFSS);
					CFSSpec_AC theFSSpec(theItem.GetFSSpec());
					// ���	We might make the following code a SpecifyWithNavReply method for
					//		CFile_AC as it could set some additional fields, too.
					aFile->Specify(theFSSpec);

					FInfo		finderInfo;
					FXInfo		xFinderInfo;
					bool		isDirectory;
					if (aFile->GetFinderInfo(finderInfo, xFinderInfo, isDirectory) == noErr)
					{
						if (isDirectory)
						{
							aFile->SetFileType(kFolderType_AC);
							aFile->SetCreator(kFolderCreator_AC);
						}
						else
						{
							aFile->SetFileType(finderInfo.fdType);
							aFile->SetCreator(finderInfo.fdCreator);
							#if 0
								// ��� Need either a SetStationery or other solution.
								aFile->fStationery = ((finderInfo.fdFlags & kIsStationery) != 0);
							#endif
						}
					}
					aFileList->InsertLast(aFile);
					aFile = NULL;
				}
				catch(CException_AC& theException)
				{
					DoCatchMessage_AC(theException);
					delete aFile;
					aFile = NULL;
					throw;
				}
				
			}
		}
	}
	catch(CException_AC& theException)
	{
		DoCatchMessage_AC(theException);
		if (aFileList)
			for (TemplateIterator_AC<TFile*> iter(aFileList); iter; ++iter)
				delete iter.Current();
		delete aFileList;
	
		throw;
	}
	*fileList = aFileList;
}

#endif

//----------------------------------------------------------------------------------------
// TApplication::DoMakeDocument: 
//
// E X A M P L E
// {
// 		TDocument*	aYOURDocument = NULL;
//
// 		aYOURDocument = new TDocument;
// 		aYOURDocument->IYOURDocument();
//		return aYOURDocument;
// }
//----------------------------------------------------------------------------------------

TDocument* TApplication::DoMakeDocument(CommandNumber /* itsCommandNumber */,
										TFile* /* itsFile */)
{
	SubClassResponsibility();

	return NULL;								// So that CFront doesn't complain
}

//----------------------------------------------------------------------------------------
// TApplication::DoMenuCommand: 
//----------------------------------------------------------------------------------------

void TApplication::DoMenuCommand(CommandNumber aCommandNumber)
{
	// ===================================================================================
	// Some commands will be posted to perform actions that must _ALWAYS_ be available.
	// The allocation cannot be allowed to fail. So we do a temp allocation which by
	// definition cannot be allowed to fail. This strategy is used wherever we want to use
	// command objects but don't want to leave the user twisting in the breeze. NOTE:
	// Don't forget to allow for this memory in your mem! resource if you copy this style
	// in your own code.
	// ===================================================================================

	switch (aCommandNumber)
	{
#if qCarbonEvents
		case kHICommandQuit:
#endif
		case cQuit:
			{
				CTempAllocation tempAllocation(true);
				CTempObjectAllocation tempObjectAllocation(true);
				
				PostCommand(TH_new TQuitCommand(aCommandNumber));
			}
			break;

		case cNew:								// cNew..cNewLast:
		case 11:
		case 12:
		case 13:
		case 14:
		case 15:
		case 16:
		case 17:
		case 18:
		case cNewLast:
		case cFinderNew:
			DoNew(aCommandNumber);
			break;

		case cOpen:								// cOpen..cOpenLast:
		case 21:
		case 22:
		case 23:
		case 24:
		case 25:
		case 26:
		case 27:
		case 28:
		case cOpenLast:
			DoOpen(aCommandNumber);
			break;

		case cAboutApp:
			PostCommand(TH_new TAboutBoxCommand);
			break;

#if qDebug
		case cDebugFlags:
			{
				if (fDebugFlagsWindow.IsNULL())
				{
					fDebugFlagsWindow = TViewServer::fgViewServer->NewTemplateWindow(kDebugFlagsView, NULL);
					::ThrowIfNULL_AC(fDebugFlagsWindow.get());
				}
				fDebugFlagsWindow->Open();
				fDebugFlagsWindow->Select();
			}
			break;

		case cRefreshFrontWindow:
			{
				TWindow * aWindow = GetActiveWindow(kNoFloaters);

				if (aWindow)
					aWindow->ForceRedraw();
			}
			break;

		case cDoFirstClick:
			{
				TWindow * aWindow = GetActiveWindow(kNoFloaters);

				if (aWindow)
					aWindow->SetDoFirstClick(!aWindow->GetDoFirstClick());
			}
			break;

#endif

#if qPerform
		case cPerfMonInit:
			{
				CAutoPtr_AC<TWindow> aWindow = TViewServer::fgViewServer->NewTemplateWindow(kPerfMonInitView, NULL);
				::ThrowIfNULL_AC(aWindow);

				IDType dismisser = aWindow->PoseModally();
				if (dismisser == 'init')
					InitiatePerfMonitor(aWindow);
				aWindow->Close();
			}
			break;

		case cPerfMonDump:
			{
				StandardFileReply replyRec;
				StandardPutFile((StringPtr)"\pSave as:", (StringPtr)"\puntitled", &replyRec);
				if (replyRec.sfGood)
					DumpPerfMonitor(replyRec.sfFile);
			}
			break;

		case cPerfMonToggle:
			EnablePerfMonitor(!PerfMonitorEnabled());
			break;

		case cPerfMonEnd:
			TerminatePerfMonitor();
			break;
#endif

#if qMSWindows
		case cTileWindows:
			// Tile MDI windows 
			SendMessage(fChildClientWindow, WM_MDITILE, MDITILE_HORIZONTAL, 0L);
			break;
	
		case cCascadeWindows:
			// Cascade MDI windows 
			SendMessage(fChildClientWindow, WM_MDICASCADE, 0, 0L);
			break;
	
		case cArrangeIcons:
			// Auto - arrange MDI icons 
			SendMessage(fChildClientWindow, WM_MDIICONARRANGE, 0, 0L);
			break;
	
		case cCloseAll:
			{
				HWND hwndT;
				HWND lastWind = NULL;
				// As long as the MDI client has a child, destroy it 
				while ((hwndT = (HWND) ::GetWindow(fChildClientWindow, GW_CHILD)) != NULL)
				{
					// Skip the icon title windows 
					while (hwndT && ::GetWindow (hwndT, GW_OWNER))
						hwndT = ::GetWindow(hwndT, GW_HWNDNEXT);
					if ((hwndT == NULL) || (hwndT == lastWind))
						break;
					lastWind = hwndT;
					SendMessage (hwndT, WM_CLOSE, 0, 0L);
				}
			}
			break;
#endif

		default:
#if qMSWindows
			// Let Windows handle the command if we get to here.
			::DefWindowProc(fFrameWindow, WM_COMMAND, aCommandNumber, 0L);
#else
			TDispatcher::DoMenuCommand(aCommandNumber);
#endif
			break;
	}
}

//----------------------------------------------------------------------------------------
// TApplication::DoSetupMenus: 
//----------------------------------------------------------------------------------------

void TApplication::DoSetupMenus()
{
	TDispatcher::DoSetupMenus();
	
	if (!InModalState())
	{
		bool lowSpace = MemSpaceIsLow();
	
		Enable(cQuit, fEventLevel <= 1);			// Can't enable Quit if in nested event handling
		Enable(cNew, !lowSpace);
		Enable(cOpen, !lowSpace);

#if qMSWindows
		// only enable if not nested.. perhaps should also check to see if there are even any documents open
		Boolean enableWindowsMenuIItems = (fEventLevel <= 1) && (GetDocumentList()->GetSize() > 0);
		Enable(cTileWindows, enableWindowsMenuIItems);
		Enable(cCascadeWindows, enableWindowsMenuIItems);
		Enable(cArrangeIcons, enableWindowsMenuIItems);
		Enable(cCloseAll, enableWindowsMenuIItems);
#endif

#if qDebug
		{
			TWindow * aWindow = gApplication->GetActiveWindow(kNoFloaters);
	
			Enable(cRefreshFrontWindow, aWindow != NULL);
			Enable(cDoFirstClick, aWindow != NULL);
			if (aWindow)
				SetMenuState(cDoFirstClick, kDebugBuzzStrings, bzDoFirstClick, bzDontDoFirstClick, aWindow->GetDoFirstClick());
	
			Enable(cDebugFlags, true);
	
			// System Justification - see comment in Debug.r
			//	Enable(cSetSysJust, true);
			//	SetMenuState(cSetSysJust, kDebugBuzzStrings, bzSetRightSysJust, bzSetLeftSysJust, GetSysDirection() != smSysJustLeft);
		}
#endif

#if qPerform
		{
			bool initiated = PerfMonitorInitiated();
	
			Enable(cPerfMonInit, !initiated);
			Enable(cPerfMonDump, initiated);
			Enable(cPerfMonToggle, initiated);
			SetMenuState(cPerfMonToggle, kDebugBuzzStrings, bzContinuePerfMon, bzPausePerfMon, PerfMonitorEnabled());
			Enable(cPerfMonEnd, initiated);
		}
#endif
	}
}

//----------------------------------------------------------------------------------------
// TApplication::DoAboutBox: Method to display the "About" box for your application.
// Override to do interesting things. Since it is normally called from a command; the app
// usually has the maximum free space available.
//----------------------------------------------------------------------------------------

void TApplication::DoAboutBox()
{
	FailSpaceIsLow();
	::ThrowIfOSErr_AC(MAInteractWithUser());

	CString_AC apName(GetApplicationName());
	ParamText(CStr255_AC(apName), gEmptyString, gEmptyString, gEmptyString);// Put Application name in the about box 

	if (CMultiLocale_AC::GetResource('STR#', kDefaultCredits))
	{
		lastCreditsStringIndex = 1;
		lastCreditsShownTicks = TickCount();
		waitTicks = 5 * 60;
#if !qMSWindows
		originalText = NewString(gEmptyString);
		::ThrowIfNULL_AC(originalText);
		MacAppAlert(phAboutApp, DoShowAboutAppFilter);
		originalText = (StringHandle)::DisposeIfHandle_AC((Handle)originalText);
#else
		originalText = "";
		MacAppAlert(phAboutApp, DoShowAboutAppFilter);
#endif
	}
	else
		StdAlert(phAboutApp);
}

//----------------------------------------------------------------------------------------
// TApplication::HandleFinderRequest: 
//----------------------------------------------------------------------------------------

void TApplication::HandleFinderRequest()
{
}

//----------------------------------------------------------------------------------------
// TApplication::KindOfDocument: 
//----------------------------------------------------------------------------------------

CommandNumber TApplication::KindOfDocument(CommandNumber itsCommandNumber, TFile* aFile)
{
	#pragma unused (aFile)
	return itsCommandNumber;
}

//----------------------------------------------------------------------------------------
// TApplication::OpenNew: 
//----------------------------------------------------------------------------------------

TDocument* TApplication::OpenNew(CommandNumber itsCommandNumber)
{
	CAutoPtr_AC<TDocument> aDocument = DoMakeDocument(KindOfDocument(itsCommandNumber, NULL), NULL);
	::ThrowIfNULL_AC(aDocument);
	gDispatcher->AddDocument(aDocument);

	try
	{
		aDocument->SetTitle(aDocument->UntitledName());
		aDocument->DoInitialState();
		aDocument->DoMakeViews(kForDisplay);
	
		FailSpaceIsLow();						// Fail if document leaves us with no room 
	
		// Don't attempt to show the windows until we're sure we won't fail 
		aDocument->DoPostMakeViews(kForDisplay);
	}
	catch(CException_AC& theException)
	{
		DoCatchMessage_AC(theException);
		::ThrowNewMessage_AC(theException.GetError(), theException.GetExceptionMessage(), messageNewFailed);
	}
	
	return aDocument.release();
}

//----------------------------------------------------------------------------------------
// TApplication::OpenOld: 
//----------------------------------------------------------------------------------------

TDocument* TApplication::OpenOld(CommandNumber itsOpenCommand, CList_AC* aFileList)
{
	TDocument* aDocument = NULL;
	TFile* aNewFile = NULL;
	OSErr savedError = 0;
	long savedMessage = 0;
	
	Size oldCodeReserve;
	Size oldMemReserve;

	{
		// Put iterator in a separate block so that it will go out of scope before the end of the method.
		// We don't want the iterator's failure handler to be invoked, because its stack ptr is munged.
		// If an error occurs, we'll just save it and ReSignal it after the iterator is gone.

		for (TemplateIterator_AC<TFile*> iter(aFileList); iter; ++iter)
		{
			TFile* aFile = iter;
		
			CommandNumber kindOfDocCmd = KindOfDocument(itsOpenCommand, aFile);
			// reset aDocument and aNewFile so that they no longer refer to items from the
			// last go round (important in case we fail downstream)�
			aDocument = NULL;
			aNewFile = NULL;

			CString_AC fileName(aFile->GetName());	// If failure occurs the file may already be
													// freed so we will save the name just in case.

			aFileList->Delete(aFile);			// ReadStationery if successful will dispose
			// of the file for us so if failure occurs
			// this had better not be in the file list.

			try
			{
				// Set reserve down a little to ensure that we can open existing documents 
				GetReserveSize(oldCodeReserve, oldMemReserve);
				SetReserveSize(oldCodeReserve, oldMemReserve / 2);

				TDocument* otherDoc = FindDocument(aFile);
				bool isStationery = aFile->IsStationery();

				if (otherDoc && !isStationery)
				{
					otherDoc->OpenAgain(kindOfDocCmd, aDocument);
					delete aFile;
					aFile = NULL;
					SetReserveSize(oldCodeReserve, oldMemReserve);
				}
				else if (CanOpenDocument(kindOfDocCmd, aFile))
				{
					TFile* fileOwnedByDoc = aFile;
					aFile = NULL;
					::ThrowIfNULL_AC(aDocument = DoMakeDocument(kindOfDocCmd, fileOwnedByDoc));
					gDispatcher->AddDocument(aDocument);

					if (!isStationery)
						aDocument->ReadDocument(kForDisplay);
					else
					{
						aNewFile = DoMakeFile(kindOfDocCmd);
						aDocument->ReadStationery(aNewFile);
						aFile = NULL;			// This file has already been freed by ReadStationery.
						aNewFile = NULL;		// Clear our reference so that if we fail
						// we don't try to free this file twice.
					}

					aDocument->DoMakeViews(kForDisplay);

					if (isStationery)
						aDocument->SetTitle(aDocument->UntitledName());

					FailSpaceIsLow();			// Fail if the document leaves us with no
					// memory
					// Set the reserve back to where it was 
					SetReserveSize(oldCodeReserve, oldMemReserve);

					// Don't attempt to show the windows until we're sure we won't fail 
					aDocument->DoPostMakeViews(kForDisplay);
				}
				else
				{
					// If we ended up without a document because we didn't understand this type
					// of file then let's get rid of the file.
					delete aFile;
					aFile = NULL;
					::ThrowException_AC(errNotMyType, 0);
				}
			}
			catch(CException_AC& theException)
			{
				DoCatchMessage_AC(theException);
				if (!theException.GetExceptionMessage())
					gErrorParm3 = fileName;

				// We may have ended up without a document because of a failure during document
				// init. b/c this can be the case we don't know what happened to aFile, whether 
				// it was freed by the document in the failure process or orphaned. Because of
				// this we will not free aFile here.
				if (aDocument)
				{
					delete aDocument;// The document will free the file
					aDocument = NULL;
				}

				delete aNewFile;		// If we successfully read the
				aNewFile = NULL;		// stationery then aNewFile will be NULL

				// Set the reserve back to where it was 
				SetReserveSize(oldCodeReserve, oldMemReserve);

				//	Don't want to fail here, because the CObjectIterator (with its embedded FailInfo) is 
				//	still in scope. Instead, save the error info until after the iterator has self-destructed.
				//	::ThrowNewMessage_AC(theException.GetError(), theException.GetMessage(), messageOpenFailed);
				savedError = theException.GetError();
				savedMessage = theException.GetExceptionMessage();
				if (!savedMessage)
					savedMessage = messageOpenFailed;
			}
			
		}
	}

	if (savedError != noErr)					// Do we need to ReSignal a failure?
	{
		// signal the failure
		::ThrowException_AC(savedError, savedMessage);
	}
	return aDocument;
}

//----------------------------------------------------------------------------------------
// TApplication::PrintDocuments: 
//----------------------------------------------------------------------------------------

void TApplication::PrintDocuments(CommandNumber		itsCommandNumber,
								  CList_AC*			aFileList,
								  const CFSSpec_AC*	targetPrinter)
{
	TPrintHandler::gFinderPrintingProceed = true;// set in TStdPrintHandler::DoPrintCommand
	
	if (TPrintHandler::gPrintHandler != NULL)
	{
		TPrintHandler::gPrintHandler->PrepareForFinderPrinting(targetPrinter);
	
		for (TemplateIterator_AC<TFile*> iter(aFileList); iter; ++iter)
		{
			TFile * aFile = iter;
			
			if (TPrintHandler::gFinderPrintingProceed)
			{
				CAutoPtr_AC<TDocument> aDocument;
	
				CommandNumber kindOfDocCmd = KindOfDocument(itsCommandNumber, aFile);
	
				if (CanOpenDocument(kindOfDocCmd, aFile))
				{
					try
					{
						aDocument = DoMakeDocument(KindOfDocument(itsCommandNumber, aFile), aFile);
						::ThrowIfNULL_AC(aDocument);
						gDispatcher->AddDocument(aDocument);
	
						aDocument->ReadDocument(kForPrinting);
						aDocument->DoMakeViews(kForPrinting);
						aDocument->DoPostMakeViews(kForPrinting);
		
						aDocument->HandleMenuCommand(itsCommandNumber);
					}
					catch(CException_AC& theException)
					{
						DoCatchMessage_AC(theException);
						// If there is a document then it will have a reference to aFile and
						// will free it when it is freed. Therefore we need to remove it from
						// the list so that when the file list is freed we don't attempt to
						// free it twice.
						if (aDocument)
							aFileList->Delete(aFile);
		
						throw;
					}
				}
				else
				{
					// If we ended up without a document because we didn't understand this type
					// of file then let's get rid of the file.
					delete aFile;
					ThrowException_AC(errNotMyType, 0);
				}
				
				aFileList->Delete(aFile);
			}
			else
				break;								// The user canceled printing
		}
	}
#if qDebug
	else
	{
		::ProgramReport_AC("TApplication::PrintDocuments: Called but TPrintHandler::gPrintHandler is NULL.");
	}
#endif
}

#if qNavigation

//----------------------------------------------------------------------------------------
// TApplication::GetNavFileTypes: 
//----------------------------------------------------------------------------------------

void TApplication::GetNavFileTypes(CommandNumber itsCommandNumber, NavTypeListHandle& navTypeList)
// GetNavFileTypes returns a NavTypeListHandle with list of file types supported
// by this application.  This is collected from the appropriate bundle resource 
//
// itsCommandNumber:	Specifies the command number of the command that caused
//						GetOpenResource to be called.
// navTypeList:			Receives the list of file types as an NavTypeList handle.
//
// Call?		Seldom. 
// Override?	Seldom.
{
#if 1
	#pragma unused (itsCommandNumber)
	
	navTypeList = reinterpret_cast<NavTypeListHandle>(GetResource('open', 128 /* scBundleID */));
	if (navTypeList)
	{
		DetachResource(reinterpret_cast<Handle>(navTypeList));
		ThrowIfResError_AC();
	}
	// ���  We need to define scBundleID.
#else
	// ��� Future support for Translation Services.  Incomplete.
	enum
	{
		kMaxTranslationTypes = 100
	};

	RSRCopenHdl	open = (RSRCopenHdl)CMultiLocale_AC::GetResource('open', 128);

	if (open)		// if the user provided an 'open' resource, then
	{				// we can compute the file list on the fly!
		// Get native types out of resource
		short		nativeTypes = (**open).numTypes;
		Size		size	 	= nativeTypes * sizeof(OSType);
		typeList	= (TypeListHandle) NewPermHandleClear(HasTranslationManager_AC()
														  ? kMaxTranslationTypes*sizeof(OSType)
														  : size);
		BlockMove(&(**open).types, *typeList, size);						// copy 'em over

		if (HasTranslationManager_AC())
		{
			// if we have the translation manager, we can extend the list

			short newTypes = kMaxTranslationTypes - nativeTypes;
			::Lock_AC(static_cast<Handle>(typeList));
			OSErr err = ExtendFileTypeList(*typeList, nativeTypes, &(*typeList)[nativeTypes], &newTypes);
			::Unlock_AC(static_cast<Handle>(typeList));
			SetHandleSize(static_cast<Handle>(typeList), (newTypes + nativeTypes) * sizeof(OSType));
			ThrowIfMemError_AC();
			ThrowIfOSErr_AC(err);
		}
	}
#endif
}

#endif

#if !qCarbon

//----------------------------------------------------------------------------------------
// TApplication::GetStandardFileParameters: 
//----------------------------------------------------------------------------------------

void TApplication::GetStandardFileParameters(CommandNumber itsCommandNumber,
											 FileFilterYDProcPtr& fileFilter,
											 TypeListHandle& typeList,
											 short& dlgID,
											 CPoint_AC& where,
											 DlgHookYDProcPtr& dlgHook,
											 ModalFilterYDProcPtr& modalFilter,
											 short*& activeList,
											 ActivateYDProcPtr& activateProc,
											 StandardFileReply* reply,
											 void*& yourDataPtr)
{
	#pragma unused (reply)

	dlgID = 0; // Let the system decide
	where = kBestSystemLocation;

	GetFileTypeList(itsCommandNumber, typeList);

	fileFilter = NULL;
	dlgHook = NULL;
	modalFilter = gModalFilterYDProcPtr;
	activeList = NULL;
	activateProc = NULL;
	yourDataPtr = NULL;
}

#endif

#if qNavigation

//----------------------------------------------------------------------------------------
// TApplication::GetNavSvcsFileParameters
//----------------------------------------------------------------------------------------

void TApplication::GetNavSvcsFileParameters(CommandNumber			itsCommandNumber,
											CAEDesc_AC*&			defaultLocation,
											NavReplyRecord&			customReply,
											NavDialogOptions&		dialogOptions,
											NavEventProcPtr&		eventFilter,
											NavPreviewProcPtr&		previewProc,
											NavCallBackUserData&	callBackUD,
											NavTypeListHandle&		navTypeList,
											NavObjectFilterProcPtr&	objectFilter)
// GetNavSvcsFileParameters returns the settings to be used in the parameters used
// as arguments to the various Navigation Services procedures: NavGetFile, NavChooseFolder,
// NavChooseVolume, and NavCreateFolder.  The default implementation returns the parameters
// previously provided by GetStandardFileParameters and also returns the list of supported
// file types as specified by the GetNavFileTypes method.
//
// itsCommandNumber:	is the command number of the command that caused
//						GetNavSvcsFileParameters to be called.
// defaultLocation:		The item you want to be shown when you open the dialog.
// customReply:			Not used.
// dialogOptions:		holds various options such as dialog location on screen,
//						allow multiple files, etc. 
// eventFilter:			Receives a modal�dialog filter function that is used by the
//						Navigation Services.  Defaults to MacAppNavigationEventFilter.
// previewProc:			Can receive a preview procedure that you can use to display your 
//						documents in the preview area.  Defaults to NULL.
// callBackUD:			Receives a pointer to optional data supplied by your application
//						and used by your callback routines.  Defaults to NULL.
// typeList:			Receives a list of file types supported by the
//						application.  Defaults to the types returned by GetFileTypeList.
// objectFilter:		Specifies a procedure that allows only files/folders of a specified
//						type to be displayed.  Defaults to NULL.
//
// Call?		Seldom.
// Override?	As needed, to modify the behavior of the Navigation Services package.  For
//				example, if you implement your own preview proc or you want to receive more files at
//				a time.  If you need to supply special filtering for the modal dialog,
//				override TApplication::NavEventFilter.  If you need to supply an extended type
//				list, override TApplication::GetNavFileTypes.
{
	#pragma unused (customReply)

	GetNavFileTypes(itsCommandNumber, navTypeList);
	defaultLocation = NULL;
	eventFilter = MacAppNavigationEventFilter;
	previewProc = NULL;
	callBackUD = NULL;
	objectFilter = NULL;

	CString_AC	appName(GetApplicationName());
	appName.AsStr255(dialogOptions.clientName);

	if (fUseQuickTimePreview)		// it can display previews in addition to QT previews
		dialogOptions.dialogOptionFlags |= kNavAllowPreviews;	
	else
		dialogOptions.dialogOptionFlags &= ~kNavAllowPreviews;	// no preview

	dialogOptions.dialogOptionFlags &= ~kNavAllowMultipleFiles;	// one file
	dialogOptions.location = kBestSystemLocation;
	callBackUD = NULL;
}

#endif

//----------------------------------------------------------------------------------------
// TApplication::GetFileTypeList: 
//----------------------------------------------------------------------------------------

void TApplication::GetFileTypeList(CommandNumber theCmdNumber, TypeListHandle& typeList)
{
	#pragma unused (theCmdNumber)
#if qMSWindows
	typeList = (TypeListHandle) NewPermHandle(0);
#else
	typeList = (TypeListHandle) NewPermHandle(sizeof(OSType));
	(*typeList)[0] = fMainFileType;
#endif
}

//----------------------------------------------------------------------------------------
// TApplication::DoNew: 
//----------------------------------------------------------------------------------------

void TApplication::DoNew(CommandNumber theCmdNumber)
{
	TNewDocumentCommand * aNewDocCommand = TH_new TNewDocumentCommand(theCmdNumber);
#if qAppleEventAware
	if (TOSADispatcher::fgDispatcher && !TOSADispatcher::fgDispatcher->GetDispatchLevel())
		aNewDocCommand->SetUseAppleEvent(true);
#endif
	PostCommand(aNewDocCommand);
}

//----------------------------------------------------------------------------------------
// TApplication::DoOpen: 
//----------------------------------------------------------------------------------------

void TApplication::DoOpen(CommandNumber theCmdNumber)
{
	CList_AC * aFileList = NULL;

	if (ChooseDocument(theCmdNumber, &aFileList))
	{
		TODocCommand * anODocCommand = TH_new TODocCommand(theCmdNumber, aFileList);
#if qAppleEventAware
		if (TOSADispatcher::fgDispatcher && !TOSADispatcher::fgDispatcher->GetDispatchLevel())
			anODocCommand->SetUseAppleEvent(true);
#endif
		PostCommand(anODocCommand);
	}
}

#if qAppleEventAware

//----------------------------------------------------------------------------------------
// TApplication::DoAECreateElement: 
//----------------------------------------------------------------------------------------

void TApplication::DoAECreateElement(TAppleEvent* message, TAppleEvent* reply)
{
	// Creates a new document. If your application has more than one type of document
	// you'll need to override this method. The default simulates choosing "New" from
	// the file menu.
	DescType theClass = message->ReadType(keyAEObjectClass);
	if (IsDocumentClass(theClass) || (theClass == cWindow))
	{
		if (CommandEnabled(cNew))
		{
			TDocument * theDoc = OpenNew(cNew);
			// Apply the properties if any.
			theDoc->SetPropertiesFromEvent(message);

			// Apply the initial data if any
			if (message->HasParameter(keyAEData))
				theDoc->DoAESetData(message, reply);

			// Return the document's object specifier
			CTempDesc_AC theDocsSpecifier;
			theDoc->MakeObjectSpecifier(theDocsSpecifier, formName);
			if (reply->dataHandle)
				reply->WriteParameter(keyAEResult, theDocsSpecifier);
		}
	}
}

#endif	// qAppleEventAware

#if qAppleEventAware

//----------------------------------------------------------------------------------------
// TApplication::DoAEClose: 
//----------------------------------------------------------------------------------------

void TApplication::DoAEClose(TAppleEvent* message, TAppleEvent* reply)
{
	if (::CommandEnabled(cQuit))
	{
		CTempAllocation tempAllocation(true);
		CTempObjectAllocation tempObjectAllocation(true);
		
		TQuitCommand * quitCommand = TH_new TQuitCommand(message, reply);
		quitCommand->Process();
	}
}

#endif	// qAppleEventAware

#if qAppleEventAware

//----------------------------------------------------------------------------------------
// TApplication::DoScriptCommand: 
//----------------------------------------------------------------------------------------

void TApplication::DoScriptCommand(CommandNumber	aCommandNumber,
								   TAppleEvent*		message,
								   TAppleEvent*		reply)
{
	switch (aCommandNumber)
	{
		case cFinderNew:
			// Special case the old MacPaint style open if user knows about the option
			// key. Only if the application is frontmost though.
			if (IsFrontProcess() && IsOptionKeyDown())
				HandleMenuCommand(cOpen);
			else if (fLaunchWithNewDocument)
				GetTarget()->HandleMenuCommand(cFinderNew);
			break;

		case cFinderOpen:
			PostCommand(TH_new TODocCommand(aCommandNumber, *message, *reply));
			break;

		case cFinderPrint:
		case cDragPrint:
			PostCommand(TH_new TPDocCommand(aCommandNumber, *message, *reply));
			break;

#if qPublishSubscribe
		case cSectionRead:
		case cSectionWrite:
		case cSectionScroll:
		case cSectionCancel:
			{
				TSectionMgr * aSectionMgr = dynamic_cast_or_throw_AC(TSectionMgr*,GetBehaviorWithIdentifier(kSectionMgrBehaviorID));
				
				aSectionMgr->DoAESectionEvent(aCommandNumber, *message, *reply);
			}
			break;
#endif

		default:
			TDispatcher::DoScriptCommand(aCommandNumber, message, reply);
			break;
	}
}

#endif	// qAppleEventAware

#if qMSWindows

//----------------------------------------------------------------------------------------
// TApplication::DoInitialState
//----------------------------------------------------------------------------------------

void TApplication::DoInitialState()
{
	TDispatcher::DoInitialState();
	if (fLaunchWithNewDocument)
		PostCommand(TH_new TNewDocumentCommand(cFinderNew));
}

#endif

//----------------------------------------------------------------------------------------
// End of UApplication.cpp

/*
	Historical Change Record:
		----- R13 -----
		07/13/97	THandleList is now CHandleList_AC
		07/09/97	Replaced AllocateObjectsFromPerm with TempAllocation.
		07/08/97	[1141803] (Translation) (ASI.ENG) TApplication.GetFileTypeList() should use 'open' rsrc
		07/02/97	[1385766] Call gApplication->SetDone in TQuitCommand::DoIt instead of in
							TQuitAppCommand::DoIt so that everyone will know we're shutting down instead
							of just closing things.
		06/23/97	[1661306] #ifndef __ImageCompression__ changed to #ifndef __IMAGECOMPRESSION__.
		06/22/97	Added include of EPPC.h.
		06/11/97	[1139446] Added DoMakeVUAssist class factory, call it from DoInitialState.
							Removed remnant qPowerTalk include.
		06/09/97	Use dynamic_cast_AC where we expected dynamic_cast to always work.
		06/04/97	[1615892] Check result of dynamic_cast.
		05/23/97	Removed unused autoptr temp from TFilesCommand::GetFilesList.
							It caused a crash during cleanup after an exception (see 1657921)
		04/30/97	Removed qPowerTalk.
		04/23/97	Remove Clone declarations from classes we don't clone.
		04/14/97	Update for real xxx_cast operators.
		04/13/97	Update List and Dependency names for ACS.
		04/04/97	Added TApplication::fUseQuickTimePreview. Set to false to use standard getfile
		04/11/97	Made TApplication::WMgrToWindow conditioned on BackwardCompatible. Use TWindow::WMgrToWindow
		04/10/97	Remove remainder of qContainer flagged code.
		04/09/97	properly use dynamic casting for all down/side casts
		04/08/97	Update for TAdorner/TBehavior/TEventHandler/TCommandHandler/TCommand/
							TFileBasedDocument/TSection/TEditionDocument protected fields.
		04/04/97	Update for TView/TWindow/TDispatcher protected fields.
		03/25/97	AC_ to _AC Name change.
		03/24/97	Migrated Dependencies and Lists to ACS
		03/17/97	Remove segmentation support.
		03/11/97	Update exception support to latest.
		03/07/97	TApplication::PrintDocuments should call CanOpenDocument just like TApplication::OpenOld
		03/07/97	Massive Changes: Use Exceptions_AC, new to TH_new, use Blah_AC,
							Update Copyright, Moved Obsolete APIs into Compatibility.h, etc..
		02/13/97	Fixed qALOE typo (thanks to Jon Pugh).
		12/18/96	Grafted ALOE dispatcher as conditional base class.
		09/30/96	Change local MAauto_ptrs to stack based object allocations where possible
		09/20/96	Remove include for UBusyCursor.
		09/10/96	Added call to initialization function for UDebugView
		08/26/96	[1353613] (GX Printing) "Edit" Menu disable problems
		08/16/96	Use constructors for all TView descendents
		08/15/96	Use constructors for all TCommand descendents
		08/14/96	Use constructors for all TDispatcher descendents
		08/13/96	Use constructors for all TBehavior descendents
		08/12/96	Use constructors for all CDynamicArray_AC descendents
		08/10/96	Fixed -noload compiles, made more datamembers auto_ptrs, FreeIfObject->delete
		08/01/96	T[Sorted]List now takes a void* T[Sorted]VoidList now typedefed to T[Sorted]List
		07/22/96	Use templates for many Iterator subclasses.
		07/17/96	define template CAutoPtr_AC and use it in place of CTempObject
		07/16/96	Removed MAVolatile
		07/16/96	Replacing Failxxx with Throwxx procs
		07/16/96	Changed references to failinfos to references of CException_AC
		07/16/96	Goodbye Exception Macros (TRY, CATCH_ALL, ENDTRY)
		07/15/96	Boolean->bool
		----- R11 -----
		06/27/96	Make conditional tests implicit as in if(x) instead of if(x != 0).
		06/26/96	Changed nil back to NULL.
		06/26/96	Install release marker.  Scope many globals.  Change TRUE/FALSE/NULL.
		06/26/96	==/!=NULL to implicit tests, except in the case of assignment to or passing/returning as bool/bool.
		06/20/96	[1353802] GetWindowToClose no longer considers ANY
							non-MacApp windows.
		06/20/96	[1290382] (Strings) CStr255_AC could have constructor for STR# id & index
		06/19/96	[1357782] Free aFile upon failure in CanOpenDocument in 
							TApplication::OpenOld.
		06/19/96	SCpp and MrCpp can't handle declarations in the expression portion of while loops
							so we just changed them all to for loops
		06/17/96	Couple of loose ends on 114989 tied up.
		06/17/96	[114989] Record all quitting-related commands.  Dumped fInProcessP
							which is no longer needed.
		06/12/96	Started the release process, removing triple-�, initials,
							inappropriate comments.
		05/10/96	Use CustomGetFilePreview if running on machine with quicktime. Toss the old
							SFPut/GetFile and use CustomPut/GetFile in all cases since it is always present w/system 7
		05/09/96	Adjust the Failure Handling macros to allow for easy switching to native exceptions.
		 5/08/96	Create and use CFSSpec_AC. You should search/replace in your code to switch to
		 					CFSSpec_AC.
		 5/08/96	Cleanup CRGBColor_AC and add new class CTextStyle_AC
		05/07/96	Made TAppleEvent derive from CAEDesc_AC as well as TObject.
		05/02/95	Call FreeIfObject, don't call Free directly since it will eventually be removed.
		04/30/96	Make all constructors use initialization lists if they weren't already
							doing do. Switch several more empty constructors to inlines.
		04/25/96	More use of CTempxxx classes instead of Failure handling where poss.
		04/24/96	Use PRE-Increment/Decrement operators whenever possible for eff.
		04/23/96	Use CTempObject/Handle/Region/Ptr, etc.
		04/18/96	Use post-increment with iterators in while loops
		04/17/96	Make all functions single entry/single exit. Use CWMgrIterator in GetWindowToClose
							since it is safe to use there.
		04/16/96	Use even more "while" style iteration
		04/16/96	Use more "while" style iteration
		04/16/96	Use "while" style iteration
		----- R10 -----
		03/30/96	Call gPrintHandler->PrepareForFinderPrinting
		03/27/96	Replace several BlockMoves_AC with string operations
		03/26/96	Cleanup references to gEmptyString
		03/22/96	[1331566] Fixed double-free in a couple of MakeAppleEvents.
		03/21/96	Make drag printing work again.
		03/18/96	Added #include for UPrintHandler
		03/18/96	Remove compatibility hacks.
		03/11/96	Remove include of and knowledge of UPrinting
		03/14/96	Replaced curly quotes with straight single quote.
		02/28/96	[115887] Unesscessary ReSignals, Copyright
		02/28/96	[1327965] Don't override various command's recording setting if
							it is already false.  Also cleaned up a bunch of junk.
							laying around after the MOM work.
		02/26/96	[1304835] Don't record closing of a hidden window.
		02/21/96	[1304266] Don't free TCloseWindowCommand in TQuitCommand::CloseAWindow.
		 1/10/96	Add back code to enable debug and perform menu items. 
		12/19/95	Don't need failure handler in DoIt just for SetValidationError. 
		 12/8/95	Bring back MAInteractWithUser. 
							Move a lot of code to UDispatcher. 
		11/29/95	Move performance monitor dialog to UPerform. 
		 10/6/95	Simplify debug output code. 
		  8/9/95	Add eventInfo parameter to calls to CADispatchEvent. 
		  5/7/95	Move SelectToolboxWindow from TApplication to UWindow. 
		  					Add CALib support. Add HandleMenuEvent. 
		----- 3.3 -----
		11/15/95	In TApplication::RegainControl now call all TDocument::RegainControl.
		 11/6/95	CWMgrIterator is unsafe to use while closing windows. 
		11/01/95	Check InteractWithUser before posing about box (this affects DoAboutBox
							and IAboutyBoxCommand).  Make TODocCommand::MakeAppleEvent kAEWaitReply.
		11/02/95	Undo aevt calls DoUndoRedoInContext.
							UndoRedoInContext processes command instead of posting.
		 11/1/95	Include comments showing how to use Mercutio MDEF in
							TApplication::DoCommandKeyEvent to get modifier sensitive commandkeys. 
		11/01/95	Missed a 68k only instance of InteractWithUser.
		11/01/95	InteractWithUser calls AEInteractWithUser (used to call
							MAInteractWithUser). Support kMacAppTimeout.
		 11/1/95	Make drag cursor and script idle code resident. 
							Don't unload segments while in the alert filter. 
							Move call to UnloadAllSegments out of SpaceIsLowAlert. 
							This makes SpaceIsLowAlert a single-purpose function. 
							Remove extra call to UnloadAllSegments from the beginning
							of Run. 
		11/01/95	Unload segments in TApplication::Idle. 
		10/31/95	Catch failures in TrackCursor and Idle. 
		10/31/95	Add CurResFile_AC, Fix UseResFile_AC to avoid unnecessary UseResFile calls.
		10/27/95	Test result of theDoc->GetUserSelection()
							in TApplication::GetObjectProperty.
							ActivateBusyCursor returns old state.
		10/26/95	Changed TApp::DoScriptCommand/cUndo handling.
		10/24/95	Replace calls to GetBestType with GetSpecifierForm.
		10/23/95	Remove GetContainedObject code that allowed access to
							invisible windows by name. Cleanup GetWindowByIndex,
							GetPaletteByIndex. Filter out invisible palettes in
							GetPaletteByIndex.
		10/21/95	Use GetBestType() in calls to MakeObjectSpecifier. 
		10/17/95	Simplify debug output code. 
		10/17/95	Removed obsolete use of __CW5__ in TApplication::GetEvent.
		10/17/95	[1292285] Added accessor/mutator for fMainEventMask.
		10/11/95	Remove erroneous reference to gApplication->MAInteractWithUser.
		10/11/95	[1263154] Cleaned up the AllocateObjectsFromPerm calling.
		10/10/95	Add/call TApplication::InteractWithUser. Virtual bottleneck.
		10/10/95	[1290707] Process closing in window order.  Changed TQuitCommand
							functions.
		 9/26/95	[1276050] Check for read-only items [pName, pIsFrontProcess,
		 					pVersion, pUserSelection] in TApplication::SetObjectProperty.
		 9/25/95	Removed TQuitCommand::Completed.
		 9/23/95	Removed obsolete comment from TQuitCommand::DoIt.
		 9/23/95	Don't record closing of clipboard window.
		 9/22/95	Add/use CNoGhostDocsIterator.
		 9/15/95	If in a modal state, only front window handles cursor.
		----- 3.3b1 -----
		  9/7/95	Quit apple event is class 'aevt'.
		  9/7/95	Simplified quit's closing of documents and windows.
		  9/6/95	Minor cleanup in TQuitCommand::DoIt and change
		  					Tapplication::DoAEClose so errors are not unnecessarily
		  					repropogated.
		 8/30/95	TApplication::HandleCursor focuses to the window when completed in order
		 					to leave the window unclipped and set to 0,0 origin for English Speech Recog.
							and others.
		 8/29/95	Report/present any errors in TQuitCommand::Completed.
		 					This should be done in an abstract command class which knows
							that it has subordinate commands which may fail.
							Don't propogate the error returned from AEProcessAppleEvent in
							TApplication::HandleHighLevelEvent since we are now bottlenecking errors
							in TOSADispatcher::DispatchHandlerGlue.
		 8/23/95	Cleaned up TQuitCommand.  Removed fQuitState.
							Added modal loop to TApplication::DoAEClose.  TApplication::CloseToolBoxWindow
							no longer returns a bool.  Unnecessary window closing code was removed
							from TApplication::Close.  Various calls to ReportError were changed to
							SetValidationError.  TQuitAppCommand now derives from TCommand.  TQuitCommand
							links itself to the various close doc/window commands.  TQuitCommand::DoIt was
							restructured.  A Completed was added to TQuitCommand.
		 8/22/95	TQuitCommand is no longer recurring but is free on completion.
		 					TApplication::Close no longer has to check for open windows
							and documents
		08/28/95	Check for currentFrontWindow not being NULL before using it in SelectToolBoxWindow
		08/28/95	Don't keep controls off the owning window anymore. Only remove them
							for the duration of the SelectWindow call.
		 8/16/95	Removed modal loop in DoAEClose since TQuitCommand was
		 					changed to derive from TServerCommand.
		 8/14/95	TApplication::DoAECreateElement calls SetPropertiesFromEvent.
		 8/14/95	Add overloaded initializers for TServerCommand. 
		 8/11/95	Misplaced endif qDrag in HandleCursor. 
		 8/10/95	Commented out unused parameter in IQuitCommand.
		  8/9/95	Execution of DoAEClose was made modal so that errors could be
		  					reported to the client properly.
		  8/9/95	Add StandardFileReply to GetStandardFileParameters. 
		  8/8/95	Made TQuitCommand recurring rather than have it repost itself 
		  					each iteration and set its priority lower so that the AEs and other 
							commands it spawns get handled first.
		  8/7/95	Fixed bug in closing of non-MA windows.  Also some small
		  					changes in TQuitCommand.
		08/02/95	Added cDragPrint to support Desktop Printers (GX and non-GX)
							Added parameter to TApplication::PrintDocuments to identify the calling command.
		  8/4/95	CloseToolboxWindow returns a bool so we can tell if the
							user canceled. Add EQuitState and fQuitState to
							TQuitCommand. 
		  8/3/95	Enhanced recordability of the quit.
		  8/3/95	Remove references to TWindow::HandlesDragCursor.
		 7/30/95	Added sending of mAboutToLoseControl, mRegainControl messages
		  8/1/95	Fix to compile with -noDrag. 
		 7/31/95	Added recordability support to TODocCommand.
		 7/31/95	Don't need to specify kDragOrClick for HandleMouseDown. 
		 7/31/95	Added recordability support to TODocCommand.
		 7/31/95	ClickThrough: TApplication::GetDefaultCursorRegion removes
		 					inactive draggable windows from the default region.
							TApplication::HandleCursor supports setting drag cursor over
							inactive windows w/draggable content.
		07/29/95	Added TWindow::BeginUpdate and EndUpdate as well as the global functions:
							GetUpdateRegion and GetVisRegion. Proper usage of these makes MacApp
							able to use the BeginUpdate and EndUpdate Traps. This allows using QD GX in MacApp
		07/26/95	change fLastPrinterName to gLastPrinterName of static CStr255_AC, it doesn't need to be
							in the freestore and it is shared for the whole application.
							Removed RedoIt method of TPrintStyleChangeCommand and added default
							Parameter to IPrintStyleChangeCommand for isUndoable. The command is
							created and executed in all cases now. Changed PrinterDriverHasChanged
							to HasPrinterDriverChanged.
							StripToPage now takes a CCoordPoint_AC to identify the strip.
							Created a TPrinter object and a TPrintInfo object
		 7/28/95	Add configuration functions to use instead of gConfiguration. 
		 7/27/95	Conditionalize attachability support. 
							No longer need MakeGlobalScripts. 
		 7/26/95	Move MakeGlobalScripts to COSAScript. 
							Put scripting setup code back in IApplication so it is
							available early enough. 
		 7/25/95	fgGenericScriptingComponent moves from TOSADispatcher to
							CScriptingComponent. 
		 7/22/95	Make sure InitUScripting has been called. 
		 7/18/95	PRAGMA_ALIGN_SUPPORTED. 
		  7/7/95	Integrate CW6 debugging changes.
		  7/5/95	Move OSADispatcher setup code from IApplication to Run,
							so it won't fragment the heap as much. 
		 6/18/95	CheckRsrcUsage is not conditioned on #qDebug anymore. It is
		 					conditioned internally by gCheckRsrcUsage. 
		 6/29/95	Remove GetMyAddress.
		 6/28/95	TApplication's RTTI didn't include MDefaultScriptableObject. 
		 6/28/95	Remove unused function IsOpen, don't include ULoMem. 
		 6/28/95	Reorder scripting method params.
		 					Change DoMakeDoItAppleEvent to MakeAppleEvent.
		 					Change fUseDoItAppleEvent to fUseAppleEvent.
		 6/27/95	GetPaletteByIndex didn't initialize result to nil.
		 6/12/95	Moved PowerTalk support from TApplication to MMailing. 
		 6/15/95	TApplication::DoScriptCommand calls 
		 					MDefaultScriptableObject::DoScriptComand
		 6/14/95	TNewDocumentCommand uses new scriptable command model
		 5/17/95	#Include for USegments
		  6/9/95	Use TOSADispatcher::fgDispatcher
							Support param reorder of MScritpableObject::DoScriptCommand
							Change OSAEvent to HandleOSAEvent
							Post Quit command from DoAEClose instead of sending AEVT
							Support TAppleEvent::fgIdleProc and fgEventFilter
							DoMenuCommand creates Quit command with fUseDoItAppleEvent = true
							IApplication sets up scripting component (temporary)
							Mix MDefaultScriptableObject instead of MScriptableObject
							Convert Quit command to new style (DoMakeDoItAppleEvent)
		 5/16/95	DialogRef, more WindowRef changes. 
		 5/16/95	MenuRef, WindowRef
		05/05/95	Remove support for pre-system 7
		 4/14/95	save/lock and restore handle state instead of lock and unlock
		 4/04/95	fix several places that were still testing zoomdocproc instead of spareflag.
							Add support for compatible floating wdef id
		 4/12/95	Use #if instead of if for qDebug. Make sure
		 					gIntenseDebugging is conditionalized. 
		 4/12/95	Base class constructors called from mem initializers don't
		 					rely on default arguments.
		  4/5/95	Floating windows are AEOM palettes.
		  					Add GetPaletteByIndex. Cleanup GetIndContainedObjects.
							CountContainedObjects supports palettes.
		  4/1/95	Completed OLE and COM implementation.
		 3/30/95	Eliminate unnecessary includes. Change old includes (Desk,
		 					GestaltEQU, OSEvents) to new equivalents. 
		 3/21/95	ARM 8.4.3 x& cannot be initialized with volatile x. 
		03/20/95	fix bug in my previous fix 1139284 where apple menu was not
							properly re-enabled after non-movable modals.
		 3/20/95	Add fWantKeyUpEvents. 
		03/20/95	1154862 Allow Command Drag of behind windows during modal. 
		03/20/95	1139284 Allow access to Apple menu (except first item) during modal windows. 
		 3/17/95	Moved call to SetEventMask from IApplication to Run. 
		 3/17/95	MAVolatile. 
		03/13/95	1184037 (GER.XSE0039)  Bug in TApplication::OpenOld
		03/13/95	1173488 TApplication::UpdateAllWindows can get into an infinite loop
		03/07/95	1161932	(SPEED) HiliteMenu takes 13% of execution time + fix
		 3/14/95	Add TLetter and TFileBaseLetter classes. 
		 3/13/95	Change Free methods to destructors. 
		  3/8/95	Add WakeProcess.
		 2/28/95	Use MA_REGISTER_CLASS instead of macroDontDeadStrip. 
		 2/27/95	Move don't dead strip of TDebugFlagsView from UDebug to here
							because this is where it is used. 
		02/22/95	1222850 MacApp should use BlockMove_AC and BlockMoveOverlap_AC everywhere
		02/22/95	1185932 add kBestSystemLocation for -1,-1 window locations
		02/13/95	Remove unnecessary initialization of static variables. See ARM �8.4 
		02/08/95	1160119 Remove use of kNoStaticLink. 
		02/08/95	replace usage of staticLink with yourDataPtr. 
		02/07/95	1139284 Allow access to Apple menu (except first item) during modal windows. 
		02/07/95	1154862 Allow Command Drag of behind windows during modal. 
		02/07/95	Create missing prototypes for static functions used internally. 
		 2/17/95	More attachability changes. 
		 1/26/95	Include CWDebugging. Rewrite TQuitCommand::DoIt to 
							send an AppleEvent. In TApplication::Close, call FreeOSAScript
							to free any attached script. In DoMenuCommand, add 
							'this' as the target object parameter for DoUndoRedo. 
							Remove case for cAEUndo/cAERedo. Add break to cPerfMonEnd case. 
							Add the fixes for qUniversal2Headers. In GetEvent, add
							Metrowerks code for giving events to the SIOUX window. 
							Add call to IdleOSAScript in TApplication::Idle. 
							Bug fix so TApplication::Run always calls CleanupMacApp. 
							Add a target parameter to DoUndoRedo. Add the target 
							desc to the undo/redo Apple Event. 
							Use CAEDesc_AC::CreateList instead of AECreateList. 
							Use CAEDesc_AC::PutListItem instead of AEPutDesc. 
							In TApplication::DoAECreateElement, instead of looping 
							over the document's contained items and setting their
							property, just call the document's SetContents method. 
							Change TApplication::DoAEClose so instead of using
							fPoseResult, it will iterate over the documents and
							close them (except the clipboard view's document). 
							DoAEClose now actually returns a reply. 
							Add TApplication::OSAHandledEvent. 
							In DoScriptCommand, remove case for cFinderQuit. For
							cAEUndo and cAERedo, call UndoRedoInContext instead of
							HandleMenuCommand. Pass cPaste, cCut and cCopy to
							HandleMenuCommand instead of cAEPaste, cAECut and
							cAECopy. Add desiredType to GetObjectProperty. 
							Add TApplication::GetContainedObject. 
							Add code to TApplication::ReportReplyError to put up
							an error alert if there is anything in the error string
							parameter. 
		 2/14/95	TApplication::MakeObjectSpecifier now returns a bool.
		 2/13/95	TApplication::GetObjectProperty returns a bool. Failure
							handlers in GetObjectProperty don't resignal.
		----- 3.5d3 Release -----
		 12/7/94	Add support for debug output with CodeWarrior 5.0. 
		11/17/94	Change NULL to nil. 
		11/14/94	Fix to do masking and shifting correctly. 
		 11/7/94	Added qSegments. 
		 11/2/94	Added break after cPerfMonEnd, as per Mark Anderson. 
		 11/1/94	Always call CleanupMacApp, not just in debug (1193709). 
		10/27/94	Compile with ETO 15 prerelease headers. 
							Compile with -modelCFM. 
		 9/22/94	Moved script event dispatching code into a new
							TScriptEventDispatcher object.
		 9/14/94	Add FindLetter, CanOpenLetter, IsLetterFileType.
							Add AEOM menu accessors. Remove DoAppleCommand.
							Add support for AOCE mailers.
		 8/29/94	TApplication::GetDocumentByIndex walks the window
							list looking for the Nth window associated with
							a document of the desired type.  It no longer
							references the dynamic array of documents. This
							way, its behavior is more consistent with what
							an applescript user would expect.
		 8/22/94	TApplication::GetDocumentByIndex no longer calls
							IsDocumentType to determine if the specified type
							is a document (per Ken Ryall).
							Cleaned up TApplication::DoNew by removing failure
							handler and consolidating code blocks (per Ken Ryall).
		 7/21/94	Remove initializer for MScriptableObject from
							TVUApplication constructor. Move the return statement
							down in MakeCreateElementEvent so as to satisfy SCpp. 
		 7/18/94	Change NULL to nil. 
		 7/10/94	Added scripting support to TApplication. This way we
							won't have both OpenNew and IFileBaseDocument. 
		  7/5/94	Change OpenNew so it considers the file to be owned
							by the document as soon as it is passed to DoMakeDocument. 
							This way we won't have both OpenNew and IFileBaseDocument
							both freeing the same file when there is a failure. 
							It is now up to the developer to free the file if there
							is a failure in DoMakeDocument before IFileBasedDocument. 
		 6/30/94	Change ChooseApplication to use TargetIDHdl as defined
							in EPPC.h instead of cooking up its own version. 
		 6/27/94	OpenNew and OpenOld now return the document that was
							opened. PollToolboxEvent now returns a bool whether
							an event was gotten and processed. 
		 6/22/94	Add back call to CleanupMacApp. 
		 6/14/94	Change SelectToolboxWindow to bring modal windows to
							the front. This is necessary if the window was created
							previously and kept invisible until needed, and it is
							not already in front. 
*/