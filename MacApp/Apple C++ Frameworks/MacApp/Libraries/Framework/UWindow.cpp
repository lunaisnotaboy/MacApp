//----------------------------------------------------------------------------------------
// UWindow.cpp
// Copyright © 1987-2001 by Apple Computer, Inc. All rights reserved.
//----------------------------------------------------------------------------------------

/*
	Change History
		07/30/01	[C] The mouse event parameter in a window click content region 
					event can safely be assumed to be a mouse down event. 
		07/18/01	[C] Enable click counting in HandleMouseEvent and register
					interest in seeing kEventMouseUp in DoInitForCarbonEvents.
		07/09/01	Changed window activation logic in MASelectToolboxWindow to call
					BrintToFront if we are using Appearance Manager 8.5 or later.
		06/22/01	Use ChangeWindowAttribute in DrawResizeIcon instead of actually
					drawing the icon.
		06/08/01	[W] No longer need to conditionalize ShowHide for Windows--just call
					ShowHideWindow.  Removed some more dead code.
		06/07/01	Wrap TransitionWindow in a utility function. 
					Make 8.5 window manager calls conditional on qPowerPC. 
		06/06/01	Update Show and MAShowWindow to 8.5 Window Manager by calling
					TransitionWindow, etc. instead of ShowHide, etc. all conditionalized
					on whether we have Window Manager 8.5.  Use ZoomWindowIdeal in
					Zoom if we have Window Manager 8.5. 
		06/04/01	Make sure we have a toolbox window before registering as droppable. 
		05/09/01	Do initialization for Carbon Events in CreateToolboxWindow
					instead of DoPostCreate. That way it's more likely to get done. 
					Also need to initialize for Carbon Events in the TWindow
					constructor if it was given a window manager window, because
					in that case CreateToolboxWindow isn't going to be called. 
		05/07/01	Comment out pragma messages for Carbon. 
		04/23/01	Protected gClipboardMgr fields. 
		04/10/01	[C] Remove test of window struct region in BuildWindowRegions.
					Allow any drawing environment a chance to intervene in the
					grafPtr selection in GetGrafPort.
		04/07/01	[PB] Put member initializers for fSubStart and fTailLength in
					declaration order. 
		03/01/01	Don't include Windows_AC. 
		01/24/01	[W] Fix GetTitle to use windowTitle.
		01/11/01	Eliminated ParseTitleTemplate and simply call GetSubstitutionMetrics
					directly where needed (two places).
		01/05/01	Change to use CString_AC instead of std::string or CStr255_AC.
		12/28/00	Replaced fPreDocname and fConstTitle with fSubStart and fTailLength.
					string is now used instead of CStr255_AC.  Using std::string.
		01/02/01	Update copyright.
		12/29/00	Start using CWindow_AC functions for convenience. 
					Check before calling CWindow_AC:: SetBackgroundTheme. 
		12/28/00	CreateAppearanceWindow is PowerPC only. 
		12/27/00	Use CWindow_AC. Rename CreateWindow to CreateToolboxWindow to
					avoid conflict with a Windows macro. 
		12/26/00	[W] Set fZoomedOut in ctors.  Check fZoomedOut in Zoom.
					Handle WM_NCLBUTTONDBLCLK in HandleWindowsEvent.  Change
					handling of WM_SIZE in HandleWindowsEvent.  Reworked CreateWindowsWindow.
		12/15/00	Split off CreateWindow and ParseTitleTemplate from ReadFields. 
					Use CreateNewWindow for all Carbon windows. 
					Install standard Carbon Event handler when creating the window. 
					[C] Don't move window in response to bounds changed event. 
					On X, it recurses. 
		12/11/00	[C] Add DidCarbonEvent. 
		12/08/00	[C] Add separate methods for different Carbon event classes. 
					Add support for activate and deactivate Carbon events. 
		12/07/00	[C] Need to handle mouse down events so we can intercept control
					clicks. 
		12/05/00	[C] Initial support for Carbon Events. 
		11/16/00	Use GetWindowRegion in ForceOnScreen and GetMaxIntersectedDevice.
		11/14/00	[W] Added altDBoxProc case to GetWindowTitleSize.  Update no longer
					does anything except call UpdateWindow.  Reworked HandleWindowsEvent
					and CreateWindowsWindow.
		11/10/00	Cosmetic.
		11/09/00	[PB] Change initialization order to match declaration. 
					[PB] Suppress GCC warnings about unused return variables. 
		10/16/00	GetClipRegion override is needed only for Carbon.
		10/16/00	Added Erase.
		10/12/00	[W] Do not fiddle with fWMgrWindow in ReadFields.
		10/10/00	[C] Be sure to leave the focus invalidated when done updating.
		10/06/00	[C] No need to SendBehind on deactivate in MASelectToolboxWindow.
		10/03/00	Reworked Zoom a bit to clean up logic for setting standard and
					user state.  Also accommodate now correctly operating
					ZoomWindowIdeal.  Improve error reported in GetUserStateFrame.
		09/21/00	Conditionalize theme drawing state saving.
		09/21/00	[W] Call SetTitle after making the Windows window in ReadFields.
					Call TView::Focus in TWindow::Focus.
		09/21/00	[W] static_cast to HWND in TWindow ctor.
		09/18/00	For Carbon, fix up clip in Focus.
		09/14/00	[C] Tweaked Update so that the background for windows with embedded
					controls is drawn correctly.
		09/14/00	[C] Fix centering of window in Center.
		09/12/00	Focus after BeginUpdate and EraseRect before HandleDraw in Update.
		09/11/00	GetClipRegion method should only be used on the view's port.
					Same for GetVisRegion.
		09/08/00	Use ACS imaging utilities instead of conditionaling on qCarbon.
		09/08/00	Added SetBackgroundTheme.
		09/06/00	Added embedded documentation.
		09/01/00	No need to check system version in ReadFields anymore.
		08/31/00	[C] Reworked ReadFields so that floaters work.
		08/24/00	Carbon isn't yet excluding the doc from its size, so need to modify
					Zoom to not go below the doc.  When Carbon implements this feature,
					we can pull this out.
		08/17/00	[W] Don’t need GetRegionCode in CreateWindowsWindowFromWDEF.
					Changed fgInstance to sfInstance in CreateWindowsWindow.
		08/09/00	[2511277] Change test of fDragCallbackStatus in
					TWindow::RegisterDroppableView.
		08/01/00	[W] Empty Focus.  GetGrafPort returns TView’s GetGrafPort.
					Added HandleWindowsEvent, DefaultWindowProcedure,
					GetWindowsClassName, SetWindowsWindow, CreateWindowsWindow,
					DeleteWindowsWindow, CreateWindowsWindowFromWDEF,
					GetWindowTitleSize and AdjustWindowFrame.  Removed
					fWindowsWindow.  Many other changes.
		07/17/00	Changed the various invalidation indication patterns a bit.
		06/14/00	Eliminate unnecessary GetRegionCode calls.  Include CMultiLocal.h.
					Do not use CMultiLocale_AC version of GetResInfo in TWindow ctor.
		06/06/00	Removed commented out code in various places and other cosmetic
					cleanup.
		06/01/00	Handle reactivation when frontmost window is floater with
					a modal behind in MAShowWindow.  Cosmetic changes, too.
		04/18/00	Include UPrintMgr.h instead of UPrintHandler.h.
		03/20/00	[2446267] Avoid short overflow in SetResizeLimits.
		03/17/00	Leave the focus on the window after updating, so Carbon can
					idle controls behind our back.
		02/22/00	[W] Added HandleWindowsEvent and DefaultWindowProcedure.  Call
					SendMessage in Open.  Manage focus in DoValidateRegion and
					DoInvalidateRegion.  Modified window creation and byte ordering
					in ReadFields.  Include QTML.h.
		01/13/00	Conditionalized declaration of oldFrontControlList and newFrontControlList
					in MASelectToolboxWindow.
		12/27/99	Stripped out unused code.
		12/08/99	Include CDrawingEnvironment_AC.h for CTempDrawingEnvironment_AC.
					Save current port in SetProxyIcon.
		12/15/99	[2419291] Save and restore port around SetWindowProxyIcon.
		12/09/99	Carbon: procID's of 16 are illegal, so in the debug mode try to catch this
					(in TWindow::TWindow and TWindow::ReadFields).
		10/10/99	Fix a compile error in TWindow ctor and ReadFields by defining
					the storage pointer as a CWindowRecord* instead of a WindowRef.
		10/07/99	Add '::' to WaitMouseUp, GetPort, GetWMgrPort, SetClip, ClipAbove,
					GetWindowStructureRgn, SendBehind, BringToFront, HiliteWindow, ShowHide,
					NewCWindow, GetClip, RectRgn, SectRgn, EmptyRgn, SetClip, PenNormal,
					DrawGrowIcon, GetPort, SetPortWindowPort, and GetWRefCon.
		09/29/99	GetCurrentProcess now called MacGetCurrentProcess.
		08/17/99	Window proxy calls are PPC only.
		07/27/99	Removed qAllegro test in HandleMouseDown and around SetProxyIconByFile,
					SetProxyIcon, GetProxyIcon, SetModified, IsModified, TrackProxyDrag and
					HandlePathSelect.  Reenabled inProxyIcon case in HandleMouseDown.
					Rework TrackProxyDrag and HandlePathSelect.  Change modal window
					handling in SetProxyIconByFile.
		07/26/99	Include CTempGrafPort_AC.h.  Save and restore the GrafPort in
					SetProxyIconByFile.
		07/23/99	[C] Cannot manage control list as usual in MASelectToolboxWindow.
		07/12/99	Fixed Focus to always clip out the update region. Now that we
					are going with the way of the toolbox, the update region is
					always the region for the next update, never the current one.
					Also fixed validate/invalidate region the same way.
		07/08/99	The window no longer saves its update and visible regions when
					it begins updating. GetUpdateRegion and GetVisRegion now go
					directly to the window's current update and visible regions.
					This makes MacApp's code more like the examples in Inside Mac.
					It fixes a bug where the non-debug version of GetUpdateRegion
					was returning LMGetSaveVisRgn, causing all the visible views to
					redraw instead of just the ones that needed updating.
					This change could affect code that calls GetUpdateRegion or
					GetVisRegion at draw time and expects the old MacApp behavior
					instead of the toolbox compatible behavior.
		06/04/99	Don't reregister droppable window if already registered in DoPostCreate.
		04/15/99	[C] Fixed parenthesis in DoInvalidateRegion.
		03/29/99	Rename Patterns_AC to CPattern_AC to avoid confusion with the
					include file.
		03/24/99	Update copyright notice.
		03/23/99	Go back to native Toolbox region and rect calls.  Do not directly access
					qd.ltGray, etc.
		03/22/99	[W] Further 'qd' reduction. No DrawResizeIcon for Windows.  Can't
					call GetAuxWin, HiliteWindow, TrackBox, GrowWindow, etc.
		03/18/99	Removed '&' on parms to a variety of Toolbox calls.
		02/11/99	[C] Cannot directly access qd in AdaptToScreen or in Update.
		02/04/99	[C] Added a #pragma unused and message and did some general
					Carbon cleanup.
		01/23/99	Include MacWindows.h.
		01/22/99	[C] Change GetWindowStructureRegion back to GetWindowStructureRgn
					and GetWindowContentRegion to GetWindowContentRgn.
		01/15/99	CAEDesc_AC is now in ACS.
		12/16/98	Replace #warning with #pragma message in GetStandardStateFrame.
		11/13/98	[2279281] Use qAllegro in place of qPowerPC && (UNIVERSAL_INTERFACES_VERSION >= 0x0320).
		11/13/98	[2279274] Force conversion to CViewPoint in Update.
		11/12/98	[2279244] Replaced dynamic_cast with dynamic_cast_AC.
		11/11/98	[2279211] Improved formula in GetStandardStateFrame.
		11/10/98	[2279106] In DoPostCreate add a resize adorner if window is resizable.
		11/06/98	Fix non-ARM compliant cast in MASelectToolboxWindow.
		11/06/98	CarbonSeed110398 - change GetWindowStructureRegion to GetWindowRegion(w, kWindowStructureRgn, rgn);
					change GetWindowContentRegion to GetWindowRegion(w, kWindowContentRgn, rgn);
					change GetWindowUpdateRegion to GetWindowRegion(w, kWindowUpdateRgn, rgn)
		11/05/98	Use OffsetRgn_AC instead of OffsetRgn;
		10/30/98	Cast 'this' in GetCommandContext.
		10/29/98	[W] It is no longer necessary to include QTMLMapNames.h.  Use
					SetPort_AC, CopyRgn_AC, FindWindow_AC, FillRgn_AC, UnionRgn_AC,
					MoveWindow_AC, FillRect_AC, LoadResource_AC, CloseWindow_AC.
					Include ImagingUtils_AC.h, WindowUtils_AC.h, ResourceUtils_AC.h.
					GetCommandContext can't be const since it returns 'this'.
		10/26/98	Carbonize: change GetVisRegion and GetUpdateRegion from static to method;
					add override of GetClipRegion; add data members for special Carbon regions
		10/08/98	Undo context.
					Merge TCommandHandler into TEventHandler.
*/

#ifndef __UWINDOW__
#include "UWindow.h"
#endif

// MacApp

#ifndef PLATFORMMEMORY_H
#include "PlatformMemory.h"
#endif

#ifndef __UADORNERS__
#include "UAdorners.h"
#endif

#if qMSWindows
	#ifndef __UAPPLICATION__
	#include "UApplication.h"
	#endif
#endif

#ifndef __UCLIPBOARDMGR__
#include "UClipboardMgr.h"
#endif

#ifndef __UCOREERRORMGR__
#include "UCoreErrorMgr.h"
#endif

#ifndef __UCOREGLOBALS__
#include "UCoreGlobals.h"
#endif

#ifndef __UCOREUTILITIES__
#include "UCoreUtilities.h"
#endif

#ifndef __UDEBUG__
#include "UDebug.h"
#endif

#ifndef __UDESIGNATOR__
#include "UDesignator.h"
#endif

#ifndef __UDIALOGBEHAVIOR__
#include "UDialogBehavior.h"
#endif

#ifndef __UDISPATCHER__
#include "UDispatcher.h"
#endif

#ifndef __UDOCUMENT__
#include "UDocument.h"
#endif

#if qDrag
	#ifndef __UDRAGDROP__
	#include "UDragDrop.h"
	#endif

	#ifndef __UDRAGDROPBEHAVIOR__
	#include "UDragDropBehavior.h"
	#endif
#endif

#ifndef __UFILE__
#include "UFile.h"
#endif

#ifndef __FLOATWINDOW__
#include "FloatWindow.h"
#endif

#ifndef __UMACAPPGLOBALS__
#include "UMacAppGlobals.h"
#endif

#ifndef __UMACAPPUTILITIES__
#include "UMacAppUtilities.h"
#endif

#ifndef __UMEMORY__
#include "UMemory.h"
#endif

#ifndef __UMENUMGR__
#include "UMenuMgr.h"
#endif

#ifndef __UPOINTEROBJECT__
#include "UPointerObject.h"
#endif

#ifndef __UPrintMgr__
#include "UPrintMgr.h"
#endif

#if qAppleEventAware
	#ifndef __USCRIPTING__
	#include "UScripting.h"
	#endif
#endif

#ifndef __USTREAM__
#include "UStream.h"
#endif

#ifndef __UUNDO__
#include "UUndo.h"
#endif

// ACS

// for DelayFuture_AC, HasAppearanceMgr_AC
#ifndef __AppearanceUtils_AC__
#include "AppearanceUtils_AC.h"
#endif

#ifndef __CDrawingEnvironment_AC__
#include "CDrawingEnvironment_AC.h"
#endif

#if qDrag
	#ifndef __CList_AC__
	#include "CList_AC.h"
	#endif
#endif

#ifndef __CMultiLocal_AC__
#include "CMultiLocal_AC.h"
#endif

#ifndef __CRegion_AC__
#include "CRegion_AC.h"
#endif

#ifndef __CTempGrafPort_AC__
#include "CTempGrafPort_AC.h"
#endif

#ifndef __CToolboxControl_AC__
#include "CToolboxControl_AC.h"
#endif

#ifndef __ResourceUtils_AC__
#include "ResourceUtils_AC.h"
#endif

#ifndef __WindowUtils_AC__
#include "WindowUtils_AC.h"
#endif

// Toolbox

#ifndef __APPEARANCE__
#include <Appearance.h>
#endif

#if qAppleEventAware
	#ifndef __AEREGISTRY__
	#include <AERegistry.h>
	#endif
#endif

#ifndef __FIXMATH__
#include <FixMath.h>
#endif

#ifndef __LOWMEM__
#include <LowMem.h>
#endif

#ifndef __MACWINDOWS__
#include <MacWindows.h>
#endif

#ifndef __RESOURCES__
#include <Resources.h>
#endif

#ifndef __TOOLUTILS__
#include <ToolUtils.h>
#endif

#include <MacWindows.h>

#if qMSWindows
#include <QTML.h>
#endif

enum
{
	kActivateWindow = true, kDeactivateWindow = false
};

//========================================================================================
// static data members
//========================================================================================

short			TWindow::gStandardWindowStaggerCount;
WindowPtr		TWindow::fgUpdatingWindowPtr;
CWindowRefTable	TWindow::fgWindows;

//========================================================================================
// Global Functions
//========================================================================================

#if qMSWindows

//----------------------------------------------------------------------------------------
// GetWindowTitleSize
//----------------------------------------------------------------------------------------

static CViewPoint GetWindowTitleSize(short procID)
{
	int captionH = 0;
	int captionV = 0;

	switch (procID)
	{
			case dBoxProc:
			case movableDBoxProc:
			//case zoomDocProc:
				captionH = 2 * GetSystemMetrics(SM_CXDLGFRAME);
				captionV = GetSystemMetrics(SM_CYCAPTION) + (2 * GetSystemMetrics(SM_CYDLGFRAME));
				break;
			case plainDBox:
				captionH = 2 * GetSystemMetrics(SM_CXBORDER);
				captionV = 2 * GetSystemMetrics(SM_CYBORDER);
				break;
			case noGrowDocProc:
				captionH = 2 * GetSystemMetrics(SM_CXDLGFRAME);
				captionV = GetSystemMetrics(SM_CYCAPTION) + (2 * GetSystemMetrics(SM_CYDLGFRAME));
				break;
			case altDBoxProc: 								// Borderless window
				captionH = 2 * GetSystemMetrics(SM_CXBORDER);
				captionV = 2 * GetSystemMetrics(SM_CYBORDER);
				break;
				
			case kSystem75_kWindoidWDEF:					// ToolPalette
			case kSystem75_kWindoidWDEF+kSystem75_hasZoom:	// ToolPalette
				captionV = GetSystemMetrics(SM_CYCAPTION) +	(GetSystemMetrics(SM_CYFRAME) - 1 ); //(265 - theFrame.GetSize()[vSel])/*!+ (2 * GetSystemMetrics(SM_CYFRAME))*/;
				captionH = GetSystemMetrics(SM_CXFRAME) + 2; // + (32 - theFrame.GetSize()[hSel]);
				break;
			default:
				captionH = 2 * GetSystemMetrics(SM_CXFRAME);
				captionV = GetSystemMetrics(SM_CYCAPTION) +  (2* GetSystemMetrics(SM_CYFRAME) - 1 ) + 1;
				break;
	}
	return CViewPoint(captionH, captionV);
}

//----------------------------------------------------------------------------------------
// AdjustWindowFrame
//----------------------------------------------------------------------------------------

static void AdjustWindowFrame(CViewRect& theFrame, short procID);

static void AdjustWindowFrame(CViewRect& theFrame, short procID)
{
	CViewPoint caption = GetWindowTitleSize(procID);
	theFrame.right += caption.h;
	theFrame.bottom += caption.v;
}

#endif

//----------------------------------------------------------------------------------------
// ShowHideWindow
//----------------------------------------------------------------------------------------

static void ShowHideWindow(WindowRef window, bool state);

void ShowHideWindow(WindowRef window, bool state)
{
#if qPowerPC
	if (HasWindowManager85_AC())
	{
		WindowTransitionAction action = state ? kWindowShowTransitionAction :
												kWindowHideTransitionAction;

		ThrowIfBadOSStatus_AC(::TransitionWindow(window,
												 kWindowZoomTransitionEffect,
												 action,
												 NULL));
	}
	else
#endif
		::ShowHide(window, state);
}

			
//========================================================================================
// CLASS CWindowAndWindowRef
//========================================================================================

//----------------------------------------------------------------------------------------
// CWindowAndWindowRef::Compare:
//----------------------------------------------------------------------------------------

CompareResult_AC CWindowAndWindowRef::Compare(const CWindowAndWindowRef& criteria) const
{
	CompareResult_AC returnVal = kItemEqualCriteria_AC;

	if (fWindowRef > criteria.fWindowRef)
		returnVal = kItemGreaterThanCriteria_AC;
	else if (fWindowRef < criteria.fWindowRef)
		returnVal = kItemLessThanCriteria_AC;

	return returnVal;
}

//========================================================================================
// CLASS CWindowRefTable
//========================================================================================

//----------------------------------------------------------------------------------------
// CWindowRefTable::Delete:
//----------------------------------------------------------------------------------------

void CWindowRefTable::Delete(const WindowRef item)
{
	if (item)
	{
		ArrayIndex_AC index = GetEqualItemNo(CWindowAndWindowRef(NULL, item));
		if (index != kEmptyIndex_AC)
			AtDelete(index);
	}
}

//----------------------------------------------------------------------------------------
// CWindowRefTable::Compare:
//----------------------------------------------------------------------------------------

CompareResult_AC CWindowRefTable::Compare(const CWindowAndWindowRef& record1,
										  const CWindowAndWindowRef& record2) const
{
	return record2.Compare(record1);
}

//========================================================================================
// CLASS TCloseWindowCommand
//========================================================================================

//----------------------------------------------------------------------------------------
// TCloseWindowCommand constructor
//----------------------------------------------------------------------------------------

TCloseWindowCommand::TCloseWindowCommand(CommandNumber itsCommandNumber, TWindow* itsWindow)
	:	TCommand(itsCommandNumber, itsWindow->GetCommandContext(itsCommandNumber), kCantUndo, kDoesNotCauseChange, NULL),
		fWindow(itsWindow)
{
	fUseAppleEvent = true;		// The default will be to record.

#if qDebug
	// We should never get a window which has a document attached because we
	// intercept that situation in TWindow's CloseByUser and DoAEClose.
	if (fWindow->GetDocument() && fWindow->GetClosesDocument())
		::ProgramBreak_AC("Attempt to close window which has a document");
#endif
}

#if qAppleEventAware

//----------------------------------------------------------------------------------------
// TCloseWindowCommand constructor
//----------------------------------------------------------------------------------------

TCloseWindowCommand::TCloseWindowCommand(TWindow*		itsWindow,
										 TAppleEvent*	message,
										 TAppleEvent*	reply)
	:	TCommand(cClose, itsWindow->GetCommandContext(cClose), kCantUndo, kDoesNotCauseChange, NULL),
		fWindow(itsWindow)
{
	#pragma unused (message, reply)
#if qDebug
	// We should never get a window which has a document attached because we
	// intercept that situation in TWindow's CloseByUser and DoAEClose.
	if (fWindow->GetDocument() && fWindow->GetClosesDocument())
		::ProgramBreak_AC("Attempt to close window which has a document");
#endif
}

#endif

#if qAppleEventAware

//----------------------------------------------------------------------------------------
// TCloseWindowCommand::MakeAppleEvent:
//----------------------------------------------------------------------------------------

TAppleEvent* TCloseWindowCommand::MakeAppleEvent()
{
	CAutoPtr_AC<TAppleEvent> returnVal(TH_new TAppleEvent(kAECoreSuite, kAEClose, gServerAddress, kAEWaitReply));

	CTempDesc_AC theWindowDesc;
	fWindow->MakeObjectSpecifier(theWindowDesc, fWindow->GetSpecifierForm());
	returnVal->WriteParameter(keyDirectObject, theWindowDesc);

	// We don't save any of the saving options here because that is done
	// in the TCloseDocument command.

	return returnVal.release();
}

#endif

//----------------------------------------------------------------------------------------
// TCloseWindowCommand::DoIt:
//----------------------------------------------------------------------------------------

void TCloseWindowCommand::DoIt()
{
	if (fWindow)
	{
		fWindow->Close();
		if (fWindow->GetFreeOnClosing())
			delete fWindow;
	}
}


//========================================================================================
// CLASS TWindow
//========================================================================================

MA_DEFINE_CLASS(TWindow);

//----------------------------------------------------------------------------------------
// TWindow Constructor.
//----------------------------------------------------------------------------------------

TWindow::TWindow(WindowRef itsWMgrWindow, bool canResize, bool canClose, bool inDispose)
	:	TView(gZeroPt, gZeroPt, sizeVariable, sizeVariable),
#if qAppleEventAware
		MScriptableObject(cWindow),
		fScriptingPrintHandler(NULL),
#endif
		// We can't tell if any changing will be required so we just the fMustxxx these false here. If
		// the developer sets them true then we respect them or if the developer calls the
		// corresponding functions we set them.
		fWMgrWindow(NULL),
#if qCarbon
		fCarbonClipRegion(NULL),
		fCarbonVisRegion(NULL),
		fCarbonUpdateRegion(NULL),
#endif
		fTargetID(fIdentifier),
		fProcID(0),
		fSubStart(CString_AC::npos),
		fTailLength(CString_AC::npos),
		fStrListID(kNoResource),					// window's title:	STR# rsrc id
		fIndex(kNoResource),						//					index into STR#
		fDisposeOnFree(false),						// delete the storage
		//fIsActive(false),
		fIsResizable(true),
		fIsClosable(true),
		fFreeOnClosing(false),
		fClosesDocument(true),
		fOpenInitially(true),
		fDoFirstClick(false),
		fFloats(false),
		fSinks(false),
		fHideOnSuspend(false),
		fWasHiddenOnSuspend(false),
		fGenerateActivates(true),

		fMustAdapt(false),
		fMustHorzCenter(false),
		fMustVertCenter(false),
		fMustStagger(false),
		fMustForceOnScreen(false),

		fAdapted(false),							// Set by AdaptToScreen
		fHorzCentered(false),						// Set by Center
		fVertCentered(false),						// Set by Center
		fStaggered(false),							// Set by SimpleStagger
		fForcedOnScreen(false)						// Set by ForceOnScreen
#if qDrag
		,
		fDragCallbackStatus(eWindowNotInited),
		fDropStatusCache(0, sizeof(short))
#endif // qDrag
#if qMSWindows
		,
		fZoomedOut(false)
#endif
{
#if qMSWindows
	SetNeedsOwnWindowsWindow(true);
#endif

	fIsActive = false; // override TView default.  A window is initially inactive.

	fTarget = this;

	if (itsWMgrWindow)
	{
#if qMSWindows
		fGrafPort = itsWMgrWindow;
		fWindowsWindow = static_cast<HWND>(GetPortHWND(fGrafPort));
#endif

		GrafPtr savePort;
		::GetPort(&savePort);

		::SetPortWindowPort(itsWMgrWindow);	// So LocalToGlobal works

		fLocation = CViewPoint(LocalToGlobal(GetPortRect_AC(itsWMgrWindow)[topLeft]));
		fSize = CViewPoint(GetPortRect_AC(itsWMgrWindow).GetSize());

		// Initialize instance variables.
		fWMgrWindow = itsWMgrWindow;
		fDisposeOnFree = inDispose;

		ResNumber itsID = 0;
#if !qCarbon
// •••  For now, comment out WDEF stuff for Carbon
		Handle theWDEFProc = WindowPeek(itsWMgrWindow)->windowDefProc;
		if (IsAResource_AC(theWDEFProc))
		{
			ResType itsType;
			CStr255_AC itsName;

			::GetResInfo(theWDEFProc, &itsID, &itsType, itsName);
		}
#endif
		fProcID = (itsID << 4) | fWMgrWindow.GetVariant();

		fIsResizable = canResize;

		try
		{
			if (canResize)
				AddAdorner(&TAdorner::fgResizeIconAdorner, kAdornLast, false);
			fIsClosable = canClose;
			BuildWindowRegions(BuildWindowRegions(kBuild));// sets fContentRegionInset && fContentDifference

			// don't use the GetResizeLimits accessor b/c we want to preserve zero values for dynamics
			SetResizeLimits(fResizeLimits[topLeft], fResizeLimits[botRight]);

			// Determine the substitutable title metrics.
			GetTitle().GetSubstitutionMetrics(fSubStart, fTailLength);

			AddAdorner(&TAdorner::fgEraseAdorner, kAdornFirst, false);

#if qCarbonEvents
			DoInitForCarbonEvents();
#endif
			RegisterWindow(this);					// add to the lookup table
		}
		catch(CException_AC& theException)
		{
			DoCatchMessage_AC(theException);
			::SetPort_AC(savePort);
			throw;
		}
	}
}

//----------------------------------------------------------------------------------------
// TWindow copy constructor
//----------------------------------------------------------------------------------------

TWindow::TWindow(const TWindow& inWindow)
	:	TView(inWindow),
#if qAppleEventAware
		MScriptableObject(inWindow),
		fScriptingPrintHandler(inWindow.fScriptingPrintHandler),
#endif
		fTarget(FindSubView(inWindow.fTargetID)),
		fWMgrWindow(NULL), // don't copy the incoming one it doesn't belong to us
#if qCarbon
		fCarbonClipRegion(NULL),	// we need to make our own clip RgnHandle
		fCarbonVisRegion(NULL),		// ... and our own vis RgnHandle
		fCarbonUpdateRegion(NULL),	// ... and our own update RgnHandle
#endif
		fTargetID(inWindow.fTargetID),
		fProcID(inWindow.fProcID),
		fSubStart(inWindow.fSubStart),
		fTailLength(inWindow.fTailLength),
		fStrListID(inWindow.fStrListID),
		fIndex(inWindow.fIndex),
		fDisposeOnFree(inWindow.fDisposeOnFree),
		//fIsActive(inWindow.fIsActive),
		fIsResizable(inWindow.fIsResizable),
		fIsClosable(inWindow.fIsClosable),
		fFreeOnClosing(inWindow.fFreeOnClosing),
		fClosesDocument(inWindow.fClosesDocument),
		fOpenInitially(inWindow.fOpenInitially),
		fDoFirstClick(inWindow.fDoFirstClick),
		fFloats(inWindow.fFloats),
		fSinks(inWindow.fSinks),
		fHideOnSuspend(inWindow.fHideOnSuspend),
		fWasHiddenOnSuspend(inWindow.fWasHiddenOnSuspend),
		fGenerateActivates(inWindow.fGenerateActivates),

		fMustAdapt(inWindow.fMustAdapt),
		fMustHorzCenter(inWindow.fMustHorzCenter),
		fMustVertCenter(inWindow.fMustVertCenter),
		fMustStagger(inWindow.fMustStagger),
		fMustForceOnScreen(inWindow.fMustForceOnScreen),

		fAdapted(inWindow.fAdapted),
		fHorzCentered(inWindow.fHorzCentered),
		fVertCentered(inWindow.fVertCentered),
		fStaggered(inWindow.fStaggered),
		fForcedOnScreen(inWindow.fForcedOnScreen)

#if qDrag
		,
		fDragCallbackStatus(inWindow.fDragCallbackStatus),
		fDropStatusCache(0, sizeof(short))
#endif // qDrag
#if qMSWindows
		,
		fZoomedOut(inWindow.fZoomedOut)
#endif
{
	// If the source has a window, create one just like it. 
	if (inWindow.fWMgrWindow)
		CreateToolboxWindow();
}

//----------------------------------------------------------------------------------------
// TWindow::DoPostCreate:
//----------------------------------------------------------------------------------------

void TWindow::DoPostCreate(TDocument* itsDocument)
{
	TView::DoPostCreate(itsDocument);

	// don't use the GetResizeLimits accessor b/c we want to preserve zero values for dynamics
	SetResizeLimits(fResizeLimits[topLeft], fResizeLimits[botRight]);
	BuildWindowRegions(BuildWindowRegions(kBuild));// sets fContentRegionInset && fContentDifference

	// Add the resize adorner if this window is resizable.
	if (fIsResizable)
		AddAdorner(&TAdorner::fgResizeIconAdorner, kAdornLast, false);

#if qDrag
	// If subviews have registered then register the window with the drag session
	// We can't register until after we have a toolbox window
	if (HasDragManager_AC()
		&& fDragCallbackStatus != eInstalled
		&& !fDroppableViewList.IsEmpty()
		&& (fWMgrWindow != NULL))
	{
		TDragDropSession::fgDragDropSession->RegisterDroppableWindow(this, fWMgrWindow);
		fDragCallbackStatus = eInstalled;
	}
#endif // qDrag
}

//----------------------------------------------------------------------------------------
// TWindow::SetBackgroundTheme:
//----------------------------------------------------------------------------------------

void TWindow::SetBackgroundTheme(ThemeBrush theBrush, bool invalidate)
{
	// CWindow_AC will throw an exception if we call it on a system that doesn't
	// have the appearance manager. We'd rather just do nothing silently, so
	// we check before calling. 
	if (!HasAppearanceMgr_AC())
		fWMgrWindow.SetBackgroundTheme(theBrush, invalidate);
}

//----------------------------------------------------------------------------------------
// TWindow::GetBehindWindowPtr:
//----------------------------------------------------------------------------------------

WindowRef TWindow::GetBehindWindowPtr() const
{
	WindowRef behind = GetLastFloatingWindowPtr();
	if (!behind)
		behind = (WindowRef)(-1);				// bring the window up in front of all other windows

	return behind;
}

//----------------------------------------------------------------------------------------
// TWindow::GetDialogBehavior:
//----------------------------------------------------------------------------------------

TDialogBehavior* TWindow::GetDialogBehavior() const
{
	// This can return NULL.

	return dynamic_cast_AC(TDialogBehavior*,GetBehaviorWithIdentifier(kDialogBehavior));
}

//----------------------------------------------------------------------------------------
// TWindow::SetModality:
//----------------------------------------------------------------------------------------

void TWindow::SetModality(bool modal)
{
	TDialogBehavior * itsDialogBehavior = GetDialogBehavior();

	if (itsDialogBehavior)
		itsDialogBehavior->fModal = modal;
	else
	{
		if (modal)
		{
			// Allocate the behavior from temporary memory in case we are trying to warn
			// the user about something.  We shouldn't fail here.
			CTempObjectAllocation tempObjectAllocation(true);
			itsDialogBehavior = TH_new TDialogBehavior(modal, kNoIdentifier, kNoIdentifier);

			AddBehavior(itsDialogBehavior);
		}
	}
}

//----------------------------------------------------------------------------------------
// TWindow::SetDialogItems:
//----------------------------------------------------------------------------------------

void TWindow::SetDialogItems(IDType itsDefaultItem,
							 IDType itsCancelItem)
{
	TDialogBehavior * itsDialogBehavior = GetDialogBehavior();

	if (itsDialogBehavior)
	{
		itsDialogBehavior->fDefaultItem = itsDefaultItem;
		itsDialogBehavior->fCancelItem = itsCancelItem;
	}
	else
	{
		if ((itsDefaultItem != kNoIdentifier) || (itsCancelItem != kNoIdentifier))
		{
			// Allocate the behavior from temporary memory in case we are trying to warn
			// the user about something.  We shouldn't fail here.
			CTempObjectAllocation tempObjectAllocation(true);
			itsDialogBehavior = TH_new TDialogBehavior(false, itsDefaultItem, itsCancelItem);

			AddBehavior(itsDialogBehavior);
		}
	}
}

//----------------------------------------------------------------------------------------
// TWindow::~TWindow:
//----------------------------------------------------------------------------------------

TWindow::~TWindow()
{
	bool disposeOnFree = fDisposeOnFree;
	WindowRef wmgrWindow = fWMgrWindow;

#if qDrag
	// Remove drag manager callbacks
	if (HasDragManager_AC() && fDragCallbackStatus == eInstalled)
	{
		TDragDropSession::fgDragDropSession->UnregisterDroppableWindow(fWMgrWindow);
		fDragCallbackStatus = eNotInstalled;
	}
#endif // qDrag

	BeInPort(NULL);		// Insure that any subviews will not attempt to use this
						// window as they shut down.  TCtlMgr relies on having  around
						// the window when the TCtlMgr is shutting down.

	DeleteWindow(this);			// Remove from the lookup table

#if !qMSWindows
	// This gets handled in DeleteWindowsWindow in Windows.
	fWMgrWindow = NULL;
#endif

	BeInPort(NULL);				// Make sure subviews don't depend on the window manager window

	if (fDocument)
		fDocument->DeleteWindow(this);
	else if (gDispatcher)
		gDispatcher->DeleteWindow(this);

#if !qMSWindows
	wmgrWindow = FreeIfWMgrWindow(wmgrWindow, disposeOnFree);
#else
	if (gDispatcher)	// If the dispatcher is gone, our window is already gone.
		DeleteWindowsWindow();
#endif

#if qCarbon
	if (fCarbonClipRegion)
	{
		::DisposeRgn(fCarbonClipRegion);
		fCarbonClipRegion = NULL;
	}
	if (fCarbonVisRegion)
	{
		::DisposeRgn(fCarbonVisRegion);
		fCarbonVisRegion = NULL;
	}
	if (fCarbonUpdateRegion)
	{
		::DisposeRgn(fCarbonUpdateRegion);
		fCarbonUpdateRegion = NULL;
	}
#endif
}

//----------------------------------------------------------------------------------------
// TWindow::GetStandardSignature:
//----------------------------------------------------------------------------------------

IDType TWindow::GetStandardSignature() const
{
	return kStdWindow;
}

//----------------------------------------------------------------------------------------
// TWindow::ReadFields:
//----------------------------------------------------------------------------------------

void TWindow::ReadFields(CStream_AC* aStream)
{
	TView::ReadFields(aStream);

	fProcID = aStream->ReadInteger();
	fTargetID = aStream->ReadIDType();

	WindowFlags itsFlags;
#if qMSWindows
	// get the bytes in the right order...
	itsFlags.ReadFrom(aStream);
#else
	aStream->ReadBytes(&itsFlags, sizeof(WindowFlags));
#endif
	fIsResizable = itsFlags.GetResizable();
	fIsClosable = itsFlags.GetHasGoAway();
	fDoFirstClick = itsFlags.GetDoFirstClick();
	fFreeOnClosing = itsFlags.GetFreeOnClosing();

	fDisposeOnFree = itsFlags.GetDisposeOnFree();
	fDisposeOnFree = false; // ignore the stream value, template windows allocate as they wish

	fClosesDocument = itsFlags.GetClosesDocument();
	fOpenInitially = itsFlags.GetOpenInitially();

	fMustAdapt = itsFlags.GetMustAdaptToScreen();
	fMustStagger = itsFlags.GetStagger();
	fMustForceOnScreen = itsFlags.GetMustForceOnScreen();
	fMustHorzCenter = itsFlags.GetHorzCenter();
	fMustVertCenter = itsFlags.GetVertCenter();
	fFloats = itsFlags.GetFloats();

	fHideOnSuspend = itsFlags.GetHideOnSuspend();
	fGenerateActivates = itsFlags.GetGenerateActivates();

	*aStream >> fStrListID
			 >> fIndex;

	// If we don't already have a window then we need to make one (a low-level one), but
	// if we do have one already it is because someone specifically wanted _this_ one.
	if (!fWMgrWindow)
	{
		CreateToolboxWindow();

		// Determine the substitutable title metrics.
		GetTitle().GetSubstitutionMetrics(fSubStart, fTailLength);
	}
}

//----------------------------------------------------------------------------------------
// TWindow::CreateToolboxWindow:
//----------------------------------------------------------------------------------------

void TWindow::CreateToolboxWindow()
{
#if qMSWindows

	// Convert kSystem75AndLess_kWindoidWDEF to kSystem75_kWindoidWDEF
	// so only have to deal with one of these.
	if ((fProcID & 0xFFF0) == kSystem75AndLess_kWindoidWDEF)
		fProcID = kSystem75_kWindoidWDEF | (fProcID & 0x000F);

	CreateWindowsWindow();

	// Set the window's title from the resource
	SetTitle(CStr255_AC(fStrListID, fIndex));

#elif qCarbon

	CreateAppearanceWindow();

#if qCarbonEvents
	DoInitForCarbonEvents();
#endif

#else

#if qPowerPC
	if (::HasWindowManager85_AC())
		CreateAppearanceWindow();
	else
#endif
		CreateClassicWindow();

#endif // qMSWindows

	if (!WMgrToWindow(fWMgrWindow))
		RegisterWindow(this);					// add to the lookup table
}

#if !qMSWindows
#if !qCarbon

//----------------------------------------------------------------------------------------
// TWindow::CreateClassicWindow:
//----------------------------------------------------------------------------------------

void TWindow::CreateClassicWindow()
{
	// retrieve the window's title from the resource
	CStr255_AC title(fStrListID, fIndex);

	CRect_AC theBounds = GetFrame().ToRect();

	short procID = fProcID;					// default

#if 0
	// Formerly, we did some magic here to detect if we were running on something
	// earlier than Sys 7.5.  This has been stripped out.

	// Compatibility Floating WDEF support. We will
	// use the WDEF specified by this ID if we are not
	// running on System 7.5 or better. If we are, however,
	// we will change the ID dynamically in the window
	// initialization sequence. This ensures that we use
	// the WDEF stored in your program on pre System 7.5
	// but, use the WDEF stored in the system thereafter.
	// The top 12 bits identify the WDEF, bottom 4 bits are the style.

#ifdef qNeedsSystem7_5
	if (qNeedsSystem7_5 || ::GetSystemVersion_AC() >= 0x750)
#endif
		if ((fProcID & 0xFFF0) == kSystem75AndLess_kWindoidWDEF)
			procID = kSystem75_kWindoidWDEF | (fProcID & 0x000F);
#endif

	WindowRef behind = IsModal() ? reinterpret_cast<WindowRef>(-1) : GetBehindWindowPtr();
	if (fSinks)
		behind = GetLastDocumentWindowPtr();

	CAutoPtr_AC<CWindowRecord> storage = NULL;
	if (!fDisposeOnFree)
		storage = TH_new CWindowRecord;

	fWMgrWindow = CWindow_AC::Create(storage, theBounds, title, false,
									 procID, behind, fIsClosable,
									 reinterpret_cast<long>(this));
	
	// If the window was created successfully, release the auto pointer
	// so the storage won't be deleted. 
	storage.release();
}

#endif // !qCarbon

#if qPowerPC

//----------------------------------------------------------------------------------------
// TWindow::CreateAppearanceWindow:
//----------------------------------------------------------------------------------------

void TWindow::CreateAppearanceWindow()
{
#if qDebug
	if (fProcID == 16)		// Not supported in Carbon
		::ProgramBreak_AC("A window procID of 16 isn't supported in Carbon.");
#endif

	// The toolbox is allocating the window storage for us, so we should
	// never try to delete it ourselves. 
	fDisposeOnFree = true;

	WindowClass windowClass = 0;
	WindowAttributes attributes = 0;
	GetCreateParameters(fProcID, windowClass, attributes);

	CRect_AC theBounds = GetFrame().ToRect();

	fWMgrWindow = CWindow_AC::Create(windowClass, attributes, theBounds);
	::ThrowIfNULL_AC(fWMgrWindow);

	// Set the window's title from the resource
	SetTitle(CStr255_AC(fStrListID, fIndex));
	
	// •••  May need to call SendBehind for sinking windows
}

//----------------------------------------------------------------------------------------
// TWindow::GetCreateParameters:
//----------------------------------------------------------------------------------------

void TWindow::GetCreateParameters(short procID, WindowClass& windowClass, 
								  WindowAttributes& attributes) const
{
	windowClass = kDocumentWindowClass;
	attributes = 0;

	if (procID == kWindowAlertProc)
	{
		windowClass = kAlertWindowClass;
	}
	else if (procID == kWindowMovableAlertProc)
	{
		windowClass = kMovableAlertWindowClass;
	}
	else if ((procID == dBoxProc) ||
			 (procID == plainDBox) ||
			 (procID == altDBoxProc) ||
			 (procID == kWindowPlainDialogProc) ||
			 (procID == kWindowShadowDialogProc))
	{
		windowClass = kModalWindowClass;
	}
	else if ((procID == movableDBoxProc) ||
			 (procID == kWindowMovableModalDialogProc) ||
			 (procID == kWindowMovableAlertProc) ||
			 (procID == kWindowMovableModalGrowProc))
	{
		windowClass = kMovableModalWindowClass;
	}
	else if (fFloats ||
			 (procID & 0xFFF0 == kSystem75_kWindoidWDEF) ||
			 ((procID >= kWindowFloatProc) && (procID <= kWindowFloatSideFullZoomGrowProc)))
	{
		windowClass = kFloatingWindowClass;
		attributes = kWindowStandardFloatingAttributes;
		if (fIsClosable)
			attributes |= kWindowCloseBoxAttribute;
		if (fIsResizable)
			attributes |= kWindowFullZoomAttribute |
						  kWindowCollapseBoxAttribute |
						  kWindowResizableAttribute;
		if ((procID & 0xFFF0 == kSystem75_kWindoidWDEF) && (procID & kSystem75_vertTBar))
			attributes |= kWindowSideTitlebarAttribute;
	}
	else
	{
		if (fIsClosable)
			attributes |= kWindowCloseBoxAttribute;
		if (fIsResizable)
			attributes |= kWindowFullZoomAttribute |
						  kWindowCollapseBoxAttribute |
						  kWindowResizableAttribute;
	}

#if qCarbonEvents
	if (gDispatcher->UseCarbonEvents())
		attributes |= kWindowStandardHandlerAttribute;
#endif
}

#endif // qPowerPC

#endif // !qMSWindows

//----------------------------------------------------------------------------------------
// TWindow::WriteFields:
//----------------------------------------------------------------------------------------

void TWindow::WriteFields(CStream_AC* aStream) const
{
	TView::WriteFields(aStream);

	aStream->WriteInteger(fProcID);
	aStream->WriteIDType(fTargetID);

	WindowFlags itsFlags;

	itsFlags.Initialize();
	itsFlags.SetHasGoAway(fIsClosable);
	itsFlags.SetResizable(fIsResizable);
	itsFlags.SetDoFirstClick(fDoFirstClick);
	itsFlags.SetFreeOnClosing(fFreeOnClosing);
	itsFlags.SetDisposeOnFree(fDisposeOnFree);
	itsFlags.SetClosesDocument(fClosesDocument);
	itsFlags.SetOpenInitially(fOpenInitially);
	itsFlags.SetMustAdaptToScreen(fMustAdapt);
	itsFlags.SetStagger(fMustStagger);
	itsFlags.SetMustForceOnScreen(fMustForceOnScreen);
	itsFlags.SetVertCenter(fMustVertCenter);
	itsFlags.SetHorzCenter(fMustHorzCenter);
	itsFlags.SetFloats(fFloats);
	itsFlags.SetHideOnSuspend(fHideOnSuspend);
	itsFlags.SetGenerateActivates(fGenerateActivates);

	// write the flags
	aStream->WriteBytes(&itsFlags, sizeof(WindowFlags));

	// write the window title
	aStream->WriteInteger(fStrListID);
	aStream->WriteInteger(fIndex);
}

//----------------------------------------------------------------------------------------
// TWindow::SetActiveState:
//----------------------------------------------------------------------------------------

void TWindow::SetActiveState(bool beActive, bool redraw) // Activate
{
	bool different = (beActive != IsActive());
	if (different)
	{
		// Change to allow floating windows to be activated even if there is an
		// active document window around.
		bool someOneElseActive = false;
		if (beActive && !fFloats)
		{
			// make sure that there is not already an active window - we
			// can't have two active ones at the same time (note that code outside
			// MacApp might call SelectWindow and generate activate events for windows
			// that really are not active, so we have to catch this possibility)…
			for (CWMgrIterator iter; iter; ++iter)
			{
				if (IsWindowVisible_AC(iter))
				{
					TWindow* theMAWindow = WMgrToWindow(iter);
					if (theMAWindow && theMAWindow->IsActive() && !theMAWindow->fFloats)
					{
						someOneElseActive = true;					// someone else is active - bail out!
						break;
					}
				}
			}
		}

		if (!someOneElseActive)
		{
			//fIsActive = beActive;
			//TView::Activate(beActive);

			TView::SetActiveState(beActive, redraw);

			if (!(fFloats && (fTarget == this)))
				SetTarget(beActive ? fTarget : gDispatcher);

			// When we de/activate a window, we need to invalidate the menus manually here.
			// Because we no longer receive activate/deactivates regularly from the Event
			// Manager, we cannot count on TApplication::DidEvent to handle this for us…
			TMenuBarManager::InvalidateMenus();
		}
	}
}

//----------------------------------------------------------------------------------------
// TWindow::IsActive:
//----------------------------------------------------------------------------------------

bool TWindow::IsActive() const
{
	return fIsActive; // a window is either active or it isn't.  It has no fSuperView.
}

//----------------------------------------------------------------------------------------
// TWindow::AdaptToScreen:
//----------------------------------------------------------------------------------------

void TWindow::AdaptToScreen()
// AdaptToScreen adjusts the size of this window to fit proportionally on
// the screen. If the window is smaller than the primary screen on which
// it is to be displayed, the window is enlarged. If the window is larger
// than the primary screen, the window is reduced proportionally within
// the bounds of the window’s resize limits.
//
// Call?		As needed.
// Override?	As needed.
{
	const CViewPoint stdScreen(512, 342);

	fAdapted = true;							// We adapted to the screen

	// Compute pixel difference between current screen and std Mac screen Note:
	// Calculation written as two separate expressions so that CPoint_AC's "-" operator can
	// be inline.
	CRect_AC	theScreenBounds(::ScreenBounds_AC());

	CViewPoint	diff(theScreenBounds.GetSize());
	diff -= stdScreen;

	CViewRect theFrame(GetFrame());

	// If screen is larger, enlarge the window. If the window is too large, shrink it
	if (diff != gZeroVPt || !theScreenBounds.Contains(theFrame[botRight].ToPoint()))
	{
		// do an adjustment for larger screen
		// the window adapted to the new screen size by proportion.
		CViewPoint newSize(Fix2Long(FixMul(Long2Fix(fSize.h), FixDiv(Long2Fix(stdScreen.h + diff.h), Long2Fix(stdScreen.h)))), Fix2Long(FixMul(Long2Fix(fSize.v), FixDiv(Long2Fix(stdScreen.v + diff.v), Long2Fix(stdScreen.v)))));

		// Consider the location of the window, bound it by the resize limits
		newSize.ConstrainTo(GetDynamicResizeLimits());
		Resize(newSize, kInvalidate);
	}
}

//----------------------------------------------------------------------------------------
// TWindow::AllowsMenuAccess:
//----------------------------------------------------------------------------------------

bool TWindow::AllowsMenuAccess()
// AllowsMenuAccess is intended to return true if the menus are accessible
// when this window is the front window. TWindow::AllowsMenuAccess always returns
// true whether the window is modal or modeless.
//
// Call?		As needed.
// Override?	As needed.
{
	// Default is to always allow menu access, even if modal
	return true;
}

typedef WindowDefUPP* WDefProcTypeHandle;

//----------------------------------------------------------------------------------------
// TWindow::Center:
//----------------------------------------------------------------------------------------

void TWindow::Center(bool horizontally, bool vertically, bool forDialog)
// Center positions this window on the screen as specified, centering it either
// horizontially, or vertically, or both. Dialog boxes are placed in the top third of
// the screen unless you specify vertical centering.
//
// horizontally:	True if the window is to be centered horizontally.
// vertically:		True if the window is to be centered vertically.
// forDialog:		True if the window is a dialog box.
//
// Call?		As needed, if your window’s resource did not specify
//				centering.
// Override?	Seldom.
{
	if (fWMgrWindow)
	{
		fHorzCentered = horizontally;
		fVertCentered = vertically;

#if !qMSWindows
		bool rgnsWereBuilt = BuildWindowRegions(kBuild);
		CTempRegion_AC strucRgn;
		fWMgrWindow.GetStructureRgn(strucRgn);

		CPoint_AC windowSize((GetRegionBounds_AC(strucRgn)).GetSize());	// Carbonized
		BuildWindowRegions(rgnsWereBuilt);

		CViewRect theFrame(GetFrame());

		// GetMaxIntersectedDevice accounts for menubar so don't subtract GetMBarHeight
		CRect_AC screenRect;
		GetMaxIntersectedDevice(screenRect);
#else
		CViewRect	theFrame(GetFrame());
		CViewPoint	windowSize(theFrame.GetSize());
		CRect_AC	screenRect(ScreenBounds_AC());
#endif
		CPoint_AC screenSize = screenRect.GetSize();

		if (horizontally)
			theFrame.left = screenRect.left + fContentRegionInset.h + (screenSize.h - windowSize.h) / 2;

		if (vertically)
		{
			if (forDialog)
			// Put it in the top third of the screen
				theFrame.top = screenRect.top + fContentRegionInset.v + (screenSize.v - windowSize.v) / 3;
			else
				theFrame.top = screenRect.top + fContentRegionInset.v + (screenSize.v - windowSize.v) / 2;
		}

		Locate(theFrame[topLeft], kDontInvalidate);
	}
}

//----------------------------------------------------------------------------------------
// TWindow::Close:
//----------------------------------------------------------------------------------------

void TWindow::Close()
{
	TView::Close();

	Show(false, kRedraw);
}

//----------------------------------------------------------------------------------------
// TWindow::CloseAndFree:
//----------------------------------------------------------------------------------------

void TWindow::CloseAndFree()
// CloseAndFree closes a window and, if fFreeOnClosing is true, frees its memory.
//
// Call?		As needed.
// Override?	Seldom.
{
#if qDebug
	::ProgramBreak_AC("TWindow::CloseAndFree is deprecated: please call Close() and then if necessary free the object");
#endif

	Close();
	if (fFreeOnClosing)
		delete this;
}

//----------------------------------------------------------------------------------------
// TWindow::CloseByUser:
//----------------------------------------------------------------------------------------

void TWindow::CloseByUser(CommandNumber aCommandNumber)
// CloseByUser closes the window and, if requested, closes the document associated
// with this window and any other windows associated with the document.
//
// Call?		Seldom. MacApp calls this method for you when the user clicks
//				the active window’s close box or chooses the Close menu command.
// Override?	Seldom.
{
	// First see if the document is to be closed.  This will happen if there
	// is a document and we're not the clipboard window.
	::Assertion_AC(gClipboardMgr != NULL, "gClipboardMgr is unexpectedly NULL");

	if (fDocument && gClipboardMgr->GetClipWindow() != this)
	{
		// Allow the document to determine the proper response to
		// closing one of its windows.
		fDocument->CloseWindow(this);
	}
	else
	{
		// Close the window directly since it wasn't attached to a document.
		DoClose(aCommandNumber);
	}
}

//----------------------------------------------------------------------------------------
// TWindow::DoClose:
//----------------------------------------------------------------------------------------

void TWindow::DoClose(CommandNumber aCommand,
					  bool useAppleEvent)
{
	// Close the window if it wasn't attached to a document.
	CTempAllocation tempAllocation(true);
	CTempObjectAllocation tempObjectAllocation(true);
	TCloseWindowCommand * aCloseWindowCommand = TH_new TCloseWindowCommand(aCommand, this);
	aCloseWindowCommand->SetUseAppleEvent(useAppleEvent);

#if qAppleEventAware
	if (useAppleEvent)
		PostCommand(aCloseWindowCommand);
	else
#endif
		aCloseWindowCommand->Process();

}

//----------------------------------------------------------------------------------------
// TWindow::DoMenuCommand:
//----------------------------------------------------------------------------------------

void TWindow::DoMenuCommand(CommandNumber aCommandNumber)
{
	switch (aCommandNumber)
	{
		case cClose:
			CloseByUser(aCommandNumber);
			break;

		default:
			TView::DoMenuCommand(aCommandNumber);
			break;
	}
}

//----------------------------------------------------------------------------------------
// TWindow::DoSetupMenus:
//----------------------------------------------------------------------------------------

void TWindow::DoSetupMenus()
{
	if (!IsInModalState())						// Don't enable menu/app commands if modal
	{
		Enable(cClose, fIsClosable);			// window objects take care of themselves!

		TView::DoSetupMenus();
	}
}

//----------------------------------------------------------------------------------------
// TWindow::HandlesCursor:
//----------------------------------------------------------------------------------------

bool TWindow::HandlesCursor() const
{
	return fHandlesCursor && (IsActive() || fDoFirstClick);
}

//----------------------------------------------------------------------------------------
// TWindow::LetsSubViewsHandleCursor:
//----------------------------------------------------------------------------------------

bool TWindow::LetsSubViewsHandleCursor() const
{
	return fLetsSubViewsHandleCursor && (IsActive() || fDoFirstClick);
}

//----------------------------------------------------------------------------------------
// TWindow::HandlesHelp:
//----------------------------------------------------------------------------------------

bool TWindow::HandlesHelp() const
{
	return IsActive() && TView::HandlesHelp();
}

//----------------------------------------------------------------------------------------
// TWindow::LetsSubViewsHandleHelp:
//----------------------------------------------------------------------------------------

bool TWindow::LetsSubViewsHandleHelp() const
{
	return IsActive() && TView::LetsSubViewsHandleHelp();
}

#if !qMSWindows
//----------------------------------------------------------------------------------------
// TWindow::DrawResizeIcon:
//----------------------------------------------------------------------------------------

void TWindow::DrawResizeIcon()
{
#if !qCarbon
	if (ResizableWindow() && Focus())
	{
		CRect_AC r(GetQDExtent());
		r[topLeft] = r[botRight] - CPoint_AC(kSBarSizeMinus1, kSBarSizeMinus1);

		// clip down and avoid drawing the lines that delimit scroll bars

		CTempRegion_AC tempRgn;
		CTempRegion_AC tempRgn2;

		// Avoid drawing the GrowIcon if it would have been clipped
		::GetClip(tempRgn);
		::RectRgn(tempRgn2, &r);
		::SectRgn(tempRgn2, tempRgn, tempRgn2);
		if (!::EmptyRgn(tempRgn2))
		{
			::SetClip(tempRgn2);
			::PenNormal();
			::DrawGrowIcon(fWMgrWindow);
			::SetClip(tempRgn);
		}
	}
#else
	//  DrawGrowIcon is deprecated from Mac OS 8.0 forward.  Theme-savvy 
	//  window defprocs include the grow box in the window frame.
    if (ResizableWindow())
	    ::ChangeWindowAttributes(fWMgrWindow, kWindowResizableAttribute, kWindowNoAttributes);
    else
	    ::ChangeWindowAttributes(fWMgrWindow, kWindowNoAttributes, kWindowResizableAttribute);
#endif
}
#endif

//----------------------------------------------------------------------------------------
// TWindow::Focus:
//----------------------------------------------------------------------------------------

bool TWindow::Focus()
{
#if !qMSWindows
	bool returnVal = false;

#if qCarbon
	// If the clip was blown away, force a full refocus
	if (IsFocused() && ::EmptyRgn(GetClipRegion()))
		InvalidateFocus();
#endif

	if (IsFocused())							// Already focused
	{
#if qDebug
		GrafPtr currentPort;

		::GetPort(&currentPort);
		if (GetGrafPort() != currentPort)
			::ProgramBreak_AC("TWindow.Focus: Port is incorrect");
#endif
		returnVal = true;
	}
	else if (fWMgrWindow)						// do my own focus
	{
		// Set the port
		GrafPtr currentPort;
		GrafPtr theWindowPort = GetGrafPort();

		::GetPort(&currentPort);
		if (currentPort != theWindowPort)
			::SetPort_AC(theWindowPort);

		CPoint_AC qdOrigin(GetQDOrigin());
		SetOrigin(qdOrigin.h, qdOrigin.v);
		gFocusedView = this;

		// Add the clipping.
		if (GetUpdating())
		{
			// If we're updating, the window manager has temporarily set
			// our visRgn to the intersection of our normal visRgn and the
			// update region. All we have to do is clip to the visRgn.
			// Actually, we could just set the clip wide open, but we're
			// trying to be tidy.
			::SetClip(GetVisRegion());
		}
		else
		{
			// If there is an update region, we want to clip it out of the
			// area we're going to draw, because it's going to get drawn
			// later at update time.
			RgnHandle theUpdateRgn = GetUpdateRegion();
			if (!::EmptyRgn(theUpdateRgn))
			{
				// The update region is in global coords but the clip is in local coords.
				// Offset the region to make it in local coords here and restore it there
				// to save copying it
				SuperViewToLocal(theUpdateRgn);
				CTempRegion_AC tempRgn;

				// clip OUT the update region
				DiffRgn(GetVisRegion(), theUpdateRgn, tempRgn);
				::SetClip(tempRgn);
				LocalToSuperView(theUpdateRgn);
			}
			else
			{
				::SetClip(GetVisRegion());
			}
		}

		// Get the default content background color.
#if qCarbon
		//#pragma message ("TWindow::Focus: Not sure how to convert this; for now get the port's background color.")
		CRGBColor_AC bgColor;
		::GetPortBackColor(GetWindowPort(fWMgrWindow), bgColor);
#else
		AuxWinHandle awHndl = NULL;
		WCTabHandle ctabHandle = GetAuxWin(fWMgrWindow, &awHndl) ? (WCTabHandle)(*awHndl)->awCTable : (WCTabHandle)awHndl;
		CRGBColor_AC bgColor((*ctabHandle)->ctTable->rgb); // content background color is first entry
#endif

		// ••• Mac OS 8.5 required workaround:
		// If using Appearance and the background color is specified white,
		// automatically adopt Appearance background theme brush.
		// This seems to be required to get correct Appearance 1.1 theme support,
		// and backgrounds have difficulty erasing correctly without it.

		// •••  The following test used to be:
		//   if (AppearanceMgrVersion_AC() >= 0x110) && bgColor == CRGBColor_AC::kRGBWhite)
		// but I took out the background color test figuring that if the developer has a non
		// white background then it doesn't matter if the theme is set since it will get
		// ignored anyway; AND the test seemed to be getting in the way of windows with
		// with embedded controls getting the right background.
		if (AppearanceMgrVersion_AC() >= 0x110)
		{
			ThemeBrush brush = IsModal() ? kThemeActiveDialogBackgroundBrush : kThemeActiveModelessDialogBackgroundBrush;
			OSStatus err = SetThemeWindowBackground(fWMgrWindow, brush, false);
#if qProjectBuilder
			(void) err;
#endif
		}
		else
		{
			// Set the default content region color. This didn't use to show up as
			// a problem, but with widespread use of platinum appearance we find that the
			// window content region color is much more important and can't just be set
			// to white anymore. If this is not done here then any erasure in the window
			// will not have the colors setup right.
			SetIfBkColor(bgColor);
		}
		returnVal = true;
	}

	return returnVal;
#else
	return TView::Focus();
#endif
}

//----------------------------------------------------------------------------------------
// TWindow::FocusOnSuperView:
//----------------------------------------------------------------------------------------

bool TWindow::FocusOnSuperView()
{
	return false;
}

//----------------------------------------------------------------------------------------
// TWindow::GetLocationAdjustment:
//----------------------------------------------------------------------------------------

CPoint_AC TWindow::GetLocationAdjustment() const
{
	CPoint_AC delta;

	const short kMinDragArea = 4;
	CViewRect theVFrame(GetFrame());
	CRect_AC theFrame(theVFrame.ToRect());

	// since we don't _really_ know what the drag rgn is, we'll assume that moving the
	// topleft pt of the window on screen is sufficient to make it draggable, so calculate
	// the deltas necessary to move the topleft pt into visible screen CRect_AC.

	CRect_AC visScreenRect;
	GetMaxIntersectedDevice(visScreenRect);		// NOTE: uses tempRgn
	visScreenRect.Inset(kMinDragArea, kMinDragArea);

	if (theFrame.top < visScreenRect.top)
		delta.v = visScreenRect.top - theFrame.top + fContentRegionInset.v;
	else if (theFrame.top > visScreenRect.bottom)
		delta.v = visScreenRect.bottom - theFrame.top - fContentRegionInset.v;

	if (theFrame.left < visScreenRect.left)
		delta.h = visScreenRect.left - theFrame.left + fContentRegionInset.h;
	else if (theFrame.left > visScreenRect.right)
		delta.h = visScreenRect.right - theFrame.right - fContentRegionInset.h;

	return delta;
}

//----------------------------------------------------------------------------------------
// TWindow::ForceOnScreen: ForceOnScreen guarantees that some minimal drag area is
// accessible to the user, to be dragged to the desired location.
//----------------------------------------------------------------------------------------

void TWindow::ForceOnScreen()
{
	const short kMinDragArea = 4;

	fForcedOnScreen = true;

#if !qMSWindows
	// On many systems (including Color QD && the Radius FPD), it's possible to have a
	// non-rectangular desktop. Try to be nice to people who saved windows on secondary
	// screens. GrayRgn is the true indicator of the shape of the
	// desktop--screenBits.bounds is the size of the screen with the menu bar on it.

	bool rgnsWereBuilt = BuildWindowRegions(kBuild);

	CTempRegion_AC strucRgn;
	fWMgrWindow.GetStructureRgn(strucRgn);

	CTempRegion_AC contRgn;
	fWMgrWindow.GetContentRgn(contRgn);

	CTempRegion_AC tempRgn;
	DiffRgn(strucRgn, contRgn, tempRgn);	// strucRgn less contRgn ≈≈ drag rgn
	if (::EmptyRgn(tempRgn))
		::MacCopyRgn(strucRgn, tempRgn);	// at least get the strucRgn

	BuildWindowRegions(rgnsWereBuilt);

	// get the desktop rgn, inset by a minimal drag area
	CTempRegion_AC aTempRgn;

	::MacCopyRgn(GetGrayRgn(), aTempRgn);			// aTempRgn = desktop rgn
	InsetRgn(aTempRgn, kMinDragArea, kMinDragArea);// inset aTempRgn
	::SectRgn(tempRgn, aTempRgn, aTempRgn);		// do drag rgn && desktop rgn instersect ?

	CPoint_AC delta;

	//if (::EmptyRgn(aTempRgn) || !RectInDrag((*(RgnHandle)aTempRgn)->rgnBBox))
	if (::EmptyRgn(aTempRgn) || !RectInDrag(GetRegionBounds_AC(aTempRgn)))	// Carbonized
		delta = GetLocationAdjustment();			// no => adjust the window's location

	Locate(fLocation.ToPoint() + delta, kDontInvalidate);
#else
	// A first stab at a windows implementation
	CViewRect	frame(GetFrame());
	CRect_AC	screenRect = ScreenBounds_AC();
	CViewRect	intersection = frame & screenRect;
	CPoint_AC	delta;

	if (intersection.IsEmpty())
		delta = GetLocationAdjustment();	// no => adjust the window's location

	Locate(fLocation.ToPoint() + delta, kDontInvalidate);
#endif
}

//----------------------------------------------------------------------------------------
// TWindow::GetMaxIntersectedDevice:
//----------------------------------------------------------------------------------------

GDHandle TWindow::GetMaxIntersectedDevice(CRect_AC& screenRect) const
{
	GDHandle returnVal = NULL;

#if !qMSWindows
	long maxSectArea = 0;
	CRect_AC moveBounds(GetDynamicMoveBounds());

	// set fContentRegionInset && fContentDifference, ensure contrgn and strucrgn are available
	bool rgnsWereBuilt = BuildWindowRegions(kBuild);
	CTempRegion_AC strucRgn;
	fWMgrWindow.GetStructureRgn(strucRgn);

	CRect_AC globalStrucRect(GetRegionBounds_AC(strucRgn));
	BuildWindowRegions(rgnsWereBuilt);

	GDHandle aGDHandle = GetDeviceList();
	GDHandle maxSectGD = GetMainDevice();	// set as best choice default
	while (aGDHandle)
	{										// calc which scrn intersects largest part of window
		if (TestDeviceAttribute(aGDHandle, screenDevice) && TestDeviceAttribute(aGDHandle, screenActive))
		{
			CRect_AC aGDScreenRect((*aGDHandle)->gdRect);
			CRect_AC gdSectRect(globalStrucRect & aGDScreenRect);
			if (!(aGDScreenRect & moveBounds).Empty() && !gdSectRect.Empty())
			{
				long sectArea = gdSectRect.GetLength(vSel) * gdSectRect.GetLength(hSel);
				if (sectArea > maxSectArea)	// do we have a new winner?
				{
					maxSectArea = sectArea;
					maxSectGD = aGDHandle;
				}
			}
		}
		aGDHandle = GetNextDevice(aGDHandle);
	}

	if (maxSectGD != GetMainDevice())
		screenRect = (*maxSectGD)->gdRect;
	else
	{										// Account for menu bar on the main screen.
		// Don't just assume that its at the top of
		// the screen!
		CTempRegion_AC tempRgn;
		CRect_AC gdRect = (*maxSectGD)->gdRect;

		::RectRgn(tempRgn, &gdRect);			// main screen with menubar
		::SectRgn(tempRgn, GetGrayRgn(), tempRgn);// GetGrayRgn == desktop rgn w/o menubar
		//screenRect = (*(RgnHandle)tempRgn)->rgnBBox;// => main screen w/o menubar
		screenRect = GetRegionBounds_AC(tempRgn);	// Carbonized
	}
	returnVal = maxSectGD;
#else
	screenRect = ScreenBounds_AC();
#endif

	return returnVal;
}

//----------------------------------------------------------------------------------------
// TWindow::GetGrafPort:
//----------------------------------------------------------------------------------------

GrafPtr TWindow::GetGrafPort() const
{
	// Allow any drawing environment a chance to intervene in the grafPtr selection.
	GrafPtr theGrafPtr = TView::GetGrafPort();
	
#if !qMSWindows
	if (theGrafPtr == NULL)
	{
		if (gPrinting || gDrawingPictScrap)
			theGrafPtr = GetGrafPtr_AC();					// Use ImagingUtils function
		else
			theGrafPtr = GetWindowGrafPtr_AC(fWMgrWindow);	// Use WindowUtils function
	}
#endif

	return theGrafPtr;
}

//----------------------------------------------------------------------------------------
// TWindow::GetWindowTarget:
//----------------------------------------------------------------------------------------

TEventHandler* TWindow::GetWindowTarget() const
{
	return fTarget;
}

//----------------------------------------------------------------------------------------
// TWindow::GetTitle:
//----------------------------------------------------------------------------------------

CString_AC TWindow::GetTitle() const
{
	Str255 windowTitle;

#if !qMSWindows
	if (fWMgrWindow)
		GetWTitle(fWMgrWindow, windowTitle);
#else
	HWND windowsWindow = GetWindowsWindow();
	if (windowsWindow)
		GetWindowText(windowsWindow, reinterpret_cast<char*>(&windowTitle[0]), sizeof(windowTitle));
#endif

	return CString_AC(windowTitle);
}

//----------------------------------------------------------------------------------------
// TWindow::GetWindow:
//----------------------------------------------------------------------------------------

TWindow* TWindow::GetWindow() const
{
	return const_cast<TWindow*>(this);
}

//----------------------------------------------------------------------------------------
// TWindow::GoAwayByUser:
//----------------------------------------------------------------------------------------

void TWindow::GoAwayByUser(const CViewPoint& theMouse)
{
#if qMSWindows
	if (fIsClosable)
#else
	if (fIsClosable && TrackGoAway(fWMgrWindow, LocalToSuperView(theMouse).ToPoint()))
#endif
		CloseByUser(cClose);
}

//----------------------------------------------------------------------------------------
// TWindow::HandleMouseDown:
//----------------------------------------------------------------------------------------

bool TWindow::HandleMouseDown(const CViewPoint& theMouse,
							  TToolboxEvent* event,
							  CPoint_AC hysteresis,
							  EMouseDownType mouseDownType)
{
	#pragma unused (mouseDownType)

	bool wasHandled = false;

	// Find out where the mouse was pressed
	short aPartCode = GetPartCode(theMouse);

	// Test to determine if the window should be selected. To be selected,
	//  • this window must not be the active window; and
	//  • this window must not float, or if it does, it must not be front-most.
	EMouseDownType mDownType = kDragOrClick;
	if ((gDispatcher->GetActiveWindow(kNoFloaters) != this) && (!fFloats || (fWMgrWindow != FrontWindow())))
	{
		mDownType = fDoFirstClick ? kFirstClick_dragOrClick : kFirstClick_dragOnly;

		if (aPartCode != inContent && (aPartCode != inDrag || !event->IsCommandKeyPressed()))
		{
			Select();
			gDispatcher->UpdateAllWindows();
		}
	}

	// dispatch according to where the mouse was pressed
	switch (aPartCode)
	{
		case inContent:
			wasHandled = TView::HandleMouseDown(theMouse, event, hysteresis, mDownType);
			break;

		case inDrag:
#if !qMSWindows
			if (!HandlePathSelect(event))
#endif
				MoveByUser(theMouse);
			wasHandled = true;
			break;

		case inGrow:

			if(GetIsResizable())
			{
				ResizeByUser(theMouse);
				wasHandled = true;
			}
			else
				wasHandled = TView::HandleMouseDown(theMouse, event, hysteresis, mDownType);

			break;

		case inGoAway:
			GoAwayByUser(theMouse);
			wasHandled = true;
			break;

		case inZoomIn:
		case inZoomOut:
			ZoomByUser(theMouse, aPartCode);
			wasHandled = true;
			break;

		case inDesk:
			wasHandled = true;
			break;

#if !qMSWindows
		case inProxyIcon:
			TrackProxyDrag(theMouse);
			wasHandled = true;
			break;
#endif

		default:
			break;
	}

	return wasHandled;
}

//----------------------------------------------------------------------------------------
// TWindow::HasPendingUpdate:
//----------------------------------------------------------------------------------------

bool TWindow::HasPendingUpdate()	// was const
{
	return !::EmptyRgn(GetUpdateRegion());
}

//----------------------------------------------------------------------------------------
// TWindow::GetPartCode:
//----------------------------------------------------------------------------------------

short TWindow::GetPartCode(const CViewPoint& theMouse) const
{
	short returnVal = inDesk;

	// Call FindWindow to determine the partcode
	WindowRef aWMgrWindow;
	short partCode = ::FindWindow_AC(LocalToSuperView(theMouse).ToPoint(), &aWMgrWindow);
	if (aWMgrWindow == fWMgrWindow)				// if we fail this sanity check, then
		returnVal = partCode;					// passed the sanity check so return the
												// part code we got back from FindWindow
#if qDebug
	else
		::ProgramBreak_AC("in TWindow.GetPartCode: passed a CViewPoint that didn't belong to the window");
#endif

	return returnVal;
}

//----------------------------------------------------------------------------------------
// TWindow::BeInDocument:
//----------------------------------------------------------------------------------------

void TWindow::BeInDocument(TDocument* itsDocument)
{
	TDocument* oldDocument = fDocument;

	TView::BeInDocument(itsDocument);

	if (itsDocument && itsDocument != oldDocument)
	{
		gDispatcher->DeleteWindow(this);		// Just in case…

		CString_AC aString(itsDocument->GetTitle());
		if (!aString.empty())					// not an untitled document
			SetTitleForDoc(aString);
		fNextHandler = itsDocument;
	}
	else
	{
		gDispatcher->AddWindow(this);
		fNextHandler = gDispatcher;
	}
}

//----------------------------------------------------------------------------------------
// TWindow::IsDismissed:
//----------------------------------------------------------------------------------------

bool TWindow::IsDismissed() const
{
	TDialogBehavior * theDialogBehavior = GetDialogBehavior();

	return theDialogBehavior ? theDialogBehavior->fDismissed : true;
}

//----------------------------------------------------------------------------------------
// TWindow::Dismiss:
//----------------------------------------------------------------------------------------

void TWindow::Dismiss(IDType dismisser,
					  bool validate)
{
	TDialogBehavior * theDialogBehavior = GetDialogBehavior();

	if (theDialogBehavior)
		theDialogBehavior->Dismiss(dismisser, validate);
}

//----------------------------------------------------------------------------------------
// TWindow::RectInDrag:
//----------------------------------------------------------------------------------------

bool TWindow::RectInDrag(const CRect_AC& whichRect) const
// Returns true if any of the corner points of whichRect are draggable.
{
	bool result = false;						// assume window isn't draggable

#if qCarbon || qMSWindows
	#pragma unused (whichRect)
	//#pragma message ("TWindow::RectInDrag: Don't know how to deal with WDEF yet.")
#else
	WDefProcTypeHandle wDefProc = (WDefProcTypeHandle)fWMgrWindow.GetAndLoadWDefProc();
	if (wDefProc)
	{
		CTempHandleLock_AC tempHandleLock((Handle)wDefProc);
		WindowDefUPP wdef = *wDefProc;

		bool rgnsWereBuilt = BuildWindowRegions(kBuild);// regions needed for hit testing
		short variant = fWMgrWindow.GetVariant();

		//
		// The static_casts are because SCpp (a certain ZorTech derived compiler) can't figure out how
		// to apply the proper coercion operator from CPoint_AC to long. They can be removed whenever
		// that compiler is feeling better. 4/1/96
		//
#if defined(__SC__) || defined(__MRC__)
		result = (CallWindowDefProc(wdef, variant, fWMgrWindow, wHit, static_cast<const long&>(whichRect[topLeft])) == wInDrag
		|| CallWindowDefProc(wdef, variant, fWMgrWindow, wHit, static_cast<const long&>(whichRect[botRight])) == wInDrag
		|| CallWindowDefProc(wdef, variant, fWMgrWindow, wHit, static_cast<long&>(CPoint_AC(whichRect.left, whichRect.bottom))) == wInDrag
		|| CallWindowDefProc(wdef, variant, fWMgrWindow, wHit, static_cast<long&>(CPoint_AC(whichRect.right, whichRect.top))) == wInDrag);
#else
		result = (CallWindowDefProc(wdef, variant, fWMgrWindow, wHit, (whichRect[topLeft])) == wInDrag
		|| CallWindowDefProc(wdef, variant, fWMgrWindow, wHit, (whichRect[botRight])) == wInDrag
		|| CallWindowDefProc(wdef, variant, fWMgrWindow, wHit, CPoint_AC(whichRect.left, whichRect.bottom)) == wInDrag
		|| CallWindowDefProc(wdef, variant, fWMgrWindow, wHit, CPoint_AC(whichRect.right, whichRect.top)) == wInDrag);
#endif
		BuildWindowRegions(rgnsWereBuilt);		// restore state of window rgns
	}
#if qDebugMsg
	else
		::ProgramBreak_AC("###TWindow.RectInDrag: can't load wdef");
#endif

#endif

	return result;
}

//----------------------------------------------------------------------------------------
// TWindow::IsShown:
//----------------------------------------------------------------------------------------

bool TWindow::IsShown() const
{
#if !qMSWindows
	return fWMgrWindow ? IsWindowVisible_AC(fWMgrWindow) : false;
#else
	HWND windowsWindow = GetWindowsWindow();
	return windowsWindow ? IsWindowVisible(windowsWindow) : false;
#endif
}

//----------------------------------------------------------------------------------------
// TWindow::DoInvalidateRegion:
//----------------------------------------------------------------------------------------

void TWindow::DoInvalidateRegion(const RgnHandle badRgn)
{
	GrafPtr	qdPort = GetGrafPtr_AC();
	if ((qdPort == (GrafPtr)::GetWindowPort(fWMgrWindow)) && IsShown() && !::EmptyRgn(badRgn))
#if qCarbon
	{
		::InvalWindowRgn(fWMgrWindow, badRgn);
		if (gShowInvalidations)
			::MacFillRgn(badRgn, CPattern_AC(0, 25));

		// Maintain the Focus
		RgnHandle qdPortClipRegion = GetClipRegion();

		// clip should EXCLUDE the invalid region
		::DiffRgn(GetClipRegion(), badRgn, qdPortClipRegion);
		::SetPortClipRegion(GetCGrafPtr_AC(), qdPortClipRegion);
	}
#else
	{
		::InvalRgn(badRgn);
		if (gShowInvalidations)
			::MacFillRgn(badRgn, CPattern_AC(0, 25));

		// Maintain the Focus
		RgnHandle qdPortClipRegion = GetClipRegion();

#if qMSWindows
		if (GetUpdating())			// clip should INCLUDE the update region
			::MacUnionRgn(qdPortClipRegion, badRgn, GetCGrafPtr_AC()->clipRgn);
		else
#endif
			// clip should EXCLUDE the invalid region
			::DiffRgn(qdPortClipRegion, badRgn, qdPortClipRegion);
	}
#endif
}

//----------------------------------------------------------------------------------------
// TWindow::DoValidateRegion:
//----------------------------------------------------------------------------------------

void TWindow::DoValidateRegion(const RgnHandle goodRgn)
{
	GrafPtr	qdPort = GetGrafPtr_AC();
	if ((qdPort == (GrafPtr)GetWindowPort(fWMgrWindow)) && IsShown())
	{
		if (!::EmptyRgn(goodRgn))
		{
#if qCarbon
			::ValidWindowRgn(fWMgrWindow, goodRgn);

			// Maintain the Focus
			RgnHandle qdPortClipRegion = GetClipRegion();

			// clip should INCLUDE the valid region
			::MacUnionRgn(qdPortClipRegion, goodRgn, qdPortClipRegion);
			::SetPortClipRegion(qdPort, qdPortClipRegion);
#else
			ValidRgn(goodRgn);

#if !qMSWindows
			// Clip should INCLUDE the valid region
			::MacUnionRgn(GetClipRegion(), goodRgn, qdPort->clipRgn);
#else
			// Maintain the Focus
			if (GetUpdating())					// clip should INCLUDE the update region and exclude valid bits
				::DiffRgn(GetClipRegion(), goodRgn, GetCGrafPtr_AC()->clipRgn);
			else								// clip should EXCLUDE the update region and include valid bits
				::MacUnionRgn(GetClipRegion(), goodRgn, GetCGrafPtr_AC()->clipRgn);
#endif
#endif
		}
	}
}

#if qCarbon
//----------------------------------------------------------------------------------------
// TWindow::GetClipRegion: Return the clip region of the specified GrafPtr.
// In Carbon set our special RgnHandle to the port's clipRgn and return it.
//----------------------------------------------------------------------------------------

RgnHandle TWindow::GetClipRegion()
{
	// Use our special Carbon region handle
	if (!fCarbonClipRegion)
		fCarbonClipRegion = ::NewRgn();

	return ::GetPortClipRegion(GetGrafPort(), fCarbonClipRegion);
}
#endif

//----------------------------------------------------------------------------------------
// TWindow::GetVisRegion: Return the visible region of the specified GrafPtr.
// In Carbon set our special RgnHandle to the port's visRgn and return it.
//----------------------------------------------------------------------------------------

RgnHandle TWindow::GetVisRegion()
{
#if qCarbon
	// Use our special Carbon region handle
	if (fCarbonVisRegion == NULL)
		fCarbonVisRegion = ::NewRgn();

	return ::GetPortVisibleRegion(GetGrafPort(), fCarbonVisRegion);
#else
	return GetGrafPort()->visRgn;
#endif
}

//----------------------------------------------------------------------------------------
// TWindow::GetUpdateRegion: Return the update region of this window.
// In Carbon set our special RgnHandle to the window's updateRgn and return it.
//----------------------------------------------------------------------------------------

RgnHandle TWindow::GetUpdateRegion()
{
#if !qCarbon
	return fWMgrWindow.Peek()->updateRgn;
#else
	// Use our special Carbon region handle
	if (fCarbonUpdateRegion == NULL)
		fCarbonUpdateRegion = ::NewRgn();

	fWMgrWindow.GetUpdateRgn(fCarbonUpdateRegion);

	return fCarbonUpdateRegion;
#endif
}

//----------------------------------------------------------------------------------------

bool TWindow::BuildWindowRegions(bool build) const
// BuildWindowRegions builds or destroys this window’s regions; a window is
// built if the window is shown on the screen or if its structure region, which
// consists of its content region, title bar, and so on, is not empty. The previous
// state of the window’s region, built(kBuild) or not built(!kBuild), is returned.
// When you specify to build a region, this method recomputes the window’s
// structure and content regions and sets the appropriate fields in this
// object. If you specify to destroy the region, this method sets the structure
// and content regions to empty regions.
//
// build:	When kBuild (true) it indicated that the window’s regions are to
//			be built.  When !kBuild (false) it specifies that the window’s regions
//			are to be destroyed.
//
// Call?		Seldom.
// Override?	Seldom.
{
	bool returnVal = kBuild;

#if !qMSWindows
#if !qCarbon
	// •••  Currently there is no way to access a window's defproc.
	WindowPeek windowPeek = fWMgrWindow.Peek();

	// The regions are considered to be built if either:
	//  a) the window is shown; or
	//  b) the structure rgn is not empty.

	if (IsShown() || !::EmptyRgn(windowPeek->strucRgn))
	{
		if ((build != kBuild) && !IsShown())
		{
			SetEmptyRgn(windowPeek->strucRgn);
			SetEmptyRgn(windowPeek->contRgn);
		}
	}
	else
	{
		if (build == kBuild)
		{
			WDefProcTypeHandle wDefProc = (WDefProcTypeHandle)fWMgrWindow.GetAndLoadWDefProc();
			if (wDefProc)
			{
				{
					CTempHandleLock_AC tempHandleLock((Handle)wDefProc);
					WindowDefUPP wdef = *wDefProc;
					CallWindowDefProc(wdef, fWMgrWindow.GetVariant(), fWMgrWindow, wCalcRgns, 0);
				}

				// Calculate offset from top-left of window structure to top-left of window content
				const_cast<TWindow*>(this)->fContentRegionInset = ((CRect_AC &)(*windowPeek->contRgn)->rgnBBox)[topLeft] - ((CRect_AC &)(*windowPeek->strucRgn)->rgnBBox)[topLeft];

				CRect_AC globalStrucRect = (*windowPeek->strucRgn)->rgnBBox;
				CRect_AC globalContRect = (*windowPeek->contRgn)->rgnBBox;
				const_cast<TWindow*>(this)->fContentDifference = globalStrucRect.GetSize() - globalContRect.GetSize();
			}
		}
		returnVal = !kBuild;
	}
#else
	// For Carbon the window structure region never appears to be empty so we simply test
	// whether the window is being shown or not. 
	if (!IsShown())
	{
		if (build == kBuild)
		{
			UInt32 features = 0;
			OSErr err = ::GetWindowFeatures(fWMgrWindow, &features);
			if ((err == noErr) && (features & kWindowCanGetWindowRegion))
			{
				// •••  How to tell window to calculate its regions?
				CRect_AC globalStrucRect;
				CRect_AC globalContRect;
				err = ::GetWindowBounds(fWMgrWindow, kWindowStructureRgn, globalStrucRect);
				err = ::GetWindowBounds(fWMgrWindow, kWindowContentRgn, globalContRect);

				// Calculate offset from top-left of window structure to top-left of window content
				const_cast<TWindow*>(this)->fContentRegionInset = globalContRect[topLeft] - globalStrucRect[topLeft];

				const_cast<TWindow*>(this)->fContentDifference = globalStrucRect.GetSize() - globalContRect.GetSize();

			}
		}
		returnVal = !kBuild;
	}
#endif
#endif

	return returnVal;
}

//----------------------------------------------------------------------------------------
// TWindow::Select:
//----------------------------------------------------------------------------------------

void TWindow::Select()
{
#if !qMSWindows
	MASelectToolboxWindow(fWMgrWindow);			// 3.5
#else
	SendMessage(CApplication_AC::fgProcess->fChildClientWindow, WM_MDIACTIVATE, (WPARAM)GetWindowsWindow(), 0);
#endif
}

//----------------------------------------------------------------------------------------
// TWindow::MoveByUser:
//----------------------------------------------------------------------------------------

void TWindow::MoveByUser(const CViewPoint& theMouse)
{
	CViewRect oldFrame(GetFrame());

	MADragWindow(fWMgrWindow, LocalToSuperView(theMouse).ToPoint(), GetDynamicMoveBounds());

	// Don't forget to tell the window object
	if (Focus())
		Locate(LocalToGlobal(GetPortRect_AC(fWMgrWindow)[topLeft]), kDontInvalidate);	// can't use localtosuper since fLocation not updated yet

#if qAppleEventAware
	CViewRect newFrame(GetFrame());
	if (TOSADispatcher::fgDispatcher->GetDefaultTarget()->IsRecordingOn() && (newFrame != oldFrame))
	{
		TSetPropertyEvent theEvent(gServerAddress, kAENoReply + kAEDontExecute, this, pBounds);
		theEvent.WriteRect(keyAEData, newFrame.ToRect());
		CAutoPtr_AC<TAppleEvent> theReply(theEvent.Send());
	}
#endif
}

//----------------------------------------------------------------------------------------
// TWindow::Open:
//----------------------------------------------------------------------------------------

void TWindow::Open()
{
	if (!IsShown())
	{
		// Keep us matching the window since we are parallel structures
		// Be sure all views are sized right
		Resize(GetPortRect_AC(fWMgrWindow).GetSize(), kDontInvalidate);

		if (fMustAdapt && !fAdapted)
			AdaptToScreen();
		if ((fMustHorzCenter && !fHorzCentered) || (fMustVertCenter && !fVertCentered))
			Center(fMustHorzCenter, fMustVertCenter, IsModal());

		if (fMustStagger && !fStaggered)
		{
			// If both staggering and forcing on screen are specified then we must ensure
			// that the window is forced on screen FIRST so that the staggering will occur
			// in a visible (and usable) location. BUT, after staggering we must STILL
			// ensure that the window is forced on screen so, we reset the forced flag so
			// that forcing will occur on schedule later.
			if (fMustForceOnScreen && !fForcedOnScreen)
			{
				ForceOnScreen();
				fForcedOnScreen = false;		// Make sure we can be forced again
			}
			SimpleStagger(CPoint_AC(kStdStaggerAmount, kStdStaggerAmount), gStandardWindowStaggerCount);
		}
		if (fMustForceOnScreen && !fForcedOnScreen)
			ForceOnScreen();

		// If fVisibleExtent is empty, InvalidateCoordinates so our contents will be drawn (b/c of caching)
		if (GetVisibleExtent().Empty())
			InvalidateCoordinates();

		if (fTarget)
			fTarget->SetTargetSelection(kDontRedraw);
		Show(true, kRedraw);					// Make me visible
#if qMSWindows
		SendMessage(CApplication_AC::fgProcess->fChildClientWindow, WM_MDIACTIVATE, (WPARAM)GetWindowsWindow(), 0);
#endif

	}
	TView::Open();							// Tell subviews to open in case they care
}

//----------------------------------------------------------------------------------------
// TWindow::PoseModally:
//----------------------------------------------------------------------------------------

IDType TWindow::PoseModally()
{
	TDialogBehavior * itsDialogBehavior = GetDialogBehavior();
	IDType result = kNoIdentifier;

	if (itsDialogBehavior)
	{
		bool wasModal = itsDialogBehavior->fModal;

		if (!wasModal)
			SetModality(true);

		try
		{
			Open();
			Select();							// Bring it to the front

			itsDialogBehavior->PoseModally();
			result = itsDialogBehavior->fDismisser;
		}
		catch(CException_AC& theException)
		{
			DoCatchMessage_AC(theException);
			Close();
			if (fFreeOnClosing)
				delete this;

			throw;
		}

		if (!wasModal)
			SetModality(wasModal);
	}
	else
	{
		Close();
		if (fFreeOnClosing)
			delete this;
#if qDebug
		::ProgramBreak_AC("Can't PoseModally because the window doesn't contain a TDialogBehavior.");
#endif

		gErrorParm3 = "TDialogBehavior";		// show name of class
		::ThrowException_AC(errMissingClass, 0);
	}

	return result;
}

//----------------------------------------------------------------------------------------
// TWindow::IsModal:
//----------------------------------------------------------------------------------------

bool TWindow::IsModal() const
{
	TDialogBehavior * theDialogBehavior = GetDialogBehavior();

	return theDialogBehavior ? theDialogBehavior->fModal : false;
}

//----------------------------------------------------------------------------------------
// TWindow::IsInModalState:
//----------------------------------------------------------------------------------------

bool TWindow::IsInModalState() const
{
	TDialogBehavior * theDialogBehavior = GetDialogBehavior();

	return theDialogBehavior ? (theDialogBehavior->fModal) && (!theDialogBehavior->fDismissed) : false;
}

//----------------------------------------------------------------------------------------
// TWindow::AddedASubView:
//----------------------------------------------------------------------------------------

void TWindow::AddedASubView(TView* theSubView)
{
#if qDrag
	// Check this view and all of its subviews to see if any of them
	// are droppable.
	RegisterIfDroppableView(theSubView);
#endif
}

//----------------------------------------------------------------------------------------
// TWindow::RemovedASubView:
//----------------------------------------------------------------------------------------

void TWindow::RemovedASubView(TView* theSubView)
{
	// if theSubView (or any subView) is the target, we need to
	// set the target to this window. It might be fatal for the target to
	// point to a view no longer in the window.

	TEventHandler * handler;
	for (handler = GetTarget(); handler; handler = handler->GetNextHandler())
		if (theSubView == handler)
		{
			SetTarget(this);
			break;
		}

	for (handler = fTarget; handler; handler = handler->GetNextHandler())
		if (theSubView == handler)
		{
			fTarget = this;
			break;
		}

#if qDrag
	// If the view being removed is droppable then we need to unregister it.
	UnregisterIfDroppableView(theSubView);
#endif
}

//----------------------------------------------------------------------------------------
// TWindow::SetFrame:
//----------------------------------------------------------------------------------------

void TWindow::SetFrame(const CViewRect& newFrame,
					   bool invalidate)
{
	if (fWMgrWindow)
	{
#if !qMSWindows
		CRect_AC newQDFrame(newFrame.ToRect());
		if (!(newFrame.GetSize() < fSize))
		{
			if (newFrame[topLeft] != fLocation)
				::MoveWindow_AC(fWMgrWindow, newQDFrame[topLeft].h, newQDFrame[topLeft].v, false);

			if (newFrame.GetSize() != fSize)
				SizeWindow(fWMgrWindow, newQDFrame.GetSize().h, newQDFrame.GetSize().v, invalidate);
		}
		else
		{
			if (newFrame.GetSize() != fSize)
				SizeWindow(fWMgrWindow, newQDFrame.GetSize().h, newQDFrame.GetSize().v, invalidate);
			if (newFrame[topLeft] != fLocation)
				::MoveWindow_AC(fWMgrWindow, newQDFrame[topLeft].h, newQDFrame[topLeft].v, false);
		}
#else
		if (newFrame.GetSize() != fSize || newFrame[topLeft] != fLocation)
		{
			CViewPoint caption = GetWindowTitleSize(fProcID);
			MoveWindow(GetWindowsWindow(), newFrame.left, newFrame.top,
					newFrame.GetSize()[hSel] + caption.h,
					newFrame.GetSize()[vSel] + caption.v, true /*invalidate*/);
		}
#endif
	}

	CViewPoint oldSize = fSize;
	CViewRect vr(-kSBarSizeMinus1, -kSBarSizeMinus1, 0, 0);// standard size of grow box

	if (fIsResizable && invalidate && newFrame.GetSize() != oldSize)
		Invalidate(vr + fSize);			// old location

	TView::SetFrame(newFrame, invalidate);

	if (fIsResizable && invalidate && fSize != oldSize)
		Invalidate(vr + fSize);			// new location
}

//----------------------------------------------------------------------------------------
// TWindow::ResizeByUser:
//----------------------------------------------------------------------------------------

void TWindow::ResizeByUser(const CViewPoint& theMouse)
{
#if !qMSWindows
	if (fIsResizable)
	{
		long growResult = ::GrowWindow(fWMgrWindow, LocalToSuperView(theMouse).ToPoint(), GetDynamicResizeLimits());
		if (growResult)
			Resize(CViewPoint(LoWord(growResult), HiWord(growResult)), kInvalidate);
#if qAppleEventAware
		if (growResult && TOSADispatcher::fgDispatcher->GetDefaultTarget()->IsRecordingOn())
		{
			TSetPropertyEvent theEvent(gServerAddress, kAENoReply + kAEDontExecute, this, pBounds);
			theEvent.WriteRect(keyAEData, GetFrame().ToRect());
			CAutoPtr_AC<TAppleEvent> theReply(theEvent.Send());
		}
#endif
	}
#else
	if (IsShown())
	{
		// There currently doesn't appear to be a way to keep fLocation up to date in windows..
		// still looking into this
		RECT oldFrame;
		GetWindowRect(GetWindowsWindow(), &oldFrame);
		MapWindowPoints(HWND_DESKTOP, CApplication_AC::fgProcess->fChildClientWindow, (POINT*)&oldFrame, 2);
		fLocation.h = oldFrame.left;
		fLocation.v = oldFrame.top;
	}
	SetFrame(CViewRect(fLocation, fLocation + theMouse), kInvalidate);
#endif
}

//----------------------------------------------------------------------------------------
// TWindow::SetResizeLimits:
//----------------------------------------------------------------------------------------

void TWindow::SetResizeLimits(CPoint_AC itsMinSize, CPoint_AC itsMaxSize)
{
	fResizeLimits.Set(itsMinSize, itsMaxSize);

	CRect_AC resizeLimits(GetDynamicResizeLimits());		// get the dynamic values

#if !qMSWindows
	// If the window is zoomable, keep the window's state data current
	if (GetWindowZoomFlag(fWMgrWindow))
	{
		CRect_AC theStdState;
		GetWindowStandardState(fWMgrWindow, &theStdState);
		long longLimit = fLocation.h + resizeLimits.right;
		longLimit = Min_AC(longLimit, kMaxCoord);
		theStdState.right = Min_AC(theStdState.right, static_cast<short>(longLimit));

		longLimit = fLocation.v + resizeLimits.bottom;
		longLimit = Min_AC(longLimit, kMaxCoord);
		theStdState.bottom = Min_AC(theStdState.bottom, static_cast<short>(longLimit));
		SetWindowStandardState(fWMgrWindow, &theStdState);
	}
#endif

	// If the window is not sized within the new limits, resize it to fit
	CViewPoint newSize(fSize);
	newSize.ConstrainTo(resizeLimits);

	Resize(newSize, IsVisible());
}

//----------------------------------------------------------------------------------------
// TWindow::DoEvent:
//----------------------------------------------------------------------------------------

void TWindow::DoEvent(EventNumber eventNumber, TEventHandler* source, TEvent* event)
{
	switch (eventNumber)
	{
		case mBecameTarget:
			if (IsActive())
				SetWindowTarget(source);
			break;

		default:
			TView::DoEvent(eventNumber, source, event);
			break;
	}
}

//----------------------------------------------------------------------------------------
// TWindow::SetWindowTarget:
//----------------------------------------------------------------------------------------

void TWindow::SetWindowTarget(TEventHandler* newTarget)
{
	if (!newTarget)								// Would be annoying if a NULL got in here!
		newTarget = this;
	if (newTarget != fTarget)
	{
		fTarget->ResignedWindowTarget();
		fTarget = newTarget;
		newTarget->BecameWindowTarget();
	}
}

//----------------------------------------------------------------------------------------
// TWindow::SetTitle:
//----------------------------------------------------------------------------------------

void TWindow::SetTitle(const CStr255_AC& newTitle)
{
#if !qMSWindows
	CStr255_AC oldTitle;

	GetWTitle(fWMgrWindow, oldTitle);			// to minimize flash, we only set the
												// title if it's different from the
												// current title
	if (oldTitle != newTitle)
		::SetWTitle(fWMgrWindow, newTitle);
#else
	HWND windowsWindow = GetWindowsWindow();
	if (windowsWindow)
	{
		char theTitle[256];
		newTitle.CopyTo(theTitle);
		::SetWindowText(windowsWindow, (const char*)theTitle);
	}
#endif
}

//----------------------------------------------------------------------------------------
// TWindow::SetTitleForDoc:
//----------------------------------------------------------------------------------------

void TWindow::SetTitleForDoc(const CString_AC& newDocTitle)
// SetTitleForDoc will set this window's title if the current window title is
// substitutable.
//
// newDocTitle:		A constant title containing the document's title.
//
// Call?		Rarely.  The TDocument::SetTitle function calls this.
// Override?	As needed.  For example, override if you want the window to
//				always have the same title as the document regardless of
//				substitutability.
{
	SetTitle(GetTitle().DoSubstitution(newDocTitle, fSubStart, fTailLength));
}

#if !qMSWindows

//----------------------------------------------------------------------------------------
// TWindow::SetProxyIconByFile:
//----------------------------------------------------------------------------------------

void TWindow::SetProxyIconByFile(CFile_AC* proxyFile)
{
#if qPowerPC
	// Do not set the proxy icon if I am a modal window, since WM will not draw the
	// title bar correctly, and won't track the mouse in the right areas.
	if (!IsModalWindow(fWMgrWindow) && ::GetSystemVersion_AC() >= 0x850)
	{
		CTempGrafPort_AC saveGrafPort;		// The GrafPort may get changed and we won't know.

		if (proxyFile->GetFileSpec().Exists())
		{
			AliasHandle alias;
			ThrowIfOSErr_AC(proxyFile->GetAlias(alias));
			ThrowIfOSErr_AC(::SetWindowProxyAlias(GetWindowRef(), alias));
			SetModified(false);
		}
		else
		{
			ThrowIfOSErr_AC(::SetWindowProxyCreatorAndType(GetWindowRef(),
															proxyFile->GetCachedFileCreator(),
															proxyFile->GetCachedFileType(),
															-1 /* boot volume */));
			SetModified(true);
		}
	}
#else
	#pragma unused (proxyFile)
#endif
}

//----------------------------------------------------------------------------------------
// TWindow::SetProxyIcon:
//----------------------------------------------------------------------------------------

void TWindow::SetProxyIcon(IconRef icon)
{
#if qPowerPC
	if (::GetSystemVersion_AC() >= 0x850)
	{
		CTempDrawingEnvironment_AC savedPort(kSaveGrafPort);
		ThrowIfOSErr_AC(::SetWindowProxyIcon(GetWindowRef(), icon));
	}
#else
	#pragma unused (icon)
#endif
}

//----------------------------------------------------------------------------------------
// TWindow::GetProxyIcon:
//----------------------------------------------------------------------------------------

IconRef TWindow::GetProxyIcon() const
{
	IconRef icon = 0; // ••• ??? what is an invalid IconRef's value?
#if qPowerPC
	if (::GetSystemVersion_AC() >= 0x850)
	{
		ThrowIfOSErr_AC(::GetWindowProxyIcon(GetWindowRef(), &icon));
	}
#endif
	return icon;
}

//----------------------------------------------------------------------------------------
// TWindow::TrackProxyDrag:
//----------------------------------------------------------------------------------------

void TWindow::TrackProxyDrag(const CViewPoint& startPt)
{
#if qPowerPC
	if (::GetSystemVersion_AC() >= 0x850)
	{
		CPoint_AC globalPt(ViewToQD(startPt));
		::LocalToGlobal(&globalPt);

		OSStatus err = ::TrackWindowProxyDrag(fWMgrWindow, globalPt);
		if (err == errUserWantsToDragWindow)
			MoveByUser(startPt);
	}
#else
	#pragma unused (startPt)
#endif
}

//----------------------------------------------------------------------------------------
// TWindow::HandlePathSelect:
//----------------------------------------------------------------------------------------

bool TWindow::HandlePathSelect(TToolboxEvent* event)
{
// Implementation note: the error code errWindowDoesNotHaveProxy is
// returned even if the window has a proxy icon; what the error means is,
// there is no saved _file_ associated with the window.  This error code
// led to the disabling of the inProxyDrag case in HandleMouseDown, and the
// disabling and the debugging ProgramReport calls.  The only way to check
// for this condition is to either maintain it ourselves in TWindow (why
// bother?), or ignore the error.  We'll use the latter.
	bool didPathSelect = false;

#if qPowerPC
	if (::GetSystemVersion_AC() >= 0x850)
	{
		didPathSelect = ::IsWindowPathSelectClick(fWMgrWindow,
												  &(const_cast<EventRecord&>(event->GetEventRecord())));
		if (didPathSelect)
		{
			SInt32 ignoredMenuResult;
			OSStatus err = ::WindowPathSelect(fWMgrWindow, NULL, &ignoredMenuResult);

			// It's okay to cancel or not have a proxy.  There's no way to
			// check for the latter except by ignoring the error as we
			// do here.
			didPathSelect = (err == noErr);
			if (didPathSelect)
			{
				// switch to the Finder (signature 'MACS')
				ProcessSerialNumber	psn;
				CFSSpec_AC			fileSpec;
				err =  FindProcessBySignature('MACS', psn, &fileSpec);
				if (err == noErr)
					err = SetFrontProcess(&psn);
			}
		}
	}
#else
	#pragma unused (event)
#endif

	return didPathSelect;
}

#endif

//----------------------------------------------------------------------------------------
// TWindow::SetModified:
//----------------------------------------------------------------------------------------

void TWindow::SetModified(bool isModified)
{
#if qPowerPC
	if (::GetSystemVersion_AC() >= 0x850)
	{
		ThrowIfOSErr_AC(::SetWindowModified(GetWindowRef(), isModified));
	}
#else
	#pragma unused (isModified)
#endif
}

//----------------------------------------------------------------------------------------
// TWindow::IsModified:
//----------------------------------------------------------------------------------------

bool TWindow::IsModified() const
{
	return
#if qPowerPC
		::GetSystemVersion_AC() >= 0x850 ? ::IsWindowModified(GetWindowRef()) :
#endif
		false;
}

//----------------------------------------------------------------------------------------
// TWindow::AboutToLoseControl:
//----------------------------------------------------------------------------------------

void TWindow::AboutToLoseControl()
// AboutToLoseControl specifies actions to take just before control passes
// to another application or a desk accessory. The method hides this window
// if it currently appears on the screen and must be hidden when its application
// is suspended.
//
// Call?		Seldom.
// Override?	Seldom.
{
	if (IsShown() && IsHiddenOnSuspend())
	{
		fWasHiddenOnSuspend = true;
		bool oldManageActivation = fGenerateActivates;
		fGenerateActivates = false;
		Show(false, kRedraw);
		fGenerateActivates = oldManageActivation;
	}
}

//----------------------------------------------------------------------------------------
// TWindow::RegainControl:
//----------------------------------------------------------------------------------------

void TWindow::RegainControl()
{
	if (fWasHiddenOnSuspend)
	{
		fWasHiddenOnSuspend = false;
		// Any necessary activation is handled in TApplication.HandleSystemEvent
		bool oldManageActivation = fGenerateActivates;
		fGenerateActivates = false;
		Show(true, kRedraw);
		fGenerateActivates = oldManageActivation;
	}
}

//----------------------------------------------------------------------------------------
// TWindow::Show:
//----------------------------------------------------------------------------------------

void TWindow::Show(bool state, bool redraw)
{
#if !qMSWindows
	if (state)
	{
		// Be sure all views are sized right
		Resize(GetPortRect_AC(fWMgrWindow).GetSize(), redraw);
	}

	if (fGenerateActivates && !fFloats)
	{
		if (state)
			MAShowWindow(fWMgrWindow);
		else
			MAHideWindow(fWMgrWindow);
	}
	else
	{
		if (fFloats)
			::HiliteWindow(fWMgrWindow, state);

		ShowHideWindow(fWMgrWindow, state);
			
		if (!state)
			SetActiveState(false, redraw); // at least de-activate ourselves when hiding
	}

	// manage floaters window list position
	if (state && fFloats)
	{
		if (fSinks)
		{
			// if we are in front of any of the non-sinking windows, we move
			// to the front of our layer
			WindowRef lastWindow = NULL;
			bool foundOurself = false;
			bool needToMove = false;

			for (CWMgrIterator iter; iter; ++iter)
			{
				if (iter.Current() == fWMgrWindow)
					foundOurself = true;
				else if (IsModalWindow(iter) || IsDocumentWindow(iter) || IsVisibleFloatWindow(iter))
				{
					lastWindow = iter;
					needToMove = foundOurself;
				}
			}

			if (needToMove)
			{
				if (lastWindow)
					::SendBehind(fWMgrWindow, lastWindow);
				else
					::BringToFront(fWMgrWindow);
			}
		}
		else
		{
			// if we are behind any of the normal document windows, we move
			// to the front of our layer
			bool foundNormalDocWindow = false;
			bool foundOurself = false;
			bool needToMove = false;

			for (CWMgrIterator iter; iter; ++iter)
			{
				if (iter.Current() == fWMgrWindow)
				{
					foundOurself = true;
					needToMove = foundNormalDocWindow;
				}
				else if (!IsModalWindow(iter) && !IsVisibleFloatWindow(iter))
					foundNormalDocWindow = true;
			}

			if (needToMove)
				::BringToFront(fWMgrWindow);
		}
	}

	// manage activation:
	if (fFloats)
		SetActiveState(state, redraw);	// for floaters, activation == visibility
	else if ((!state) && IsActive())
		SetActiveState(false, redraw);	// if active, de-activate ourselves when hiding

	TView::Show(state, redraw);
#else
	// •-•-•-•-•-•-• Windows Implementation •-•-•-•-•-•-•
	if (state)
	{
		// Be sure all views are sized right
		Resize(GetPortRect_AC(fWMgrWindow).GetSize(), redraw);
	}

	if (fGenerateActivates && !fFloats)
	{
		if (state)
			MAShowWindow(fWMgrWindow);
		else
			MAHideWindow(fWMgrWindow);
	}
	else
	{
#pragma message ("TWindow::Show: What do we do with floating windows?")

		ShowHideWindow(GetWindowsWindow(), state ? SW_SHOW : SW_HIDE);

		if (!state)
			SetActiveState(false, redraw); //Activate(false);					// at least de-activate ourselves when
		// hiding
	}

	// manage activation:
	if (fFloats)
		SetActiveState(state, redraw);		// for floaters, activation == visibility
	else if ((!state) && IsActive())
		SetActiveState(false, redraw);		// if active, de-activate ourselves when hiding

	TView::Show(state, redraw);
#endif
}

//----------------------------------------------------------------------------------------
// TWindow::SimpleStagger:
//----------------------------------------------------------------------------------------

void TWindow::SimpleStagger(CPoint_AC delta, short& counter)
{
	fStaggered = true;
	CViewRect theFrame(GetFrame());

	theFrame[botRight] = (theFrame[topLeft] + CViewPoint(GetDynamicMoveBounds()[botRight])) - theFrame[botRight];

	// This covers the case of delta.h && delta.v both >= 0; if either is less than 0, the
	// right (bottom) limit is set to the left (top) edge of the screen -- allowing for
	// some margin. This makes the right (bottom) edge less than the left (top) edge, but
	// this is OK since the/ statement below will be dividing 2 negative numbers.

	if (delta.h < 0)
		theFrame.right = fMoveBounds.left;
	if (delta.v < 0)
		theFrame.bottom = fMoveBounds.top;

	// This code avoids divide by zero problems
	long nSlots = (!delta.h || !delta.v) ? 0 : Min_AC(static_cast<long>((theFrame.GetLength(hSel) + delta.h - 1) / delta.h), static_cast<long>((theFrame.GetLength(vSel) + delta.v - 1) / delta.v));
	long slot = nSlots ? counter % nSlots : 0;

	if (slot)									// move the window
	{
		// The place to position the window
		Locate(theFrame[topLeft] + CViewPoint((slot * delta.h), (slot * delta.v)), kDontInvalidate);
	}

	++counter;
}

//----------------------------------------------------------------------------------------
// TWindow::BeginUpdate:
//----------------------------------------------------------------------------------------

void TWindow::BeginUpdate()
{
	// Keep track of the window we are updating.
	fgUpdatingWindowPtr = fWMgrWindow;

	// Set the port to the window before calling BeginUpdate.
	// Keeps Spotlight from complaining.
	CGrafPtr theWindowPort = ::GetWindowPort(fWMgrWindow);
	if (GetCGrafPtr_AC() != theWindowPort)
		::SetPort_AC(theWindowPort);

	::BeginUpdate(fWMgrWindow);
}

//----------------------------------------------------------------------------------------
// TWindow::EndUpdate:
//----------------------------------------------------------------------------------------

void TWindow::EndUpdate()
{
	fgUpdatingWindowPtr = NULL;

	::EndUpdate(fWMgrWindow);

}

//----------------------------------------------------------------------------------------
// TWindow::Update:
//----------------------------------------------------------------------------------------

void TWindow::Update()
{
#if !qMSWindows
	// if we are already in the process of updating, don't do anything.
	// The toolbox BeginUpdate is not reentrant!
	if (!fgUpdatingWindowPtr)
	{
		if (HasPendingUpdate())
		{
#if 1 // Experimental
			// •••  Moved to before BeginUpdate so we can notify subviews of the
			//	location change and they will have access to the real visRgn.

			// Fix up fLocation so that SuperViewToLocal can't fail when dynamically
			// changing screen resolution.
			Focus();
			CViewPoint windowLocation(LocalToGlobal(GetPortRect_AC(fWMgrWindow)[topLeft]));
			if (fLocation != windowLocation)
			{
#if qDebug
				ProgramBreak_AC("Window appears to have moved, captain, by a change to a smaller screen resolution.");
#endif
				// •••  Probably should call Locate or TView::SetFrame so that
				//	subviews are notified of the location change. Also, the
				//	window should have a chance to adapt to the screen.
				//	Isn't there an AppleEvent we can listen to for display changes?
				fLocation = windowLocation;
			}
#endif // Experimental end.

			try
			{
				InvalidateFocus();
				BeginUpdate();
				Focus();
#if qDebug
				if (gShowInvalidations && Focus())
				{
					::MacFillRect(GetQDExtent(), CPattern_AC(0, 7));	// we'll be clipped appropriately
					DelayFuture_AC(15);		// so you can see it
				}
#endif
				// Erase the updated region of the window so that the proper content
				// pattern/theme is drawn.
				Erase();

				// Draw the visible region of the window. BeginUpdate has temporarily
				// intersected it with the update region for us.
				HandleDraw(GetRegionBounds_AC(GetVisRegion()));
			}
			catch(CException_AC& theException)
			{
				DoCatchMessage_AC(theException);

				// Or we get into an infinite loop
				// trying to update the window when
				// displaying an alert
				EndUpdate();
				InvalidateFocus();

				throw;
			}

			EndUpdate();
#if qCarbon
			// Leave with the focus on the window, so Carbon can idle controls
			// behind our back.
			Focus();
#endif
			// Don't let any MacApp code think the window is focused.
			InvalidateFocus();
		}
	}
#else
	UpdateWindow(GetWindowsWindow());
#endif
}

//----------------------------------------------------------------------------------------
// TWindow::Erase
//----------------------------------------------------------------------------------------

void TWindow::Erase()
// Erase can be used to erase the entire window's extent.  It is typically used
// by Update to erase the update region of the window.  In this case, if the
// background color for the window is set to white then this will have the effect
// of erasing to the background theme of the window.
//
// Call?		As needed.  Erase is called at the appropriate time by
//				TWindow::Update.
// Override?	As necessary.  You may want to override this function in order to
//				avoid the erase in cases where you are drawing off-screen and
//				pushing the update to the window directly.
{
	// Erase the updated region of the window so that the proper background
	// theme is drawn.
	::EraseRect(GetQDExtent());
}

//----------------------------------------------------------------------------------------
// TWindow::GetStandardStateFrame:  Former nested routine, now a private method
//----------------------------------------------------------------------------------------

CViewRect TWindow::GetStandardStateFrame(const CViewRect& boundingRect) const
{
	CViewRect				stdFrame;			// The resulting frame.

	const ViewCoordinate	edgeInset(2);		// Inset from the edge.
	CViewRect				resizeLimits(GetDynamicResizeLimits());
	CViewPoint				contentDifference(fContentDifference);
	CViewPoint				contentRegionInset(fContentRegionInset);

	CViewPoint				frameAdjust;
	CViewRect				bounds(boundingRect);

	bounds.Inset(edgeInset, edgeInset);

	for (VHSelect vhs(vSel); vhs <= hSel; ++vhs)
		frameAdjust[vhs] = ::Min_AC(bounds.GetLength(vhs),
									resizeLimits[botRight][vhs] + contentDifference[vhs]);

	stdFrame[topLeft] = bounds[topLeft] + contentRegionInset
						+ (bounds.GetSize() - frameAdjust) / CViewPoint(edgeInset, edgeInset);
	stdFrame[botRight] = stdFrame[topLeft] - contentDifference + frameAdjust;

	return stdFrame;
}

//----------------------------------------------------------------------------------------
// TWindow::GetUserStateFrame:
//----------------------------------------------------------------------------------------

CViewRect TWindow::GetUserStateFrame(const CViewRect& boundingRect) const
{
	#pragma unused (boundingRect)
	CViewRect userFrame;

	if (GetWindowZoomFlag(fWMgrWindow))			// has zoom box
	{
		CRect_AC userQDState;
		GetWindowUserState(fWMgrWindow, &userQDState);
		userFrame = userQDState;
	}
#if qDebug
	else
		::ProgramBreak_AC("TWindow::GetUserStateFrame: Called for a non-zoomable window.");
#endif

	return userFrame;
}

//----------------------------------------------------------------------------------------
// TWindow::CountAsOpen:
//----------------------------------------------------------------------------------------

bool TWindow::CountAsOpen()
{
	// Override this if you prefer some other indicator of whether a window should
	// be considered as being open.
	return IsShown() && !fFloats;
}

//----------------------------------------------------------------------------------------
// TWindow::Zoom:
//----------------------------------------------------------------------------------------

void TWindow::Zoom(short partCode)
{
#if qMSWindows
	fZoomedOut = (partCode == inZoomOut);
#endif
	CRect_AC	aGDScreenRect;
	CViewRect	itsNewFrame;

	// Find out within which screen the window would like to be zoomed.
	GetMaxIntersectedDevice(aGDScreenRect);
	CViewRect	aGDScreenVRect(aGDScreenRect);

	// Grab either the standard or user state frame.
	if (partCode == inZoomOut)
		itsNewFrame = GetStandardStateFrame(aGDScreenVRect);
	else
		itsNewFrame = GetUserStateFrame(aGDScreenVRect);

	if (Focus())	// The ROM requires that thePort be the window being zoomed.
	{
		// If the window both moves and resizes then call the ZoomWindow trap
		// to get the right visual effect.  If it only moves OR resizes then just
		// call SetFrame since more bits may be preserved.
		if (itsNewFrame[topLeft] != fLocation && itsNewFrame.GetSize() != fSize)
		{
			::EraseRect(GetQDExtent());

			// Make sure the window is zoomable.
			if (GetWindowZoomFlag(fWMgrWindow))
			{
#if qPowerPC
				if (HasWindowManager85_AC())
				{
					CPoint_AC tmpSize(itsNewFrame.GetSize().ToPoint());		// Result discarded.
					::ZoomWindowIdeal(fWMgrWindow, partCode, &tmpSize);
					// At this point, ZoomWindowIdeal has positioned the window to where it thinks
					// it is best situated.  We'll grab the window's bounds and use them for
					// the subsequent SetFrame.
					itsNewFrame = LocalToGlobal(GetPortRect_AC(fWMgrWindow));
				}
				else
#endif
					::ZoomWindow(fWMgrWindow, partCode, false);
			}
		}

		// Set the standard or user state frame now that it's been adjusted.
		if (GetWindowZoomFlag(fWMgrWindow))		// has zoom box
		{
			if (partCode == inZoomOut)
				SetWindowStandardState(fWMgrWindow, itsNewFrame.ToRect());
			else
				SetWindowUserState(fWMgrWindow, itsNewFrame.ToRect());
		}

		// Let the View know what we've done
		SetFrame(itsNewFrame, kInvalidate);
	}
}

//----------------------------------------------------------------------------------------
// TWindow::ZoomByUser:
//----------------------------------------------------------------------------------------

void TWindow::ZoomByUser(const CViewPoint& theMouse,
						 short partCode)
{
#if qMSWindows
	#pragma unused (theMouse, partCode)
	#pragma message ("TWindow::ZoomByUser: Needs implementation.")
#else
	if (TrackBox(fWMgrWindow, LocalToSuperView(theMouse).ToPoint(), partCode))
	{
		Zoom(partCode);

#if qAppleEventAware
		if (TOSADispatcher::fgDispatcher->GetDefaultTarget()->IsRecordingOn())
		{
			TSetPropertyEvent theEvent(gServerAddress, kAENoReply + kAEDontExecute, this, pIsZoomed);
			theEvent.WriteBoolean(keyAEData, (partCode == inZoomOut));
			CAutoPtr_AC<TAppleEvent> theReply(theEvent.Send());
		}
#endif
	}
#endif
}

//----------------------------------------------------------------------------------------
// TWindow::GetDynamicMoveBounds:
//----------------------------------------------------------------------------------------

CRect_AC TWindow::GetDynamicMoveBounds() const
{
	//
	// Any value is made dynamic by leaving it at zero. Any non-zero values
	// are honored.
	//
	CRect_AC moveBounds(fMoveBounds);

	//CRect_AC grayBox((*GetGrayRgn())->rgnBBox);
	CRect_AC grayBox(GetRegionBounds_AC(GetGrayRgn()));	// Carbonized
	grayBox.Inset(4, 4);

	if (!fMoveBounds.top)						// dynamic
		moveBounds.top = grayBox.top;

	if (!fMoveBounds.left)						// dynamic
		moveBounds.left = grayBox.left;

	if (!fMoveBounds.bottom)					// dynamic
		moveBounds.bottom = grayBox.bottom;

	if (!fMoveBounds.right)						// dynamic
		moveBounds.right = grayBox.right;

	return moveBounds;
}

//----------------------------------------------------------------------------------------
// TWindow::GetDynamicResizeLimits:
//----------------------------------------------------------------------------------------

CRect_AC TWindow::GetDynamicResizeLimits() const
{
	//
	// Any value in fResizeLimits is made dynamic by leaving it at zero. Any
	// non-zero values are honored.
	//
	CRect_AC resizeLimits = fResizeLimits;

	// maximum size vertically
	static const short kHalfTitleBar = 8;
	//CPoint_AC grayRgnBBoxSize(CRect_AC((*GetGrayRgn())->rgnBBox).GetSize());
	CPoint_AC grayRgnBBoxSize(GetRegionBounds_AC(GetGrayRgn()).GetSize());	// Carbonized

	if (!fResizeLimits.bottom)					// dynamic
		resizeLimits.bottom = grayRgnBBoxSize.v - kHalfTitleBar;

	// maximum size horizontally
	if (!fResizeLimits.right)					// dynamic
		resizeLimits.right = grayRgnBBoxSize.h;

	//
	// Ideally the window's settings should come from the window template and
	// the default settings should come from a resource (with a constant for a
	// backstop if the resource is not present). However, the template format
	// is not changing (for MA 3.3) and I'd have to check with the MacApp team
	// about defining a resource for the default.
	//
	// I am able to fix one persistent problem here, though. User interface
	// elements have been shrinking over the past several years and very small
	// status windows have become more common. MacApp has supplied a default
	// minimum resize limit of 80, 80 pixels in previous releases. This is too
	// large for these small windows and yet is still close to reasonable. I
	// propose to reduce the constant minimum to a slightly smaller value than
	// before (approximately two scroll arrows plus a thumb plus a resize icon)
	// as well as modifying the calculation of the default value to accept the
	// current size of the window as the minimum if it is smaller than the
	// constant values.
	//
	static const short kMinWindowWidth = kStdSzSBar * 4;
	static const short kMinWindowHeight = kStdSzSBar * 4;

	// minimum size vertically
	if (!fResizeLimits.top)						// dynamic
	{
		resizeLimits.top = Min_AC(kMinWindowHeight, resizeLimits.bottom);
		// capture the minimum if it will be smaller than the default
		if (fSize.v < resizeLimits.top)
			resizeLimits.top = const_cast<TWindow*>(this)->fResizeLimits.top = fSize.v;
	}

	// minimum size horizontally
	if (!fResizeLimits.left)					// dynamic
	{
		resizeLimits.left = Min_AC(kMinWindowWidth, resizeLimits.right);
		// capture the minimum if it will be smaller than the default
		if (fSize.h < resizeLimits.left)
			resizeLimits.left = const_cast<TWindow*>(this)->fResizeLimits.left = fSize.h;
	}

	return resizeLimits;
}

//----------------------------------------------------------------------------------------
// Undo Support
//----------------------------------------------------------------------------------------

//----------------------------------------------------------------------------------------
// TWindow::GetUndoHandler:
//----------------------------------------------------------------------------------------

TUndoHandler* TWindow::GetUndoHandler()
{
	TUndoHandler* undoHandler = TEventHandler::GetUndoHandler();

	if (!undoHandler)
	{
		if (fDocument)
		{
			undoHandler = fDocument->GetUndoHandler();
		}
		else
		{
			undoHandler = TH_new TUndoHandler();
			AddBehavior(undoHandler);
		}
	}

	return undoHandler;
}

//----------------------------------------------------------------------------------------
// TWindow::GetCommandContext
//----------------------------------------------------------------------------------------

TEventHandler* TWindow::GetCommandContext(const CommandNumber aCommandNumber)
{
	return fDocument ? fDocument :
#if qAppleEventAware
					   MScriptableObject::GetCommandContext(aCommandNumber);
#else
					   dynamic_cast_AC(TEventHandler*, this);
#endif
}

#if qAppleEventAware

//----------------------------------------------------------------------------------------
// TWindow::GetSpecifierForm:
//----------------------------------------------------------------------------------------

DescType TWindow::GetSpecifierForm()
{
	return (!GetTitle().empty()) ? formName : MScriptableObject::GetSpecifierForm();
}

//----------------------------------------------------------------------------------------
// TWindow::CountContainedObjects:
//----------------------------------------------------------------------------------------

long TWindow::CountContainedObjects(DescType desiredType)
{
	long result = 0;

	if (IsShown() && !fFloats)					// don't support floaters and invisible windows
	{
		if (gDispatcher->IsDocumentClass(desiredType))
			result = 1;
		else if (fDocument)
			result = fDocument->CountContainedObjects(desiredType);
	}
	else

		if (!result)
			result = MScriptableObject::CountContainedObjects(desiredType);

	return result;
}

//----------------------------------------------------------------------------------------
// TWindow::GetContainedObject:
//----------------------------------------------------------------------------------------

MScriptableObject* TWindow::GetContainedObject(DescType desiredType,
											   DescType selectionForm,
											   const CAEDesc_AC& selectionData)
{
	MScriptableObject * result = NULL;
	if (IsShown() && !fFloats)
	{
		if (gDispatcher->IsDocumentClass(desiredType))
			result = fDocument;
		else if (fDocument && (desiredType != cProperty) && (desiredType != GetOMClass()))
			result = fDocument->GetContainedObject(desiredType, selectionForm, selectionData);
	}

	if (!result)
		result = MScriptableObject::GetContainedObject(desiredType, selectionForm, selectionData);

	return result;
}

//----------------------------------------------------------------------------------------
// TWindow::GetObjectProperty:
//----------------------------------------------------------------------------------------

bool TWindow::GetObjectProperty(CAEDesc_AC& thePropertyValue,
								   DescType whichProperty,
								   const CAEDesc_AC& desiredType)
{
	bool hasProperty = true;

	try
	{
		switch (whichProperty)
		{
			case pClass:
				thePropertyValue.PutType(GetOMClass());
				break;

			case pBounds:
				thePropertyValue.PutRect(ViewToQD(GetFrame()));
				break;

			case pName:
				thePropertyValue.PutString(GetTitle());
				break;

			case pHasCloseBox:
				thePropertyValue.PutBoolean(fIsClosable);
				break;

			case pHasTitleBar:
				thePropertyValue.PutBoolean(fContentDifference != gZeroPt);
				break;

			case pIndex:
				{
					long index = 0;
					hasProperty = false;

					for (CWMgrIterator iter; iter; ++iter)
					{
						TWindow* aWindow = WMgrToWindow(iter);
						// count its index either as a floater or non-floater
						if (aWindow && aWindow->IsShown() && (fFloats == aWindow->fFloats))
						{
							++index;
							if (aWindow == this)
							{
								thePropertyValue.PutLong(index);
								hasProperty = true;
								break;
							}
						}
					}
					break;
				}

			case pIsModal:
				thePropertyValue.PutBoolean(IsModal());
				break;

			case pIsResizable:
				thePropertyValue.PutBoolean(fIsResizable);
				break;

			case pIsZoomable:
				thePropertyValue.PutBoolean((fProcID) & zoomDocProc);
				break;

			case pIsZoomed:
				{
					CRect_AC aGDScreenRect;
					GetMaxIntersectedDevice(aGDScreenRect);
					CViewRect aGDScreenVRect(aGDScreenRect);
					CViewRect zoomFrame(GetUserStateFrame(aGDScreenVRect));
					thePropertyValue.PutBoolean((GetFrame() != zoomFrame));
					break;
				}

			case pSelection:
				{
					TDocument * theDoc = fDocument;
					if (theDoc)
					{
						TDesignator * theUserSelection = theDoc->GetUserSelection();
						if (theUserSelection)
						{
							CTempDesc_AC propData;
							theUserSelection->MakeObjectSpecifier(propData, theUserSelection->GetSpecifierForm());
							thePropertyValue = propData;
						}
						else
							::ThrowIfOSErr_AC(errAENoSuchObject);
					}
					break;
				}

			default:
				{
					// Users will frequently refer to the window when they mean the document. If this window
					// has a document we'll give it a crack at supplying the property.
					if (fDocument)
						hasProperty = fDocument->GetObjectProperty(thePropertyValue, whichProperty, desiredType);
					else
						hasProperty = MScriptableObject::GetObjectProperty(thePropertyValue, whichProperty, desiredType);
				}
				break;
		}
	}
	catch(CException_AC& theException)
	{
		DoCatchMessage_AC(theException);
		hasProperty = false;
	}

	return hasProperty;
}

//----------------------------------------------------------------------------------------
// TWindow::GetSetPropertyInfo:
//----------------------------------------------------------------------------------------

void TWindow::GetSetPropertyInfo(DescType			whichProperty,
								 CommandNumber&		cmdNum,
								 bool&				canUndo,
								 bool&				causesChange,
								 TEventHandler*&	theContext)
{
	MScriptableObject::GetSetPropertyInfo(whichProperty, cmdNum, canUndo, causesChange, theContext);

	if (whichProperty == pBounds || whichProperty == pIsZoomed || whichProperty == pName)
	{
		canUndo = false;
		causesChange = false;
	}
}

//----------------------------------------------------------------------------------------
// TWindow::SetObjectProperty:
//----------------------------------------------------------------------------------------

void TWindow::SetObjectProperty(const CAEDesc_AC& thePropertyValue, DescType whichProperty)
{
	switch (whichProperty)
	{
		case pBounds:
			{
				CRect_AC theWindowRect = thePropertyValue.GetRect();
				SetFrame(CViewRect(theWindowRect), true);
			}
			break;

		case pName:
			{
				CStr255_AC theWindowName = thePropertyValue.GetString();
				SetTitle(theWindowName);
			}
			break;

		case pIsZoomed:
			{
				CRect_AC aGDScreenRect;
				GetMaxIntersectedDevice(aGDScreenRect);
				CViewRect aGDScreenVRect(aGDScreenRect);
				CViewRect zoomFrame(GetUserStateFrame(aGDScreenVRect));
				bool isZoomed = (GetFrame() != zoomFrame);
				bool shouldZoom = thePropertyValue.GetBoolean();
				short partCode = 0;
				if (shouldZoom && !isZoomed)
					partCode = inZoomOut;
				else if (!shouldZoom && isZoomed)
					partCode = inZoomIn;
				if (partCode)
					Zoom(partCode);
				break;
			}

		case pHasCloseBox:
		case pHasTitleBar:
		case pIsModal:
		case pIsResizable:
		case pIsZoomable:
			::ThrowIfOSErr_AC(errAECantSetReadOnly);
			break;

		default:
			// Users will frequently refer to the window when they mean the document. If this window
			// has a document we'll give it a crack at setting the property.
			if (fDocument)
				fDocument->SetObjectProperty(thePropertyValue, whichProperty);
			else
				MScriptableObject::SetObjectProperty(thePropertyValue, whichProperty);
			break;
	}
}

#if qAttachable

//----------------------------------------------------------------------------------------
// TWindow::HandleOSAEvent:
//----------------------------------------------------------------------------------------

bool TWindow::HandleOSAEvent(CommandNumber aCommandNumber, TAppleEvent* message, TAppleEvent* reply)
{
	// Overridden to also give the document's script a shot at the event
	return MScriptableObject::HandleOSAEvent(aCommandNumber, message, reply) || (fDocument && fDocument->HandleOSAEvent(aCommandNumber, message, reply));
}

#endif // qAttachable

//----------------------------------------------------------------------------------------
// TWindow::DoAEMove:
//----------------------------------------------------------------------------------------

void TWindow::DoAEMove(TAppleEvent* message, TAppleEvent* reply)
{
	CTempDesc_AC theInsertionLoc, windowObj;
	CAEDesc_AC insertionRec;
	DescType theType, position;
	Size paramSize;
	message->ReadParameter(keyAEInsertHere, typeInsertionLoc, theInsertionLoc);
	::ThrowIfOSErr_AC(AECoerceDesc(theInsertionLoc, typeAERecord, insertionRec));
	insertionRec.GetKeyDesc(keyAEObject, typeWildCard, windowObj);
	::ThrowIfOSErr_AC(AEGetKeyPtr(insertionRec, keyAEPosition, typeEnumeration, &theType, &position, sizeof(DescType), &paramSize));

	if (position == kAEBeginning)
		Select();								// don't support the other keys yet

	::ThrowIfOSErr_AC(AEDisposeDesc(insertionRec));

	// Return an object specifier for the window
	CTempDesc_AC theWindowSpec;
	MakeObjectSpecifier(theWindowSpec, formName);
	reply->WriteParameter(keyAEResult, theWindowSpec);
}

//----------------------------------------------------------------------------------------
// TWindow::DoAEClose:
//----------------------------------------------------------------------------------------

void TWindow::DoAEClose(TAppleEvent* message, TAppleEvent* reply)
{
	// First see if a document is to be closed.
	if (fDocument && fClosesDocument)
	// Closing the document will close any associated windows.
		fDocument->DoAEClose(message, reply);
	else
		// Close the window if it wasn't attached to a document.
		DoClose(cClose, false);
}

//----------------------------------------------------------------------------------------
// TWindow::DoAEPrint
//----------------------------------------------------------------------------------------

void TWindow::DoAEPrint(TAppleEvent* message, TAppleEvent* reply)
{
	bool wasHandled = false;

	if (fScriptingPrintHandler)
		wasHandled = fScriptingPrintHandler->DoScriptCommand(cPrint, message, reply);

	if (!wasHandled)
	{
		if (fDocument)
			fDocument->HandleScriptCommand(cPrint, message, reply);
		else
			MScriptableObject::DoAEPrint(message, reply);
	}
}

//----------------------------------------------------------------------------------------
// TWindow::DoScriptCommand
//----------------------------------------------------------------------------------------

void TWindow::DoScriptCommand(CommandNumber aCommandNumber, TAppleEvent* message, TAppleEvent* reply)
{
	switch (aCommandNumber)
	{
		case cAEDelete:
			DoAEClose(message, reply);
			break;

		case cAEOpen:
		case cAESave:
		case cAECountElements:
		case cAECreateElement:
		case cAEDoObjectsExist:
			if (fDocument)
			{
				fDocument->HandleScriptCommand(aCommandNumber, message, reply);
				break;
			}
		// no break - drop thru!

		default:
			MScriptableObject::DoScriptCommand(aCommandNumber, message, reply);
			break;
	}
}

//----------------------------------------------------------------------------------------
// TWindow::SetScriptingPrintHandler
//----------------------------------------------------------------------------------------

void TWindow::SetScriptingPrintHandler(TPrintHandler* printHandler)
{
	fScriptingPrintHandler = printHandler;
}

//----------------------------------------------------------------------------------------
// TWindow::ReleaseScriptingPrintHandler
//----------------------------------------------------------------------------------------

void TWindow::ReleaseScriptingPrintHandler(TPrintHandler* printHandler)
{
	if (fScriptingPrintHandler == printHandler)
		fScriptingPrintHandler = NULL;
}

#endif	// #if qAppleEventAware

#if qDrag

//----------------------------------------------------------------------------------------
// Drag Support
//----------------------------------------------------------------------------------------

//----------------------------------------------------------------------------------------
// TWindow::RegisterDroppableView
//----------------------------------------------------------------------------------------

void TWindow::RegisterDroppableView(TView* theView)
{
	if (HasDragManager_AC())
	{
		ArrayIndex_AC index = fDroppableViewList.GetIdentityItemNo(theView);
		if (index == kEmptyIndex_AC)
		{
			// Insert the view into the list if it's not already there.
			fDroppableViewList.InsertElementInOrder(&theView);	// Add the view to the list

			// Register this window with the global drag session if appropriate
			// We can't register until after we have a toolbox window
			if ((fDragCallbackStatus != eInstalled) && (fWMgrWindow != NULL))
			{
				TDragDropSession::fgDragDropSession->RegisterDroppableWindow(this, fWMgrWindow);
				fDragCallbackStatus = eInstalled;
			}
		}
#if qDebug
		else
			::ProgramBreak_AC("TWindow::RegisterDroppableView: A droppable view tried to register itself twice.");
#endif
	}
#if qDebug
	else
		::ProgramBreak_AC("TWindow::RegisterDroppableView: A droppable view tried to register but the Drag Manager isn't present.");
#endif
}

//----------------------------------------------------------------------------------------
// TWindow::RegisterIfDroppableView
//----------------------------------------------------------------------------------------

void TWindow::RegisterIfDroppableView(TView* theView)
{
	if (HasDragManager_AC())
	{
		// If the view being removed is droppable then we need to register it.
		if (theView->GetDroppable())
			RegisterDroppableView(theView);

		// Now we have to check to see if any of our subviews are droppable.
		for (CSubViewIterator iter(theView); iter; ++iter)
			RegisterIfDroppableView(iter);
	}
}

//----------------------------------------------------------------------------------------
// TWindow::UnregisterDroppableView
//----------------------------------------------------------------------------------------

void TWindow::UnregisterDroppableView(TView* theView)
{
#if qDebug
	if (!HasDragManager_AC())						// should never get called if the Drag Mgr isn't present
	{
		::ProgramBreak_AC("###A drag/drop view unregistered but the Drag Manager is not present.");
		return;
	}
#endif

	fDroppableViewList.Delete(theView);

	// if the behavior count went to zero, unregister the window callbacks
	if (fDroppableViewList.IsEmpty())
	{
		TDragDropSession::fgDragDropSession->UnregisterDroppableWindow(fWMgrWindow);
		fDragCallbackStatus = eNotInstalled;
	}
}

//----------------------------------------------------------------------------------------
// TWindow::UnregisterIfDroppableView
//----------------------------------------------------------------------------------------

void TWindow::UnregisterIfDroppableView(TView* theView)
{
	if (HasDragManager_AC())
	{
		// If the view being removed is droppable then we need to unregister it.
		if (theView->GetDroppable())
			UnregisterDroppableView(theView);

		// Now we have to check to see if any of our subviews are droppable.
		for (CSubViewIterator iter(theView); iter; ++iter)
			UnregisterIfDroppableView(iter);
	}
}

//----------------------------------------------------------------------------------------
// TWindow::MouseToDropTarget
//----------------------------------------------------------------------------------------

TView* TWindow::MouseToDropTarget(CDragItemIterator& dragItemIterator,
								  const CPoint_AC& globalMouse,
								  CViewPoint& localMouse)
{
	TView * targetView = NULL;
	TView * aView = NULL;
	CViewPoint aPoint;
	ArrayIndex_AC maxIndex = fDropStatusCache.GetSize();
	short oldStatus,
	newStatus;

	CViewPoint pointInWindow = SuperViewToLocal(globalMouse);

	// Loop through the status list. The status list is a cache of values that
	// indicate whether or not a specific view can accept the drag.
	for (ArrayIndex_AC index = 1; index <= maxIndex; ++index)
	{
		fDropStatusCache.GetElementsAt(index, &oldStatus, 1);
		if (oldStatus != kCantReceiveDrop)
		{
			newStatus = oldStatus;
			fDroppableViewList.GetElementsAt(index, &aView, 1);
			if (newStatus == kDropStatusUnknown)
			{
				if (!aView->GetDroppable() || !aView->IsShown() || !aView->IsEnabled())
					newStatus = kCantReceiveDrop;
			}

			if (newStatus != kCantReceiveDrop)
			{
				aPoint = aView->RootViewToLocal(pointInWindow);
				if (aView->GetVisibleExtent().Contains(aPoint))
				{
					if (newStatus == kDropStatusUnknown)
						newStatus = aView->WillAcceptDrop(dragItemIterator) ? kCanReceiveDrop : kCantReceiveDrop;

					if ((newStatus == kCanReceiveDrop) && (!targetView || targetView->ContainsSubView(aView)))// we've got a winner!!
					{
						targetView = aView;
						localMouse = aPoint;
					}
				}

			}
			if (oldStatus != newStatus)
				fDropStatusCache.ReplaceElementsAt(index, &newStatus, 1);// cache the new status
		}
	}

	return targetView;
}

//----------------------------------------------------------------------------------------
// TWindow::DragEnteredWindow
//----------------------------------------------------------------------------------------

void TWindow::DragEnteredWindow(CDragItemIterator& dragItemIterator)
{
	#pragma unused (dragItemIterator)

	short viewStatus = kDropStatusUnknown;
	ArrayIndex_AC viewListSize = fDroppableViewList.GetSize();

	fDropStatusCache.SetArraySize(viewListSize);

	// initialize the status list with kDropStatusUnknown
	for (ArrayIndex_AC i = 0; i < viewListSize; ++i)
		fDropStatusCache.InsertElementsBefore(i + 1, &viewStatus, 1);
}

//----------------------------------------------------------------------------------------
// TWindow::DragLeftWindow
//----------------------------------------------------------------------------------------

void TWindow::DragLeftWindow()
{
	fDropStatusCache.DeleteAll();
}

#endif // qDrag

#if 0
//----------------------------------------------------------------------------------------
// GetAndLoadWDefProc:
//----------------------------------------------------------------------------------------

Handle TWindow::GetAndLoadWDefProc(Handle windowDefProc)
{
	Handle returnVal = NULL;
	Handle wDefProc = (Handle)(StripLong(windowDefProc));  // strip the variant code

	if ((*wDefProc))							// if Master Ptr is NULL => resource is purged
		returnVal = wDefProc;
	else
	{
		::LoadResource_AC(wDefProc);
		if (ResError() == noErr)				// only return it if the LoadResource worked
			returnVal = wDefProc;
	}

	return returnVal;
}
#endif

//----------------------------------------------------------------------------------------
// HighlightAndActivateWindow: Common code for ActivateWindow and DeactivateWindow.  Does
// actual highlighting and calling of the activate handler.
//----------------------------------------------------------------------------------------

void TWindow::HighlightAndActivateWindow(WindowRef theWindow,  bool activate)
{
	if (theWindow)
	{
#if qMSWindows
		#pragma message ("TWindow::HighlightAndActivateWindow: Any additional work needed here?")
#else
		if ((activate && !IsWindowHilited(theWindow)) || (!activate && IsWindowHilited(theWindow)))
			::HiliteWindow(theWindow, activate);	// make the window "look" right
#endif

		TWindow* theMAWindow = WMgrToWindow(theWindow);
		if (theMAWindow)
			theMAWindow->SetActiveState(activate, kRedraw); //theMAWindow->Activate(activate);
	}
}

//----------------------------------------------------------------------------------------
// IsGhostWindow:
//----------------------------------------------------------------------------------------

bool TWindow::IsGhostWindow(const WindowRef window)
{
#if qCarbon
	#pragma unused (window)
	//#pragma message ("TWindow::IsGhostWindow: No Carbon equivalent for LMGetGhostWindow.")
	return false;
#elif !qMSWindows
	return window ? window == (WindowRef)LMGetGhostWindow() : false;
#else
	return false;
#endif
}

//----------------------------------------------------------------------------------------
// WMgrToWindow:
//----------------------------------------------------------------------------------------

TWindow* TWindow::WMgrToWindow(const WindowRef aWindowPtr)
{
	ArrayIndex_AC item = 0;
	if (aWindowPtr)
		item = fgWindows.GetEqualItemNo(CWindowAndWindowRef(NULL, aWindowPtr));

	return item ? fgWindows.At(item).fTWindow : NULL;
}

//----------------------------------------------------------------------------------------
// DeleteWindow:
//----------------------------------------------------------------------------------------

void TWindow::DeleteWindow(TWindow* aWindow)
{
	if (aWindow)
		fgWindows.Delete(aWindow->GetWindowRef());
}

//----------------------------------------------------------------------------------------
// RegisterWindow:
//----------------------------------------------------------------------------------------

void TWindow::RegisterWindow(TWindow* aWindow)
{
	fgWindows.Insert(CWindowAndWindowRef(aWindow, aWindow->GetWindowRef()));
}

//----------------------------------------------------------------------------------------
// IsDocumentWindow:
//----------------------------------------------------------------------------------------

bool TWindow::IsDocumentWindow(const WindowRef aWindow)
// If a window is not a floater window, and is not a system window, and is not the special
// THINK environment window, then it is a document window.
{
	const short kTHINKWindowKind = 32700;
	short itsWindowKind = GetWindowKind(aWindow);

	return !IsFloatWindow(aWindow) && !IsSystemWindow(aWindow) && itsWindowKind < kTHINKWindowKind;
}

//----------------------------------------------------------------------------------------
// IsDialog:
//----------------------------------------------------------------------------------------

bool TWindow::IsDialog(const WindowRef window)
{
	bool returnVal = false;

	if (window)
	{
		short windowVariant = CWindow_AC(window).GetVariant();
		returnVal = windowVariant == dBoxProc || windowVariant == plainDBox || windowVariant == altDBoxProc || windowVariant == movableDBoxProc;
	}

	return returnVal;
}

//----------------------------------------------------------------------------------------
// IsFloatWindow:
//----------------------------------------------------------------------------------------

bool TWindow::IsFloatWindow(const WindowRef window)
{
	bool returnVal = false;

	if (window)
	{
		TWindow* aMAWindow = WMgrToWindow(window);
		if (aMAWindow)
			returnVal = aMAWindow->fFloats;
		else
		{
#if qPowerPC
			if (HasWindowManager85_AC())
			{
				WindowClass		theWindowClass;
				ThrowIfBadOSStatus_AC(::GetWindowClass(window, &theWindowClass));
				returnVal = (theWindowClass == kFloatingWindowClass);
			}
			else
#endif
				returnVal = GetWindowKind(window) == kFloatingWindowKind;
		}
	}

	return returnVal;
}

//----------------------------------------------------------------------------------------
// IsSinkWindow:
//----------------------------------------------------------------------------------------

bool TWindow::IsSinkWindow(const WindowRef window)
{
	bool returnVal = false;

	if (window)
	{
		TWindow* aMAWindow = WMgrToWindow(window);
		if (aMAWindow)
			returnVal = aMAWindow->fFloats && aMAWindow->fSinks;
	}

	return returnVal;
}

//----------------------------------------------------------------------------------------
// IsVisibleFloatWindow:
//----------------------------------------------------------------------------------------

bool TWindow::IsVisibleFloatWindow(const WindowRef window)
{
	// A note on IsVisibleFloatWindow:
	// We only consider a window to be a floating window if it is visible.
	// The motivation around the check for visibility is that, given the Toolbox
	// Window Manager's tendency to move visible windows to the head of WindowList,
	// there is no clean way for us to guarantee that hidden floaters will stay in
	// our floating window "layer".  Instead, the approach we take is to allow
	// hidden floaters to be moved wherever in the window list, and we ensure that
	// they move back to the floating window layer when they are shown.  The check
	// for visibility ensures that functions that depend on the first or last
	// floating window (such as TWindow::GetBehindWindowPtr) perform as expected.
	bool returnVal = false;

	if (window && IsWindowVisible_AC(window))
	{
		returnVal = IsFloatWindow(window) && !IsSinkWindow(window);
	}

	return returnVal;
}

//----------------------------------------------------------------------------------------
// IsSystemWindow:
//----------------------------------------------------------------------------------------

bool TWindow::IsSystemWindow(const WindowRef window)
{
	bool returnVal = false;

	if (window)
	{
#if qCarbon
		//#pragma message ("TWindow::IsSystemWindow: Can't get windowDefProc in Carbon.")
		short windowKind = GetWindowKind(window);
		returnVal = (windowKind < 0);	// •••  is this legit in Carbon?
#else
		short		theID;
		ResType		theType;
		CStr255_AC	theName;

		::GetResInfo(((WindowPeek)window)->windowDefProc, &theID, &theType, theName);
		short windowKind = GetWindowKind(window);
		const short kWorldScriptWDEF = 125;
		returnVal = (windowKind < 0) || (theID == kWorldScriptWDEF) || (theID == kBalloonWDEFID);
#endif
	}

	return returnVal;
}

//----------------------------------------------------------------------------------------
// IsModalWindow:
//----------------------------------------------------------------------------------------

bool TWindow::IsModalWindow(const WindowRef window)
{
	bool result = false;

	if (window)
	{
		TWindow* aMAWindow = WMgrToWindow(window);
		if (aMAWindow)
			result = aMAWindow->IsModal();
		else
		{
#if qPowerPC
			if (HasWindowManager85_AC())
			{
				WindowClass		theWindowClass;
				ThrowIfBadOSStatus_AC(::GetWindowClass(window, &theWindowClass));
				result = (theWindowClass >= kAlertWindowClass
							 && theWindowClass <= kMovableModalWindowClass);
			}
			else
#endif
			{
				// according to IM 4-9 (new version), these are
				// the possible window variants for modal dialogs:
				short windowVariant = CWindow_AC(window).GetVariant();
				result = windowVariant == dBoxProc || windowVariant == plainDBox || windowVariant == altDBoxProc || windowVariant == movableDBoxProc;
			}
		}
	}

	return result;
}

//----------------------------------------------------------------------------------------
// GetLastFloatingWindowPtr:
//----------------------------------------------------------------------------------------
// returns the last floating window in the window list

WindowRef TWindow::GetLastFloatingWindowPtr()
{
	WindowRef lastFloatWindowPtr = NULL;

	for (CWMgrIterator iter; iter; ++iter)
	{
		if (IsVisibleFloatWindow(iter))
			lastFloatWindowPtr = iter;
	}

	return lastFloatWindowPtr;
}

//----------------------------------------------------------------------------------------
// GetFirstFloatingWindowPtr:
//----------------------------------------------------------------------------------------
// returns the first floating window in the window list

WindowRef TWindow::GetFirstFloatingWindowPtr()
{
	WindowRef firstFloatWindowPtr = NULL;

	for (CWMgrIterator iter; iter; ++iter)
	{
		if (IsVisibleFloatWindow(iter))
		{
			firstFloatWindowPtr = iter;
			break;
		}
	}

	return firstFloatWindowPtr;
}

//----------------------------------------------------------------------------------------
// GetLastDocumentWindowPtr:
//----------------------------------------------------------------------------------------

WindowRef TWindow::GetLastDocumentWindowPtr()
{
	WindowRef lastDocumentWindowPtr = NULL;

	for (CWMgrIterator iter; iter; ++iter)
	{
		if (IsDocumentWindow(iter))
			lastDocumentWindowPtr = iter;
	}

	return lastDocumentWindowPtr;
}

//----------------------------------------------------------------------------------------
// ActivateWindow: Activates the window by highlighting it, and calling its
// activate handler.
//----------------------------------------------------------------------------------------

void TWindow::MAActivateWindow(WindowRef theWindow)
{
	HighlightAndActivateWindow(theWindow, kActivateWindow);
}

//----------------------------------------------------------------------------------------
// DeactivateWindow: Deactivates the window by unhighlighting it and calling its
// activate handler.
//----------------------------------------------------------------------------------------

void TWindow::MADeactivateWindow(WindowRef theWindow)
{
	HighlightAndActivateWindow(theWindow, kDeactivateWindow);
}

//----------------------------------------------------------------------------------------
// MADragWindow: Our replacement for DrawWindow to handle floating windows…
//----------------------------------------------------------------------------------------

void TWindow::MADragWindow(WindowRef		windowToDrag,
						   CPoint_AC		startPoint,
						   const CRect_AC&	draggingBounds)
{
#if qCarbon
	//#pragma message ("TWindow::MADragWindow: Just DragWindow. (Window Mgr port not in Carbon.)")
	::DragWindow(windowToDrag, startPoint, draggingBounds);
#elif qMSWindows
	#pragma unused (windowToDrag, startPoint, draggingBounds)
	#pragma message ("TWindow::MADragWindow: Just DragWindow. (DragWindow not in Windows.)")
#else
	CRect_AC dragRect;
	GrafPtr savePort;
	GrafPtr windowManagerPort;
	long dragResult;
	short topLimit;
	short newHorizontalWindowPosition;
	short newVerticalWindowPosition;
	short horizontalOffset;
	short verticalOffset;
	bool commandKeyDown = false;

	if (::WaitMouseUp())
	{
		// Adjust the top of the dragging rectangle so that it’s below the menu bar
		topLimit = ::GetMBarHeight() + 4;
		dragRect = draggingBounds;
		if (dragRect.top < topLimit)
			dragRect.top = topLimit;

		// Set up the Window Manager port.
		::GetPort(&savePort);
		::GetWMgrPort(&windowManagerPort);
		::SetPort_AC(windowManagerPort);
		::SetClip(GetGrayRgn());

		commandKeyDown = IsCommandKeyDown();

		if (commandKeyDown || !(IsFloatWindow(windowToDrag) || IsModalWindow(windowToDrag)))
		{
			if (!commandKeyDown)
			{
				// If there are floating windows, clip the dragging outline to draw
				// behind the floaters.
				::ClipAbove(MAFrontWindow());
			}
			else
			{
				// If the command key was down, clip the outline to draw behind any
				// windows above the window being dragged.
				::ClipAbove(windowToDrag);
			}
		}

		// Create a region to drag
		CTempRegion_AC dragRegion;

		::GetWindowStructureRgn(windowToDrag, dragRegion);

		// Drag the window around
		dragResult = ::DragGrayRgn(dragRegion, startPoint, &dragRect, &dragRect, noConstraint, NULL);

		// Restore the port for coordinate conversion.
		::SetPort_AC(savePort);

		if (dragResult)
		{
			horizontalOffset = static_cast<short>(dragResult & 0xFFFF);
			verticalOffset = static_cast<short>(dragResult >> 16);

			// Only move it if it stayed inside the dragging box.
			if (verticalOffset != -32768)
			{
				CTempRegion_AC contRgn;
				GetWindowContentRgn(windowToDrag, contRgn);

				newHorizontalWindowPosition = (*contRgn)->rgnBBox.left + horizontalOffset;
				newVerticalWindowPosition = (*contRgn)->rgnBBox.top + verticalOffset;

				::MoveWindow_AC(windowToDrag, newHorizontalWindowPosition, newVerticalWindowPosition, false);
			}
		}

		// Bring the window forward if the command key wasn’t down
		if (!commandKeyDown)
			MASelectToolboxWindow(windowToDrag);// 3.5
	}
#endif	// non-Carbon code
}

//----------------------------------------------------------------------------------------
// MASelectToolboxWindow:
//----------------------------------------------------------------------------------------

void TWindow::MASelectToolboxWindow(WindowRef windowToSelect)
{
	WindowRef currentFrontWindow = NULL;
	WindowRef lastFloatingWindow = NULL;
	bool isFloatingWindow = IsFloatWindow(windowToSelect);

	if (isFloatingWindow)
	{
		currentFrontWindow = GetFirstFloatingWindowPtr();
	}
	else
	{
		currentFrontWindow = MAFrontWindow();
		lastFloatingWindow = GetLastFloatingWindowPtr();
	}

	// Be fast (and lazy) and do nothing if we don’t have to.
	if (currentFrontWindow != windowToSelect)
	{
		// Selecting floating windows are easy, since they’re always active
		if (isFloatingWindow)
		{
			if (IsSinkWindow(windowToSelect))
			{
				WindowRef lastWindow = GetLastDocumentWindowPtr();
				if (!lastWindow)
					lastWindow = lastFloatingWindow;

				if (lastWindow)
					::SendBehind(windowToSelect, lastWindow);
				else
					::BringToFront(windowToSelect);
			}
			else
				::BringToFront(windowToSelect);
		}
		else
		{
			// If there are no floating windows, we can call SelectWindow like the good ol’ days
			if (!lastFloatingWindow)
			{
				// Keep control off Window's control list b/c the Window Mgr adds the regions of controls in
				// the control list to the update region (see NOTE under DrawControls in Inside Mac volume I)
				// generating an update event and causing all controls in a window to redraw unnecessarily.

#if qCarbon
				//#pragma message ("MASelectToolboxWindow: Cannot manage control list this way.  What do we do?)")
#else
				ControlHandle oldFrontControlList;
				ControlHandle newFrontControlList;

				bool currentFrontWindowWasMacAppWindow = false;
				if (currentFrontWindow)
				{
					currentFrontWindowWasMacAppWindow = TWindow::WMgrToWindow(currentFrontWindow) != NULL;
					if (currentFrontWindowWasMacAppWindow)
					{
						oldFrontControlList = reinterpret_cast<ControlRef>(((WindowPeek)currentFrontWindow)->controlList);
						((WindowPeek)currentFrontWindow)->controlList = NULL;
					}
				}

				bool newFrontWindowWasMacAppWindow = false;
				if (windowToSelect)
				{
					newFrontWindowWasMacAppWindow = TWindow::WMgrToWindow(windowToSelect) != NULL;
					if (newFrontWindowWasMacAppWindow)
					{
						newFrontControlList = reinterpret_cast<ControlRef>(((WindowPeek)windowToSelect)->controlList);
						((WindowPeek)windowToSelect)->controlList = NULL;
					}
				}
#endif

				::SelectWindow(windowToSelect);

#if !qCarbon
				if (currentFrontWindowWasMacAppWindow)
					((WindowPeek)currentFrontWindow)->controlList = reinterpret_cast<Handle>(oldFrontControlList);

				if (newFrontWindowWasMacAppWindow)
					((WindowPeek)windowToSelect)->controlList = reinterpret_cast<Handle>(newFrontControlList);
#endif
			}
			else
			{
				// Deactivate the window currently in front.
				MADeactivateWindow(currentFrontWindow);

				// Bring it behind the last floating window if it is not modal and activate it.
				// Note that Inside Mac 1 states that you need to call PaintOne() and CalcVis() on a
				// window if you are using SendBehind() to bring it closer to the front.  With System 7,
				// this is no longer necessary.
				// ••• Note: Carbon does not require the SendBehind nor does Appearance Manager
				// 8.5 or later.

#if qPowerPC
				if (HasWindowManager85_AC() || IsModalWindow(windowToSelect))
#else
				if (IsModalWindow(windowToSelect))
#endif
					::BringToFront(windowToSelect);
				else
					::SendBehind(windowToSelect, lastFloatingWindow);

				MAActivateWindow(windowToSelect);
			}
		}
	}

	// Make sure previous mouse clicks are not considered part of a multi-click.
	gDispatcher->SetLastClickPart(inDesk);
}
// End added for 3.5

//----------------------------------------------------------------------------------------
// MAShowWindow: Show the specified window.  If the window is the frontmost document
// window, unhighlight the window behind it, deactivate it, and activate this one.
//----------------------------------------------------------------------------------------

void TWindow::MAShowWindow(WindowRef windowToShow)
{
	enum WindowFoundState
	{
		eWindowNotFound, eWindowIsFrontmost, eWindowIsNotFrontmost
	};

	WindowRef frontNonFloatingNonModalWindow = NULL;
	bool windowIsInFront = false;

	if (!IsWindowVisible_AC(windowToShow))
	{
		frontNonFloatingNonModalWindow = MAFrontWindow();

		if (IsFloatWindow(windowToShow))
		{
			// A floating window is to be shown.  Check to see if a modal window 
			// is being shown before allowing the floater to receive activates.
			windowIsInFront = !IsModalWindow(::FrontWindow());
		}
		else
		{
			if (IsModalWindow(windowToShow))
			{
				// We are bringing up a modal window! If we are bringing it up in front of
				// another modal window, we need to deactivate that one.  Otherwise we need
				// to make sure that the frontNonFloatingNonModalWindow has been deactivated…
				WindowFoundState windowToShowFoundState = eWindowNotFound;

				for (CWMgrIterator iter; iter; ++iter)
				{
					if (iter.Current() == windowToShow)
						windowToShowFoundState = eWindowIsFrontmost;
					else if (IsWindowVisible_AC(iter))
						windowToShowFoundState = (IsModalWindow(iter) ? eWindowIsNotFrontmost : eWindowIsFrontmost);

					if (windowToShowFoundState != eWindowNotFound)
						break;
				}

				if (windowToShowFoundState == eWindowIsFrontmost)
				{
					windowIsInFront = true;

					// Now deactivate the frontmost modal window or nonfloater, whichever comes first…
					// Ensure that it finds any modal non-floater to deactivate if present.
					// Failure to do so will cause activation of this modal window to fail in
					// SetActiveState with disasterous results (the user will be unable to work
					// with it).
					WindowRef theWnd = ::FrontWindow();
					if (theWnd)
					{
						if (IsModalWindow(theWnd))
							MADeactivateWindow(theWnd);
						else
						{
							// We need to look harder for modal windows which are
							// active as we may have hit a floater front window.
							TWindow* activeModalWindow = nil;
							for (CWMgrIterator wIter; wIter; ++wIter)
							{
								if (IsWindowVisible_AC(wIter)
									&& !(IsFloatWindow(wIter)
										|| IsGhostWindow(wIter)
										|| IsSystemWindow(wIter)))
								{
									TWindow* theMAWindow = WMgrToWindow(wIter);
									if (theMAWindow && theMAWindow->IsModal() && theMAWindow->IsActive())
									{
										activeModalWindow = theMAWindow;
										break;
									}
								}
							}
							if( activeModalWindow )
								MADeactivateWindow(activeModalWindow->GetWindowRef());
							else
								MADeactivateWindow(frontNonFloatingNonModalWindow);
						}
					}
				}
			}
			else
			{
				// We are showing a non-floater, non-modal window.  If it is in front of the
				// frontNonFloatingNonModalWindow, we need a deactivate…

				if (frontNonFloatingNonModalWindow)
				{
					WindowFoundState windowToShowFoundState = eWindowNotFound;

					for (CWMgrIterator iter; iter; ++iter)
					{
						if (iter == windowToShow)
							windowToShowFoundState = eWindowIsFrontmost;
						else if (iter == frontNonFloatingNonModalWindow)
							windowToShowFoundState = eWindowIsNotFrontmost;

						if (windowToShowFoundState != eWindowNotFound)
							break;
					}

					if (windowToShowFoundState == eWindowIsFrontmost)
					{
						windowIsInFront = true;
						MADeactivateWindow(frontNonFloatingNonModalWindow);
					}
				}
				else
					windowIsInFront = true;
			}
		}

#if !qMSWindows
		if (windowIsInFront)
		{
			// Determine whether this is the foreground app.
			ProcessSerialNumber	current;
			ProcessSerialNumber	foreground;
			MacGetCurrentProcess(&current);
			OSErr anErr = GetFrontProcess(&foreground);
			Boolean isSameProcess = false;
			if (!anErr)
				anErr = SameProcess(&current, &foreground, &isSameProcess);

			windowIsInFront = anErr ? false : isSameProcess;
		}

		if (windowIsInFront || IsFloatWindow(windowToShow))
		{
			// Set the highlight state so the window appears highlighted from the start.
			::HiliteWindow(windowToShow, true);
		}
#endif

		// Show the window
		ShowHideWindow(windowToShow, true);

		// If this is the new frontmost document window or a floating window, send it an activate event
		if (windowIsInFront || IsFloatWindow(windowToShow))
		{
			TWindow* theMAWindow = WMgrToWindow(windowToShow);
			if (theMAWindow)
				theMAWindow->SetActiveState(true, kRedraw); //theMAWindow->Activate(true);
		}
	}
}

//----------------------------------------------------------------------------------------
// MAHideWindow: Hide the specified window.
//----------------------------------------------------------------------------------------

void TWindow::MAHideWindow(WindowRef windowToHide)
{
	bool needToActivateAnotherWindow = false;

	// Don’t do anything if the window is already invisible.
	if (IsWindowVisible_AC(windowToHide))
	{
		needToActivateAnotherWindow = IsWindowHilited(windowToHide) && !IsFloatWindow(windowToHide);

		// Actually hide the window first. This short circuits any drawing and speeds everything up!
		ShowHideWindow(windowToHide, false);

		// Give the window a change of deactivating in case it is presently active…
		MADeactivateWindow(windowToHide);

		// if we were hiding the active window (it was either the frontmost nonfloater or the
		// frontmost modal window), we need to find and activate another window…
		if (needToActivateAnotherWindow)
		{
			WindowRef windowToActivate = FrontWindow();
			while (windowToActivate && (IsFloatWindow(windowToActivate) || !IsWindowVisible_AC(windowToActivate)))
				windowToActivate = GetNextWindow_AC(windowToActivate);

			// if we found one, activate it!
			if (windowToActivate)
				MAActivateWindow(windowToActivate);
		}
	}
}

//----------------------------------------------------------------------------------------
// MAFrontWindow:
//----------------------------------------------------------------------------------------
// Returns the first visible, non-floater window in the window list. Ignores the ghost window (if any).
// Note that if a modal window has been brought up in front of the floaters, we bypass it too.

WindowRef TWindow::MAFrontWindow()
{
	WindowRef returnVal = NULL;

	for (CWMgrIterator iter; iter; ++iter)
	{
		if (!(IsFloatWindow(iter) || IsGhostWindow(iter) || IsSystemWindow(iter) || IsModalWindow(iter)) && IsWindowVisible_AC(iter))
		{
			returnVal = iter;
			break;
		}
	}

	return returnVal;
}

//----------------------------------------------------------------------------------------
// FreeIfWMgrWindow:
//----------------------------------------------------------------------------------------

WindowRef TWindow::FreeIfWMgrWindow(WindowRef w, bool inDispose)
{
	if (w)
	{
		// If the window is visible, hide it first so
		// that the proper activate and deactivate events are sent.
		if (IsWindowVisible_AC(w))
			MAHideWindow(w);

		if (GetWindowPort(w) == GetCGrafPtr_AC())// Only need to invalidate focus if freed window is the current port
		{
			if (gDispatcher)
				gDispatcher->InvalidateFocus();

			::SetPortWindowPort(gWorkPort);
		}

#if qCarbon
	#pragma unused (inDispose)	// not allowed to allocate our own storage in Carbon.
		::CloseWindow_AC(w);
#else
		if (inDispose)
			::DisposeWindow(w);
		else
		{
			::CloseWindow_AC(w);
			delete w;
		}
#endif
	}

	return NULL;								// convenience to caller
}

#if qMSWindows

//----------------------------------------------------------------------------------------
// TWindow::HandleWindowsEvent
//----------------------------------------------------------------------------------------

long TWindow::HandleWindowsEvent(HWND hwnd, UINT message, WPARAM wParam, LPARAM lParam)
{
	long result = 0;
	switch (message)
	{
		case WM_NCLBUTTONDBLCLK:
			switch (fProcID)
			{
				case dBoxProc:	 //	dBoxProc : Start dialog					
				case plainDBox:	 //	plainDBox: simple window w/o title or borders
				case noGrowDocProc:		// noGrowDocProc : not resizable document window
				case movableDBoxProc:	 //	Movable modal dialog
				case altDBoxProc: // borderless window
				case kSystem75_kWindoidWDEF: // ToolPalette
					break;
				
				// this one should zoom, but not the full windows defualt zoom, but rather
				// the zoom in/out that is constrained by the window functionality
				case kSystem75_kWindoidWDEF+kSystem75_hasZoom: // ToolPalette with zoom box
					{
						if (fZoomedOut)
							Zoom(inZoomIn);
						else
							Zoom(inZoomOut);
					}
					break;

				default: // Normal document window
					result = DefaultWindowProcedure(hwnd, message, wParam, lParam);
					break;
			}
			break;

		case WM_SIZE:
			{
				// If resizing before visible, we already know the new frame
				// because it was set by us and not the user.
				if ((wParam != SIZE_MINIMIZED) && IsShown())
				{
					CViewPoint newSize = CViewPoint(LOWORD(lParam), HIWORD(lParam));
					ResizeByUser(newSize);
				}
				result = DefaultWindowProcedure(hwnd, message, wParam, lParam);
			}
			break;

		case WM_MOVE:
			result = DefaultWindowProcedure(hwnd, message, wParam, lParam);
			if (IsShown())
			{
				RECT frame;
				::GetWindowRect(GetWindowsWindow(), &frame);
				MapWindowPoints(HWND_DESKTOP, CApplication_AC::fgProcess->fChildClientWindow, (POINT*)&frame, 2);
				fLocation.h = frame.left;
				fLocation.v = frame.top;
			}
			break;

		case WM_COMMAND:
			TView::HandleWindowsEvent(hwnd, message, wParam, lParam);
			result = DefaultWindowProcedure(hwnd, message, wParam, lParam);
			TMenuBarManager::InvalidateMenus();
			break;

		case WM_SETFOCUS:
			{
				TView* view = FindSubView(fTargetID);
				if (view != NULL)
					view->Show(true, false);
				result = DefaultWindowProcedure(hwnd, message, wParam, lParam);
			}
			break;

		case WM_NCACTIVATE:
			result = DefaultWindowProcedure(hwnd, message, wParam, lParam);
			if (wParam != 0)
				SetActiveState(true, kRedraw);
			else
				SetActiveState(false, kRedraw);
			TMenuBarManager::InvalidateMenus();
			break;

		case WM_CLOSE:
			DoMenuCommand(cClose);
			TMenuBarManager::InvalidateMenus();
			break;

		case WM_PAINT:
			result = DefaultWindowProcedure(hwnd, message, wParam, lParam);
			break;

		default:
			result = DefaultWindowProcedure(hwnd, message, wParam, lParam);
			break;
	}
	return result;
}

//----------------------------------------------------------------------------------------
// TWindow::DefaultWindowProcedure
//----------------------------------------------------------------------------------------

long TWindow::DefaultWindowProcedure(HWND hwnd, UINT message, WPARAM wParam, LPARAM lParam)
{
	long result;
	switch (fProcID)
	{
		case 52: // ToolPalette
			result = ::DefWindowProc(hwnd, message, wParam, lParam);
			break;

		default:
	 		result = ::DefMDIChildProc(hwnd, message, wParam, lParam);
	 		break;
	 }
	 return result;
}

//----------------------------------------------------------------------------------------
// TWindow::SetWindowsWindow
//----------------------------------------------------------------------------------------

void TWindow::SetWindowsWindow(HWND windowsWindow)
{
	TView::SetWindowsWindow(windowsWindow);
	fWMgrWindow = (WindowRef)GetGrafPort();
}

//----------------------------------------------------------------------------------------
// TWindow::CreateWindowsWindow
//----------------------------------------------------------------------------------------

void TWindow::CreateWindowsWindow()
{
	if (GetWindowsWindow() == NULL)
	{
		CViewRect frame = GetFrame();
		AdjustWindowFrame(frame, fProcID);
		CREATESTRUCT create;
		create.lpCreateParams = NULL;
		create.hInstance = (HINSTANCE)CApplication_AC::sfInstance;
		create.hMenu = NULL;
		create.hwndParent = CApplication_AC::fgProcess->fChildClientWindow;
	    create.y = frame.top;
	    create.x = frame.left;
	    create.cy = frame.Height();
	   	create.cx = frame.Width();
		create.style = WS_CHILD | WS_CAPTION /*| WS_CLIPCHILDREN*/ | WS_CLIPSIBLINGS;
	    create.lpszName = NULL;
	    create.lpszClass = GetWindowsClassName();
		create.dwExStyle = NULL;

		switch (fProcID)
		{
			//case zoomDocProc:
			case dBoxProc:	 //	dBoxProc : Start dialog
				create.style |= WS_DLGFRAME ;
				create.dwExStyle = WS_EX_DLGMODALFRAME | WS_EX_CONTROLPARENT;
				break;

			case plainDBox:	 //	plainDBox: simple window w/o title or borders
				create.style = WS_CHILD | WS_SYSMENU | WS_BORDER | WS_CLIPSIBLINGS;
				create.dwExStyle = WS_EX_CONTROLPARENT;
				break;

			case noGrowDocProc:		// noGrowDocProc : not resizable document window
				create.style |= WS_MINIMIZEBOX | WS_SYSMENU;
				create.dwExStyle = WS_EX_CONTROLPARENT;
				break;

			case movableDBoxProc:	 //	Movable modal dialog
				create.style |=  WS_DLGFRAME;
				create.dwExStyle = WS_EX_DLGMODALFRAME | WS_EX_CONTROLPARENT;
				break;

			case altDBoxProc: // borderless window
				create.style = WS_CHILD| WS_BORDER | WS_CLIPSIBLINGS;
				create.dwExStyle = WS_EX_CONTROLPARENT;
				create.hwndParent = gApplication->fFrameWindow;
				break;
					
			case kSystem75_kWindoidWDEF: // ToolPalette
				create.style = WS_CHILD | WS_SYSMENU | WS_CAPTION | WS_BORDER | WS_CLIPSIBLINGS;
				create.dwExStyle = WS_EX_TOOLWINDOW;
				create.hwndParent = gApplication->fFrameWindow;
				break;

			case kSystem75_kWindoidWDEF+kSystem75_hasZoom: // ToolPalette with zoom box
				create.style = WS_CHILD| WS_SYSMENU | WS_CAPTION | WS_BORDER | WS_MAXIMIZEBOX | WS_CLIPSIBLINGS;
				create.dwExStyle = WS_EX_TOOLWINDOW;
				create.hwndParent = gApplication->fFrameWindow;
				break;

			default: // Normal document window
				create.dwExStyle = WS_EX_ACCEPTFILES | WS_EX_MDICHILD | WS_EX_CONTROLPARENT;
				create.style |=  WS_MAXIMIZEBOX | WS_MINIMIZEBOX | WS_SYSMENU | WS_THICKFRAME | WS_CLIPSIBLINGS;
				break;
		}

		// Create Child Window
		gNewViewObject = this;
		HWND hwndChildWindow = CreateWindowEx(create.dwExStyle, create.lpszClass, create.lpszName,
											  create.style, create.x, create.y, create.cx, create.cy,
											  create.hwndParent, create.hMenu, create.hInstance, NULL);
		SetWindowsWindow(hwndChildWindow);
		gNewViewObject = NULL;
	}
}

//----------------------------------------------------------------------------------------
// TWindow::DeleteWindowsWindow
//----------------------------------------------------------------------------------------

void TWindow::DeleteWindowsWindow()
{
	HWND window = GetWindowsWindow();
	if (window != NULL)
	{
		::SendMessage(CApplication_AC::fgProcess->fChildClientWindow, WM_MDIDESTROY, (WPARAM)window, 0L);
		DestroyPortAssociation((CGrafPtr)fWMgrWindow.get());
		SetWindowsWindow(NULL);
		fWMgrWindow = NULL;
    }
}

// WINDTemplate and CreateWindowsWindowFromWDEF were copied from UDispatcher.
// Perhaps they should be moved to a header?
// However, the short itemsID field was changed to a title field as that's  how
// WIND records are layed out.  Nevertheless, the handle isn't long enough for
// a string that long, only long enough for the actual title.  the copy should
// not have a problem with that, though, as it only looks at the actual data.

#if PRAGMA_STRUCT_ALIGN
#pragma options align=mac68k
#endif

struct WINDTemplate
{
	CRect_AC	bounds;
	short		procID;
	Boolean		visible;
	Boolean		filler1;
	Boolean		goAway;
	Boolean		filler2;
	long		refcon;
	CStr255_AC	title;
};

#if PRAGMA_STRUCT_ALIGN
#pragma options align=reset
#endif

typedef struct WINDTemplate WINDTemplate;
typedef WINDTemplate* WINDTemplatePtr, ** WINDTemplateHandle;

//----------------------------------------------------------------------------------------
// TWindow::CreateWindowsWindowFromWDEF:
//----------------------------------------------------------------------------------------

void TWindow::CreateWindowsWindowFromWDEF(ResNumber itsRsrcID)
{
	// this code is from pieces of TDispatcher::NewToolboxWindow
	WINDTemplateHandle templateHandle = (WINDTemplateHandle)CMultiLocale_AC::GetResource('WIND', itsRsrcID);
	if (templateHandle != NULL)
	{
		WINDTemplate& templateData = **templateHandle;
		// probably should copy more, but I think it will work with just this.
		fLocation = templateData.bounds[topLeft];
		fSize = templateData.bounds.GetSize();
		fProcID = templateData.procID;
		CStr255_AC title(templateData.title);
		CreateWindowsWindow();
		SetTitle(title);
	}
}

#endif // qMSWindows

#if qCarbonEvents

//----------------------------------------------------------------------------------------
// Carbon Events
//----------------------------------------------------------------------------------------

CTempEventHandlerUPP pHandleCarbonEventUPP;

//----------------------------------------------------------------------------------------
// TWindow::DoInitForCarbonEvents: 
//----------------------------------------------------------------------------------------

void TWindow::DoInitForCarbonEvents()
// DoInitForCarbonEvents installs Carbon Event handlers for the window, if the application
// is not using Carbon Events. 
//
// Call?		Never. TWindow::DoPostCreate calls DoInitForCarbonEvents for you. 
// Override?	As needed, to install different Carbon Event handlers for the window. 
{
	if (fWMgrWindow && gDispatcher->UseCarbonEvents())
	{
		static const EventTypeSpec list[] =
		{
			{ kEventClassMouse, kEventMouseDown },
			{ kEventClassMouse, kEventMouseUp },
			{ kEventClassWindow, kEventWindowActivated },
			{ kEventClassWindow, kEventWindowDeactivated },
			{ kEventClassWindow, kEventWindowClickContentRgn },
			{ kEventClassWindow, kEventWindowClose },
			{ kEventClassWindow, kEventWindowDrawContent },
			{ kEventClassWindow, kEventWindowBoundsChanged }
		};
		enum { listSize = sizeof(list) / sizeof(list[0]) };
		
//		ThrowIfOSErr_AC(ChangeWindowAttributes(fWMgrWindow, kWindowStandardHandlerAttribute, 0));

		if (!pHandleCarbonEventUPP)
			pHandleCarbonEventUPP = HandleCarbonEventProc;

		EventHandlerRef ref = NULL;
		InstallWindowEventHandler(fWMgrWindow, pHandleCarbonEventUPP, listSize, list, this, &ref);
	}
}

//----------------------------------------------------------------------------------------
// TWindow::HandleCarbonEventProc: 
//----------------------------------------------------------------------------------------

pascal OSStatus TWindow::HandleCarbonEventProc(EventHandlerCallRef myHandler, EventRef event, 
											   void* userData)
// HandleCarbonEventProc is the callback glue for the window's Carbon Event handler. 
// Forwards to HandleCarbonEvent. 
//
// myHandler:	A reference to the current handler call chain. This is sent to your
//				handler so that you can call CallNextEventHandler if you need to. 
// event:		The Carbon Event to handle. 
// userData:	The user data specified in the call to InstallWindowEventHandler. 
//
// Call?		Never. Called by the toolbox. 
{
	OSStatus result = eventNotHandledErr;

	try
	{
		// Save and restore the port, just in case some part of
		// the Carbon toolbox is counting on it not changing. 
		CTempGrafPort_AC savePort;

		// Give the event to the window object for handling. 
		if (userData)
			result = reinterpret_cast<TWindow*>(userData)->HandleCarbonEvent(myHandler, event);

		// Take care of business before returning to the toolbox. 
		gDispatcher->DidCarbonEvent();
	}
	catch (CMacException_AC ex)
	{
		result = ex.GetError();
	}
	catch (...)
	{
	}
	
	return result;
}

//----------------------------------------------------------------------------------------
// TWindow::HandleCarbonEvent: 
//----------------------------------------------------------------------------------------

OSStatus TWindow::HandleCarbonEvent(EventHandlerCallRef myHandler, CCarbonEvent_AC event)
// HandleCarbonEvent is the window's Carbon Event handler. 
//
// myHandler:	A reference to the current handler call chain. This is sent to your
//				handler so that you can call CallNextEventHandler if you need to. 
// event:		The Carbon Event to handle. 
//
// Call?		Never. Either send a Carbon Event to the window event target, or call a 
//				lower level window method directly. 
// Override?	As needed, to handle additional Carbon Events.
{
	OSStatus result = noErr; // assume we're going to handle the event

	UInt32 eventClass = event.GetClass();
	switch (eventClass)
	{
		case kEventClassMouse:
			result = HandleMouseEvent(myHandler, event);
			break;

		case kEventClassWindow:
			result = HandleWindowEvent(myHandler, event);
			break;

		default:
			result = eventNotHandledErr; // by default let the event propagate
			break;
	}
	
	return result;
}

//----------------------------------------------------------------------------------------
// TWindow::HandleMouseEvent: 
//----------------------------------------------------------------------------------------

OSStatus TWindow::HandleMouseEvent(EventHandlerCallRef myHandler, CMouseEvent_AC event)
// HandleMouseEvent is the window's Carbon Event handler for mouse events. 
//
// myHandler:	A reference to the current handler call chain. This is sent to your
//				handler so that you can call CallNextEventHandler if you need to. 
// event:		The Carbon Event to handle. 
//
// Call?		Never. Either send a Carbon Event to the window event target, or call a 
//				lower level window method directly. 
// Override?	As needed, to handle additional Carbon Events.
{
#pragma unused (myHandler)

	OSStatus result = noErr; // assume we're going to handle the event

	UInt32 eventKind = event.GetKind();
	switch (eventKind)
	{
		case kEventMouseDown:
			{
				CMouseDownEvent_AC mouseDownEvent(event);
				EventRecord eventRecord;
				if (mouseDownEvent.ConvertToEventRecord(eventRecord))
				{
					// Even if the window is already focused, some non-MacApp code may have 
					// messed with the clip, so let's make sure we start fresh. 
					InvalidateFocus();
					
					if (Focus())		// if we can't focus, we're in trouble 
					{
						TToolboxEvent toolboxEvent(this, &eventRecord, false);
						CViewPoint theMouse = SuperViewToLocal(toolboxEvent.GetWhere());

						// Do our own click count maintenance (not done by Carbon).
						WindowRef aWMgrWindow;
						short whereMouseDown = ::FindWindow_AC(toolboxEvent.GetWhere(), &aWMgrWindow);

						// A little sanity check.
						if (aWMgrWindow != fWMgrWindow || gDispatcher == NULL)
							return eventNotHandledErr; // by default let the event propagate

						toolboxEvent.SetClickCount(gDispatcher->CountClicks(&toolboxEvent, whereMouseDown));
						HandleMouseDown(theMouse, &toolboxEvent, GetStdHysteresis());
						Update();
					}
				}

				if (gDispatcher)
				{
					gDispatcher->SetLastMouseUpTime(TickCount());
						// Because the toolbox often eats mouseUpEvents remember the 
						// time on the way out for double/triple click detection.
				}
			}
			break;

		case kEventMouseUp:
			{
				CMouseUpEvent_AC	mouseUpEvent(event);
				EventRecord			eventRecord;

				if (mouseUpEvent.ConvertToEventRecord(eventRecord))
				{
					// Even if the window is already focused, some non-MacApp code may have 
					// messed with the clip, so let's make sure we start fresh. 
					InvalidateFocus();
					
					if (Focus())		// if we can't focus, we're in trouble 
					{
						TToolboxEvent toolboxEvent(this, &eventRecord, false);
						CViewPoint theMouse = SuperViewToLocal(toolboxEvent.GetWhere());
						if (gDispatcher)
						{
							// Now we _Really_ know what the last mouse up time is so remember
							// time of last mouse up, in order to detect double/triple (multiple) clicks.
							gDispatcher->SetLastMouseUpTime(toolboxEvent.GetWhen());
						}
						HandleMouseUp(theMouse, &toolboxEvent, GetStdHysteresis());
						Update();
					}
				}
			}
			break;

		default:
			result = eventNotHandledErr; // by default let the event propagate
			break;
	}
	
	return result;
}

//----------------------------------------------------------------------------------------
// TWindow::HandleWindowEvent: 
//----------------------------------------------------------------------------------------

OSStatus TWindow::HandleWindowEvent(EventHandlerCallRef myHandler, CWindowEvent_AC event)
// HandleWindowEvent is the window's Carbon Event handler for window events. 
//
// myHandler:	A reference to the current handler call chain. This is sent to your
//				handler so that you can call CallNextEventHandler if you need to. 
// event:		The Carbon Event to handle. 
//
// Call?		Never. Either send a Carbon Event to the window event target, or call a 
//				lower level window method directly. 
// Override?	As needed, to handle additional Carbon Events.
{
#pragma unused (myHandler)

	OSStatus result = noErr; // assume we're going to handle the event

	UInt32 eventKind = event.GetKind();
	switch (eventKind)
	{
		case kEventWindowDrawContent:
			DrawContents();
			break;

		case kEventWindowActivated:
			SetActiveState(true, kRedraw);
			break;

		case kEventWindowDeactivated:
			SetActiveState(false, kRedraw);
			break;

		case kEventWindowBoundsChanged:
			{
				CViewRect bounds = CWindowBoundsChangedEvent_AC(event).GetCurrentBounds();
				// Call TView::SetFrame instead of the TWindow version because we
				// don't want to try to move the window to where it already is. 
				TView::SetFrame(bounds, kInvalidate);
				Update();
			}
			break;

		case kEventWindowClickContentRgn:
			{
				CMouseDownEvent_AC mouseDownEvent = CWindowClickContentRgnEvent_AC(event).GetMouseEvent();
				if (mouseDownEvent)
				{
					EventRecord eventRecord;
					if (mouseDownEvent.ConvertToEventRecord(eventRecord))
					{
						// Even if the window is already focused, some non-MacApp code may have 
						// messed with the clip, so let's make sure we start fresh. 
						InvalidateFocus();
						
						if (Focus())		// if we can't focus, we're in trouble 
						{
							TToolboxEvent toolboxEvent(this, &eventRecord, false);
							CViewPoint theMouse = SuperViewToLocal(toolboxEvent.GetWhere());
							HandleMouseDown(theMouse, &toolboxEvent, GetStdHysteresis());
							Update();
						}
					}
				}
			}
			break;

		case kEventWindowClose:
			CloseByUser(cClose);
			result = eventNotHandledErr; // let Carbon Events to the rest of closing the window
			break;

		default:
			result = eventNotHandledErr; // by default let the event propagate
			break;
	}

	return result;
}

#endif // qCarbonEvents


//----------------------------------------------------------------------------------------
// End of UWindow.cpp

/*
	Historical Change Record:
		----- R13 -----
		07/25/97	When updating with platinum appearance we were not respecting the window's content
							region color. We needed to set the background color for the window when focusing.
							However, to allow drawing environments to provide alternate coloration we also needed
							to call TView::SetupDrawingEnvironment() when focusing. TWhiteBackgroundAdorner installs
							a DrawingEnvironment to cause the color environment to change to the desired one.
		07/16/97	Changed ProgramBreak_AC to ProgramReport_AC in CWindowRefTable::At and AtDelete
		07/13/97	[1615633] (TTEView -Clone) Clone crashed at mouse click
		07/12/97	[1357471] MacApp: TWindow::Clone() does not work correctly
		07/12/97	[1615906] Potential memory leak when disposing windows
		07/11/97	Changed 7/9's changes to use TempObjectAllocation.
		07/09/97	[1604530] Updated Update to update location if it thinks it needs updating.
		07/09/97	Replaced AllocateObjectsFromPerm with TempAllocation.
		07/08/97	[1617477] Added AddedSubView to check for droppable views and
							add them to list if found.  RemovedSubView now removes from list.
							RegisterDroppableView now checks first before inserting view
							into list.  Added Un/RegisterIfDroppableView methods to scan
							subviews.
		06/30/97	[1353169] fprinf(stderr, blah) to ProgramBreak_AC(blah)
		06/22/97	Minor changes for VC++.
		06/22/97	Moved fTarget(this) in TWindow contructor because "this" isn't valid in an
							initializer list.  Also comment out "#undef CloseWindow".
		06/19/97	Switch to an ordered list for mapping WindowRefs to TWindows (used to be linear search).
							Also, don't remove/restore controllist for non-macapp windows.
		06/12/97	[1347449] Only resize the window if fIsResizable is true.
		06/10/97	Need to use dynamic_cast not dynamic_cast_AC
		06/09/97	Use dynamic_cast_AC where we expected dynamic_cast to always work.
		06/05/97	EXPORT_AC, EXPORT_MA, no-load fixes, Memory_AC, Windows_AC, no CW11orLATER, removed segmentation, etc...
		05/30/97	[1609209] Made the distinction explicit between a visible float window and its float-ness.
		05/29/97	Removed obsolete UContainer dependency.
		05/14/97	[1642582] bug fix in TWindow::Zoom
		04/23/97	Remove Clone declarations from classes we don't clone.
		04/23/97	ReadFields methods don't free themselves on failure.
		04/22/97	Make the global adorners static members of TAdorner
		04/14/97	Update for real xxx_cast operators.
		04/14/97	More const for TView/TWindow.
		04/13/97	Update List and Dependency names for ACS.
		04/11/97	Made TApplication::WMgrToWindow conditioned on BackwardCompatible. Use TWindow::WMgrToWindow
		04/11/97	Moved SetTarget/GetTarget/fTarget to TEventHandler (as statics), IsTarget a simple
							Inline and removed the need for TEditText to lie in a (former) override of IsTarget.
							Instead, TEditText::WantsToBeTarget only wants to be the target if its fTEView isn't
		04/10/97	Remove remainder of qContainer flagged code.
		04/09/97	properly use dynamic casting for all down/side casts
		04/08/97	Update for TAdorner/TBehavior/TEventHandler/TCommandHandler/TCommand/
							TFileBasedDocument/TSection/TEditionDocument protected fields.
		04/04/97	Update for TView/TWindow/TDispatcher protected fields.
		04/02/97	Update for TView view coordinate tranform methods.
		03/25/97	AC_ to _AC Name change.
		03/24/97	Migrated Dependencies and Lists to ACS
		03/21/97	Migrated to CViewRect, CViewPoint, ViewCoordinate.
		03/13/97	Update CW11 noDebug/68K support
		03/11/97	Update exception support to latest.
		03/07/97	Massive Changes: Use Exceptions_AC, new to TH_new, use Blah_AC,
							Update Copyright, Moved Obsolete APIs into Compatibility.h, etc..
		03/05/97	Added UClipboard.h include for no load builds.
		02/15/97	Fleshed out copy constructor.
		02/13/97	[1616308] Don't close the document for a clipboard window
							in TWindow::CloseByUser because we don't want the document
							to be closed.
		02/13/97	Added ALOESizeWindow support so clip regions are updated correctly.
		01/17/97	Updated qMSWindows conditionals.
		01/13/97	Updated qWindows conditionals.
		12/18/96	Added ALOE support.
		12/05/96	Added qWindows conditionals.
		11/08/96	TWindow::Begin/EndUpdate did not have segmentation directives and were thus in GOpen!
		09/30/96	Change local MAauto_ptrs to stack based object allocations where possible
		09/30/96	Fix cloning by turning clone methods into copy constructors
		09/20/96	Cosmetic.
		09/19/96	Eliminate all memory leaks identified by TidyHeap.
		08/28/96	Remove superview/document arguments to TView (and derived) constructors.
		08/26/96	[1353613] (GX Printing) "Edit" Menu disable problems
		08/16/96	Use constructors for all TView descendents
		08/15/96	Use constructors for all TCommand descendents
		08/13/96	Use constructors for all TBehavior descendents
		08/12/96	Use constructors for all CDynamicArray_AC descendents
		08/10/96	Fixed -noload compiles, made more datamembers auto_ptrs, FreeIfObject->delete
		08/07/96	Goodbye TObject!
		08/01/96	T[Sorted]List now takes a void* T[Sorted]VoidList now typedefed to T[Sorted]List
		07/18/96	Use CAutoPtr_AC based pointers for many instance variables.
		07/17/96	define template CAutoPtr_AC and use it in place of CTempObject
		07/16/96	Removed MAVolatile
		07/16/96	Replacing Failxxx with Throwxx procs
		07/16/96	Goodbye Exception Macros (TRY, CATCH_ALL, ENDTRY)
		07/16/96	Now include UExceptions.h instead of UFailure.h
		07/15/96	Boolean->bool
		----- R11 -----
		06/27/96	Make conditional tests implicit as in if(x) instead of if(x != 0).
		06/26/96	Changed nil back to NULL.
		06/26/96	[1290384] Overhauled BeInDocument.
		06/26/96	Install release marker.  Scope many globals.  Change TRUE/FALSE/NULL.
		06/26/96	==/!=NULL to implicit tests, except in the case of assignment to or passing/returning as bool/bool.
		06/21/96	[1291338] Check to see that app is in foreground before highlighting
							window when it is shown.
		06/19/96	SCpp and MrCpp can't handle declarations in the expression portion of while loops
							so we just changed them all to for loops
		06/17/96	[1222063] Added CountAsOpen.
		06/17/96	[114989] Record all quitting-related commands.  Default recording
							in command I method to true.
		06/12/96	Started the release process, removing triple-•, initials,
							inappropriate comments.
		05/25/96	[1353199] Potential memory leak when disposing windows.
		05/23/96	Account for STRICT_WINDOWS being taken out of ETO 21.
		05/09/96	Adjust the Failure Handling macros to allow for easy switching to native exceptions.
		05/06/96	Combine Lockhandle and LockHandleHigh. Create CTempHandleLock_AC.
		05/02/95	Made TWindow::CloseAndFree deprecated. It will eventually be removed,
							please call Close and then if necessary free the object
		 4/26/96	Made C/CViewPoint/Rect default constructors set the point/rect to a cleared value. Made
		 					clearing very fast/compact. Eliminated the now unnecessary hand clearing of C/CViewPoint/Rects.
		04/26/96	Make GetDynamicMoveBounds/GetDynamicResizeLimits return CRect_AC
							function results.
		04/24/96	Use PRE-Increment/Decrement operators whenever possible for eff.
		04/23/96	Use CTempObject/Handle/Region/Ptr, etc.
		04/18/96	Use post-increment with iterators in while loops
		04/16/96	Use more "while" style iteration
		04/11/96	Fix some SCpp compiler whining
		----- R10 -----
		03/27/96	MADragWindow is supposed to take a CPoint_AC, was a point
		03/27/96	Fix my mistake.
		03/26/96	Fix but in TWindow::GetMaxIntersectedDevice that I introduced where the window
							would then zoom to the screen it _LEAST_ intersected. Sheesh!. Did a little cleanup too.
		03/26/96	Cleanup references to gEmptyString and ""
		03/22/96	[1331566] Fixed double-free in a MakeAppleEvent.
		03/20/96	Replace a couple of curly quotes.
		03/19/96	Removed support for CFront.
		 3/18/96	Made better use of TView calls that return CRect_AC/CViewPoint/CViewRect
		03/14/96	Use CPascalStr_AC::Empty.
		03/05/96	[1329893] Added TWindow::GetCommandContext.  ICloseWindowCommand
							retrieves correct context from the window.
		 3/01/96	Re-arranged data members, natural alignment results in
		 					reduced storage size.
							Grouped some globals and global functions as static members.
		  1/18/95	Made GetWindow const.
		01/16/95	CARequestStandardFocusSet called when HandleMouseDown in content.
		12/19/95	Don't need failure handler in DoIt just for SetValidationError.
		12/18/95	Remove linkedCommand argument to ICloseWindowCommand.
		 12/8/95	Split up includes for modular MacApp.
		 6/11/95	Change RegisterDroppableView to use !eInstalled instead
		 					of eNotInstalled. This allows registering droppable views
		 					after DoPostCreate. If DoPostCreate didn't do anything,
		 					the drag callback status is still eWindowNotInited.
		  5/7/95	Move MASelectToolboxWindow here from being a method of
		  					TApplication.
		----- 3.3 -----
		11/03/95	Setting window's name property is not undoable.
		11/02/95	Add TWindow::GetSetPropertyInfo. Setting bounds or zoomed
							is not undoable and doesn't cause change.
		11/02/95	Have TWindow::DoClose decide to Post or Process the close command.
		 11/1/95	Typo in previous fix.
		 11/1/95	Add ReleaseScriptingPrintHandler.
		 11/1/95	Make drag cursor and script idle code resident.
		10/31/95	Add fScriptingPrintHandler, SetScriptingPrintHandler.
							Add DoAEPrint. Update support of print via aevt's.
		10/27/95	TWindow::GetObjectProperty supports pClass to returning the
							class of the window's document.
							TWindow::GetSpecifierForm returns formName if the window
							has a title.
		10/25/95	TWindow::ReadFields doesn't set fOMClassID based on fFloats.
							fOMClassID is correctly set in constructors of TWindow
							and TFloatWindow.
		10/24/95	Replace calls to GetBestType with GetSpecifierForm.
		10/21/95	Use GetBestType() in calls to MakeObjectSpecifier.
		10/17/95	1289742	(Windows) Redrawing in Windows inconsistant
		10/16/95	Cosmetic.
		10/16/95	Reintroduce the bottlenecking of window closing through
							TDocument::CloseWindow().
		10/11/95	[1263154] Cleaned up the AllocateObjectsFromPerm calling.
		 9/26/95	[1276050] Check for read-only properties [pHasCloseBox,
		 					pHasTitleBar ,pIsModal ,pIsResizable, pIsZoomable, pSelection]
							in TWindow::SetObjectProperty.
		 9/22/95	[1270448] Removed pVersion from TWindow properties.
		 9/22/95	[1287420] Removed the linkedCommand argument from TWindow::DoClose
		 					interface and from the DoClose calls in DoAEClose and
							CloseByUser.  [1287415] Added additional test in ICloseWindowCommand
							(both forms) for debugging validation.
		----- 3.3b1 -----
		  9/5/95	Changed TCloseWindowCommand back to TCommand.
		 8/23/95	TWindow::DoClose handles linked commands.  TWindow::CloseByUser now returns void
							rather than bool.  Added a failure handler to TCloseWindowCommand::DoIt.
							TCloseWindowCommand now derives from TServerCommand.
		08/19/95	Smarter calculation of default minimum in GetDynamicResizeLimits.
		  8/7/95	General cleanup of scripting.
		  8/4/95	CloseByUser returns a bool.
		  8/3/95	Added change missing in merge from ,49a1.
							Don't put CTempDesc_AC in same block as FailInfo.
		 7/31/95	Made close window recordable.
		  8/3/95	Remove HandlesDragCursor.
		  8/2/95	Use GetClipRegion
		  8/1/95	Fix TWindow::HandlesDragCursor dereference of nil.
		  8/1/95	Fix to compile with -noDrag.
		 7/31/95	ClickThrough: Add HandlesDragCursor. DoMouseCommand support.
		07/29/95	Added TWindow::BeginUpdate and EndUpdate as well as the global functions:
							GetUpdateRegion and GetVisRegion. Proper usage of these makes MacApp
							able to use the BeginUpdate and EndUpdate Traps. This allows using QD GX in MacApp
		 7/28/95	Add configuration functions to use instead of gConfiguration.
		 7/27/95	Conditionalize attachability support.
		  7/6/95	TWindow::DoPostCreate sets dragCallbackStatus to eNotInstalled.
		  7/5/95	Use (Rect*) cast instead of &CRect_AC so it will work with both
		  					the macros and the new C++ inline glue.
		 6/29/95	Remove references to TApplication::GetMyAddress.
		 6/28/95	Reorder scripting method params.
		 6/18/95	Remove gStandardWindowMoveBounds, gStandardWindowSizeRect and
		 					gStandardWindowScreenRect. Change usage of fMoveBounds and fResizeLimits
							to be used only if non-zero. Otherwise, values are dynamically calculated
							in the new functions: GetDynamicMoveBounds and GetDynamicResizeLimits.
							This is because monitor location, resolution and size is now dynamic since
							System 7.5.
		 6/16/95	Support MI in TWindow classdesc.
		 6/15/95	UWindow initializes MScriptableObject with "this"
		 6/12/95	Support MScriptableObject::DoScriptCommand param reorder
							Support name change: MScriptableObject::OSAHandledEvent to HandleOSAEvent
							Support TOSADispatcher::fgDispatcher
							Support TOSADispatcher::fDefaultTarget of type MDefaultScriptableObject
		 5/31/95	SetWindowStandardState can't take a &CRect_AC.
		 5/16/95	More cleanup for STRICT_WINDOWS
		 5/16/95	WindowRef
		 4/28/95	Allocate WindowRecords from the objectstore.
		 4/04/95	fix several places that were still testing zoomdocproc instead of spareflag.
							Add support for compatible floating wdef id
		 4/10/95	Include UStream.
		  4/9/95	Use LockHandle_AC instead of LockHandleHigh wherever possible.
		  					Add a delay to the window invalidation debug code so it
							is perceptible.
		  4/5/95	Support palette AEOM class.
		  4/5/95	TWindow::CloseByUser doesn't install save as apple event
		 					params if the window doesn't have a document.
		 3/30/95	Remove unnecessary includes.
		 3/28/95	Removed double semicolon in MouseToDropTarget.
		 3/24/95	ARM 8.4.3 x& cannot be initialized with volatile x.
		 3/22/95	Renamed:
		 						fDragDropSubViewList to fDroppableViewList
		 						fDropViewStatusList to fDropStatusCache
		 						RegisterDragDropView to RegisterDroppableView
		 						UnregisterDragDropView to UnregisterDroppableView
		 					Removed CanWindowAcceptDrag. Implemented smarter caching of
		 					droppability during a drag.
		 3/17/95	MAVolatile. UpdateCoordinates.
		 3/16/95	Optimize drag and drop.
		 3/15/95	Drag and drop face lift.
		 3/13/95	Change Free methods to destructors.
							When we're disposing of our window manager window, tell the
							subviews to BeInPort(NULL) so they won't try to reference the
							deleted window.
		02/22/95	1222969 Use spareFlag to test for a zoomable window, not the variant.
		02/22/95	1184021 Get the wdefs proper rsrcid into fProcID when creating procedurally
		02/13/95	Remove unnecessary initialization of static variables. See ARM §8.4
		02/07/95	Create missing prototypes for static functions used internally.
		 2/17/95	Integration fixes.
		 2/17/95	Rename IsDraggable to RectInDrag in order to avoid
		 					conflict with drag & drop support in TView.
		 1/26/95	Add support for attachability and many improvements
							to scripting support.
		 2/14/95	TWindow::GetObjectProperty(index) doesn't count floaters
							or invisible windows.
		 2/14/95	TWindow::GetObjectProperty returns a bool.
		 2/10/95	TWindow::MouseToDropTarget now focuses on a view before
							testing to see if it can act as the current drop target.
							This fixes problems caused by views whose sizes and
							states change when they are focused.
		 1/20/95	TWindow::Show tested fGenerateActivates and fFloats to
							determine whether or not to call HiliteWindow. It now
							tests only fFloats.
		  1/4/95	TWindow now provides a registry mechanism for subviews that
							support drag/drop.  This replaces the registry mechanism
							for TDragDropBehaviors.
							Changed fDragDropBehaviorList to fDragDropSubViewList.
							Changed associated code to support registration of
							drag/drop views rather than behaviors.
							Changed TWindow::RegisterDragDropBehavior and
							TWindow::UnregisterDragDropBehavior to
							TWindow::RegisterDragDropView and TWindow::UnregisterDragDropView.
							TWindow::MouseToDropTarget now returns a TView instead of a
							TDragDropBehavior.
		----- 3.5d3 Release -----
		11/17/94	Conditionalize includes of drag stuff.
		 11/9/94	Test gConfiguration.hasDragManager at runtime
							before using the drag manager.
		 11/9/94	Conditionally compile out drag support when qDrag
							is false.
		 11/9/94	Fix debug check for behavior registering twice.
		 11/2/94 	GSF		Remove fDragTrackingUPP and fDragReceiveUPP to
							support newer drag design.  Moved all drag
							manager access to UDragDrop.
		 11/1/94	Removed unnecessary UPPs for window defprocs, which
							are always 68K code. (1187572)
		10/27/94	Compile with ETO 15 prerelease headers.
		 9/28/94	Add fDragTrackingUPP and fDragReceiveUPP fields to
							TWindow.  Added support for initializing and disposing
							the UPPs.
		 9/23/94	Add support for gScriptEventDispatcher.
		 9/13/94	Merged with Eric Hanig's MADrag additions.
		 7/26/94	Include UFile.
		 7/18/94	Change NULL to nil.
		 7/14/94	Merged with Ken Ryall's MAScript changes.
		 6/27/94	IsFloatWindow now recognizes floating windows other than
							kFloatingWindow as long as they have an associated
							TWindow with fFloats true.
		 6/14/94	Allow floating windows to be activated even if there
							already is an active document window around.
		  6/3/94	Fix MADragWindow to clip the gray outline correctly when
							dragging movable modal windows. (Fix proposed by Henk
							Kampman, HOL0156.)
*/