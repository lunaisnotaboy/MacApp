//----------------------------------------------------------------------------------------
// UEditionDocument.cpp
// Copyright © 1984-2001 by Apple Computer, Inc. All rights reserved.
//----------------------------------------------------------------------------------------

/*
	Change History
		06/15/01	Don't throw if the settings resource is missing. It should be
					okay if a file doesn't have edition information. Not all systems
					have the Edition Manager. 
		03/19/01	Use BlockZero_AC, instead of BlockSet_AC(,,0)
		01/11/01	Use CString_AC instead of CStr255_AC.  GetNextEditionName now
					returns a string rather than setting a string directly.  Some
					functions made const.
		01/02/01	Update copyright.
		11/10/00	Cosmetic.  Pragma unuseds.
		11/01/00	[PB] Include MacErrors instead of Errors. 
		09/06/00	Added embedded documentation.
		06/14/00	Eliminate unnecessary GetRegionCode calls.  Call
					CMultiLocale_AC::AddResource instead of MAAddResource.  Include
					CMultiLocal.h.
		12/08/99	Took out MA_DEFINE_CLASS of TEditionDocument.
		10/25/99	PRAGMA_ALIGN_SUPPORTED now PRAGMA_STRUCT_ALIGN.
		08/09/99	Changed MA_REGISTER_SIGNATURE to REGISTER_SIGNATURE_AC.
		03/24/99	Update copyright notice.
*/

#ifndef __UEDITIONDOCUMENT__
#include "UEditionDocument.h"
#endif

// ACS

#ifndef __CDependencies_AC__
#include "CDependencies_AC.h"
#endif

#ifndef __CMultiLocal_AC__
#include "CMultiLocal_AC.h"
#endif

#ifndef __StdStringUtils_AC__
#include "StdStringUtils_AC.h"
#endif

// MacApp

#ifndef __UAPPLEEVENTS__
#include "UAppleEvents.h"
#endif

#ifndef __UCLIPBOARDMGR__
#include "UClipboardMgr.h"
#endif

#ifndef __UDESIGNATOR__
#include "UDesignator.h"
#endif

#ifndef __UDISPATCHER__
#include "UDispatcher.h"
#endif

#ifndef __UERRORMGR__
#include "UErrorMgr.h"
#endif

#ifndef __UFILE__
#include "UFile.h"
#endif

#ifndef __UGEOMETRY__
#include "UGeometry.h"
#endif

#ifndef __UMACAPPGLOBALS__
#include "UMacAppGlobals.h"
#endif

#ifndef __UMACAPPUTILITIES__
#include "UMacAppUtilities.h"
#endif

#ifndef __UMEMORY__
#include "UMemory.h"
#endif

#ifndef __UMENUMGR__
#include "UMenuMgr.h"
#endif

#ifndef __USCRIPTING__
#include "UScripting.h"
#endif

#ifndef __USECTION__
#include "USection.h"
#endif

#ifndef __USECTIONMGR__
#include "USectionMgr.h"
#endif

#ifndef __UWINDOW__
#include "UWindow.h"
#endif

#ifndef __USTREAM__
#include "UStream.h"
#endif

// Toolbox

#ifndef __MACERRORS__
#include <MacErrors.h>
#endif

#ifndef __PACKAGES__
#include <Packages.h>
#endif

#ifndef __RESOURCES__
#include <Resources.h>
#endif

#ifndef __TOOLUTILS__
#include <ToolUtils.h>
#endif

// Mac OS names are our preference, so remap conflicting ones
#if qMSWindows
#	ifndef __QTMLMAPNAMES__
#		include "QTMLMapNames.h"
#	endif
#endif

// ANSI


#ifndef __STRING__
#include <string.h>
#endif

//----------------------------------------------------------------------------------------

const unsigned long	kEditionDocRsrcType = 'EdSt';// rsrc type for Edition Doc private rsrc 
const short			kEditionDocRsrcID = 301;			 // rsrc id for Edition Doc private rsrc 
extern const char*	kEditionDocRsrcName = "Edition Doc Settings";

#if PRAGMA_STRUCT_ALIGN
#pragma options align=mac68k
#endif

typedef struct EditionDocSettings
{												 // used for saving settings in a resource 
	Boolean		showSectionBorders;
	Boolean		stopAllEditions;
} *EditionDocSettingsPtr, ** EditionDocSettingsHandle;

#if PRAGMA_STRUCT_ALIGN
#pragma options align=reset
#endif

//========================================================================================
// GLOBAL Procedures
//========================================================================================

//----------------------------------------------------------------------------------------
// InitUEditionDocument: 
//----------------------------------------------------------------------------------------

void InitUEditionDocument()
{
	::ThrowIfOSErr_AC(InitEditionPack());
	
	REGISTER_SIGNATURE_AC(TSectionBehavior, kSectionBehavior);

	// debug check to ensure that the user has included Editions.r in their <program>.r file
#if qDebugMsg
const short kAEEditionsDispatchTable = 401;		// ID of our 'aedt' resource
	Handle aedtResource = CMultiLocale_AC::GetResource('aedt', kAEEditionsDispatchTable);
	if (!aedtResource)
	{
		ProgramBreak_AC("###Missing 'aedt' resource id=%d!\n", kAEEditionsDispatchTable);
		::ProgramBreak_AC("Did you forget to include Editions.rsrc in your .r file?\n");
	}
#endif
}

//========================================================================================
// CLASS TEditionDocument
//========================================================================================

//----------------------------------------------------------------------------------------
// TEditionDocument constructor
//----------------------------------------------------------------------------------------

TEditionDocument::TEditionDocument(TFile*		itsFile,
								   const OSType	itsScrapType,
								   const OSType	editionCreator)
	:	TFileBasedDocument(itsFile, itsScrapType),
		fEditionCreator(editionCreator),
		fNextEditionNumber(1),
		fStopAllEditions(false),
		fShowSectionBorders(true),
		fNewPublishers(false)
{
	InitUSectionMgr();							// ensure it's init'd
}

//----------------------------------------------------------------------------------------
// TEditionDocument::Free: 
//----------------------------------------------------------------------------------------

TEditionDocument::~TEditionDocument()
{
	for (TemplateIterator_AC<TSection*> iter(&fSectionList); iter; ++iter)
		delete iter.Current();
}

//----------------------------------------------------------------------------------------
// TEditionDocument::FreeData: 
//----------------------------------------------------------------------------------------

void TEditionDocument::FreeData()
{
	for (TemplateIterator_AC<TSection*> iter(&fSectionList); iter; ++iter)
		delete iter.Current();
	fSectionList.DeleteAll();

	TFileBasedDocument::FreeData();
}

//----------------------------------------------------------------------------------------
// TEditionDocument::CanPublishSelection: 
//----------------------------------------------------------------------------------------

bool TEditionDocument::CanPublishSelection()
// CanPublishSelection is intended to return true if the user’s selection 
// can be published. TEditionDocument::CanPublishSelection returns true if 
// there is a nonempty user selection that is not the same selection specified 
// in a noncancelled publisher; otherwise, it returns false.
//
// Call?		As needed.
// Override?	Seldom.
{
	bool returnVal = false;
	// we can publish if:
	// 1. there is a user selection, and
	// 2. the user selection contains something, and
	// 3. there isn't already a non-canceled publisher EXACTLY contained in the current selection.

	TDesignator * userSelection = GetUserSelection();
	if (userSelection && !userSelection->IsEmpty())
	{
		returnVal = true;
		for (CSectionIterator iter(this); iter.Current(); ++iter)
			if (!(*iter).IsCanceled() && 
				((*iter).GetSectionType() == stPublisher) && 
				userSelection->IsContained((*iter).GetDesignator()) == kExactlyContained)
			{
				returnVal = false;
				break;
			}
	}

	return returnVal;
}

//----------------------------------------------------------------------------------------
// TEditionDocument::CanSubscribe: 
//----------------------------------------------------------------------------------------

bool TEditionDocument::CanSubscribe()
// CanSubscribe is intended to return true if a user’s selection can be subscribed 
// to. TEditionDocument::CanSubscribe returns true if a nonempty user selection exists
// that does not intersect any other subscriber’s selection.
//
// Call?		As needed.
// Override?	Seldom.
{
	bool returnVal = false;
	// we can subscribe if:
	// 1. there is a user selection, and
	// 2. the user selection contains something, and
	// 3. there isn't a non-canceled subscriber currently selected (i.e. don't subscribe OVER a subscriber).

	TDesignator * userSelection = GetUserSelection();
	if (userSelection && !userSelection->IsEmpty())
	{
		returnVal = true;
		for (CSectionIterator iter(this); iter.Current(); ++iter)
			if (!(*iter).IsCanceled() && 
				((*iter).GetSectionType() == stSubscriber) && 
				userSelection->IsContained((*iter).GetDesignator()) != kNotContained)
			{
				returnVal = false;
				break;
			}
	}

	return returnVal;
}

//----------------------------------------------------------------------------------------
// TEditionDocument::DoWrite: 
//----------------------------------------------------------------------------------------

void TEditionDocument::DoWrite(TFile* aFile, bool makingCopy)
{
	TFileBasedDocument::DoWrite(aFile, makingCopy);

	// 0. warn user if doc has multiple publishers to same edition
	{
		TSection* prevPublisher = NULL;
		for (CSectionIterator iter(this); iter.Current(); ++iter)
			if ((*iter).GetSectionType() == stPublisher)
			{
				if (prevPublisher && ((*(prevPublisher->GetSectionHandle()))->controlBlock == (*((*iter).GetSectionHandle()))->controlBlock))
				{
					PoseSavingMultPublishersAlert(prevPublisher);
					break;
				}
				prevPublisher = iter;
			}
	}

	// 1. write out (as a resource) fStopAllEditions and fShowSectionBorders 
	DoWriteSettings(aFile);

	// 2. clear the new publishers flag 
	fNewPublishers = false;

	// 3. tell each section to write itself out 
	for (CSectionIterator iter(this); iter.Current(); ++iter)
		(*iter).DoWrite(aFile, false);
}

//----------------------------------------------------------------------------------------
// TEditionDocument::DoWriteSettings: 
//----------------------------------------------------------------------------------------

void TEditionDocument::DoWriteSettings(TFile* aFile)
{
	#pragma unused (aFile)

	EditionDocSettingsHandle h = (EditionDocSettingsHandle)NewPermHandle(sizeof(EditionDocSettings));

	(*h)->showSectionBorders = fShowSectionBorders;
	(*h)->stopAllEditions = fStopAllEditions;
	
	CMultiLocale_AC::AddResource((Handle)h, kEditionDocRsrcType, kEditionDocRsrcID, CStr255_AC(kEditionDocRsrcName));
	::ThrowIfResError_AC();
}

//----------------------------------------------------------------------------------------
// TEditionDocument::DoRead: 
//----------------------------------------------------------------------------------------

void TEditionDocument::DoRead(TFile* aFile, bool forPrinting)
{
	CTempUseResFile_AC tempUseResFile(aFile->GetRsrcRefNum());

	TFileBasedDocument::DoRead(aFile, forPrinting);

	// 1. read in (from a resource) fStopAllEditions and fShowSectionBorders 
	DoReadSettings(aFile);

	// 2. create the section objects and tell each section to read itself in 
	for (short i = 1; i <= Count1Resources(rSectionType); ++i)
	{
		short theID;
		Handle h;

		h = Get1IndResource(rSectionType, i);	// get the resource handle 
		::ThrowIfNULLResource_AC((Handle)h);
		theID = static_cast<short>((*reinterpret_cast<SectionHandle>(h))->sectionID);
		switch ((*reinterpret_cast<SectionHandle>(h))->kind)
		{
			case stPublisher:
				DoReadPublisher(aFile, theID);
				break;
			case stSubscriber:
				DoReadSubscriber(aFile, theID);
				break;
			default:
#if qDebug
				::ProgramBreak_AC("SectionHandle appears to be corrupt");
#endif
				break;
		}
	}
}

//----------------------------------------------------------------------------------------
// TEditionDocument::DoReadSettings: 
//----------------------------------------------------------------------------------------
void TEditionDocument::DoReadSettings(TFile* /*aFile*/)
{
	EditionDocSettingsHandle h = (EditionDocSettingsHandle) CMultiLocale_AC::Get1Resource(kEditionDocRsrcType, kEditionDocRsrcID);
	if (h)
	{
		::ThrowIfResError_AC();
		fShowSectionBorders = (*h)->showSectionBorders;
		fStopAllEditions = (*h)->stopAllEditions;
		ReleaseResource((Handle)h);
	}
}

//----------------------------------------------------------------------------------------
// TEditionDocument::DoReadPublisher: 
//----------------------------------------------------------------------------------------

void TEditionDocument::DoReadPublisher(TFile* aFile, short theID)
{
	CAutoPtr_AC<TPublisher> aPublisher(DoMakePublisher(NULL, NULL, theID));

	aPublisher->DoRead(aFile);
	AddSection(aPublisher);

	aPublisher.release();
}

//----------------------------------------------------------------------------------------
// TEditionDocument::DoReadSubscriber: 
//----------------------------------------------------------------------------------------

void TEditionDocument::DoReadSubscriber(TFile* aFile, short theID)
{
	CAutoPtr_AC<TSubscriber> aSubscriber(DoMakeSubscriber(NULL, NULL, theID));

	aSubscriber->DoRead(aFile);
	AddSection(aSubscriber);

	aSubscriber.release();
}

//----------------------------------------------------------------------------------------
// TEditionDocument::RevertDocument: 
//----------------------------------------------------------------------------------------

void TEditionDocument::RevertDocument()
{
	Abandon();
	TFileBasedDocument::RevertDocument();
}

//----------------------------------------------------------------------------------------
// TEditionDocument::DoMenuCommand: 
//----------------------------------------------------------------------------------------

void TEditionDocument::DoMenuCommand(CommandNumber aCommandNumber)
{
	switch (aCommandNumber)
	{
		case cCreatePublisher:
			DoNewPublisher();
			break;

		case cSubscribeTo:
			PostCommand(TH_new TNewSubscriberCommand(cSubscribeTo, this));
			break;

		case cOptions:
			DoSectionOptions();
			break;

		case cBorders:
			PostCommand(TH_new TSectionBorderCommand(cBorders, this));
			break;

		case cStopAllEditions:
			PostCommand(TH_new TStopAllEditionsCommand(cStopAllEditions, this));
			break;

		default:
			TFileBasedDocument::DoMenuCommand(aCommandNumber);
			break;
	}
}

//----------------------------------------------------------------------------------------
// TEditionDocument::DoSectionOptions: 
//----------------------------------------------------------------------------------------

void TEditionDocument::DoSectionOptions()
{
	TSection * aSection = GetSelectedSection();
	if (aSection)
	{
		if (aSection->GetSectionType() == stPublisher)
			DoPublisherOptions(dynamic_cast_or_throw_AC(TPublisher*,aSection));
		else if (aSection->GetSectionType() == stSubscriber)
			DoSubscriberOptions(dynamic_cast_or_throw_AC(TSubscriber*,aSection));
#if qDebug
		else
			::ProgramBreak_AC("what kind of section is it anyway?");
#endif
	}
}

//----------------------------------------------------------------------------------------
// TEditionDocument::Close: 
//----------------------------------------------------------------------------------------

void TEditionDocument::Close()
{
	short poseResult = cancel;
	long changeCount;

	changeCount = GetChangeCount();
	
	// preflight the Close for the case in which the document's DATA is unchanged (the change
	// count is 0) but there are new publishers in the document
	if (!changeCount && fNewPublishers)
	{
		poseResult = PoseNewPublishersAlert();
		if (poseResult == cancel)
			::ThrowException_AC(noErr, messageCancelled);
	}
	else if (changeCount && fAskOnClose)
	{
		poseResult = PoseSaveDialog();
		if (poseResult == cancel)
			::ThrowException_AC(noErr, messageCancelled);
	}

	Changed(mClosed,this);

	if (poseResult == kYesButton)
		SaveDocument(cClose);				// Will fail if unable to save 
	else if (poseResult == kNoButton)
		Abandon();

	// Must never be called for a document related to a view in the Clipboard.
	// Why is this???
	for (CWindowIterator iter(this); iter.Current(); ++iter)
	{
		(*iter).Close();
		if ((*iter).GetFreeOnClosing())
			delete iter.Current();
	}
}

//----------------------------------------------------------------------------------------
// TEditionDocument::PoseNewPublishersAlert: 
//----------------------------------------------------------------------------------------

short TEditionDocument::PoseNewPublishersAlert()
{
	short returnVal = kNoButton;

	::ThrowIfOSErr_AC(MAInteractWithUser());

	CString_AC reason(static_cast<ResNumber>(kIDBuzzString), gDispatcher->GetDone() ? bzQuitting : bzClosing);

	ParamText(CStr255_AC(fTitle), CStr255_AC(reason), gEmptyString, gEmptyString);
	
	CTempUseResFile_AC tempUseResFile(gApplicationRefNum);
	returnVal = MacAppAlert(phNewPublisherAlert, NULL);
	
	return returnVal;
}

//----------------------------------------------------------------------------------------
// TEditionDocument::PoseMultPublishersAlert: 
//----------------------------------------------------------------------------------------

short TEditionDocument::PoseMultPublishersAlert(TSection* aSection)
{
	short returnVal = kNoButton;

	::ThrowIfOSErr_AC(MAInteractWithUser());

	CStr255_AC name(aSection->GetEditionName());

	ParamText(name, gEmptyString, gEmptyString, gEmptyString);
	
	CTempUseResFile_AC tempUseResFile(gApplicationRefNum);
	returnVal = MacAppAlert(phMultPublisherWrn, NULL);
	
	return returnVal;
}

//----------------------------------------------------------------------------------------
// TEditionDocument::PoseSavingMultPublishersAlert: 
//----------------------------------------------------------------------------------------

short TEditionDocument::PoseSavingMultPublishersAlert(TSection* aSection)
{
	short returnVal = kNoButton;

	::ThrowIfOSErr_AC(MAInteractWithUser());

	CString_AC	name(aSection->GetEditionName());

	ParamText(CStr255_AC(name), CStr255_AC(fTitle), gEmptyString, gEmptyString);
	
	CTempUseResFile_AC tempUseResFile(gApplicationRefNum);
	returnVal = MacAppAlert(phSavingMultPublisherWrn, NULL);
	
	return returnVal;
}

//----------------------------------------------------------------------------------------
// TEditionDocument::Abandon: 
//----------------------------------------------------------------------------------------

void TEditionDocument::Abandon()
{
	for (CSectionIterator iter(this); iter.Current(); ++iter)
		if ((*iter).GetSectionType() == stPublisher)
		{
			// if publisher is *new* and it hasn't been saved yet,
			// delete the edition container file 
			if (dynamic_cast_or_throw_AC(TPublisher*,iter.Current())->GetNewSection())
				dynamic_cast_or_throw_AC(TPublisher*,iter.Current())->DeleteEditionFile();
		}
	
	fNewPublishers = false;						// no new publishers any more

	TFileBasedDocument::Abandon();
}

//----------------------------------------------------------------------------------------
// TEditionDocument::DoNeedDiskSpace: 
//----------------------------------------------------------------------------------------

void TEditionDocument::DoNeedDiskSpace(TFile*	itsFile,
									   long&	dataForkBytes,
									   long&	rsrcForkBytes) const
{
	TFileBasedDocument::DoNeedDiskSpace(itsFile, dataForkBytes, rsrcForkBytes);

	rsrcForkBytes += kRsrcTypeOverhead + kRsrcOverhead +
						sizeof(EditionDocSettings) + strlen(kEditionDocRsrcName) + kLengthByte;
	
	// if there are any sections to write, add in type overhead for alis', 'sect', and 'DESG'
	CSectionIterator iter(this);
	if (iter.Current())
		rsrcForkBytes += (3 * kRsrcTypeOverhead);

	for (; iter.Current(); ++iter)
		(*iter).DoNeedDiskSpace(dataForkBytes, rsrcForkBytes);
}

//----------------------------------------------------------------------------------------
// TEditionDocument::DoAddSectionBehavior: 
//----------------------------------------------------------------------------------------

void TEditionDocument::DoAddSectionBehavior(TView* itsView)
// a convenience method supplied for the convenience of the user
{
	if (itsView)
	{
		TBehavior* itsBehavior = itsView->GetBehaviorWithIdentifier(kSectionBehavior);
		if (!itsBehavior)
			itsView->AddBehavior(TH_new TSectionBehavior(kSectionBehavior));
	}
}

//----------------------------------------------------------------------------------------
// TEditionDocument::DoNewPublisher: 
//----------------------------------------------------------------------------------------

void TEditionDocument::DoNewPublisher()
{
	OSErr				err;
	TDesignator*		itsDesignator;
	NewPublisherReply	reply;

	// set up the reply record 
	err = GetLastEditionContainerUsed(&(reply.container));
	if ((err != noErr) && (err != fnfErr))		// allow fnfErr 
		::ThrowIfOSErr_AC(err);

	// Determine what the new edition name is going to be.
	CString_AC	newName(GetNextEditionName());
	Size		maxNameSize = sizeof(StrFileName) - 1;	// This could be either 63 or 255.
	CString_AC::size_type	strLength = Min_AC(maxNameSize, newName.size());
	reply.container.theFile.name[0] = strLength;
	BlockMove_AC(reinterpret_cast<const void*>(newName.c_str()),
				 reinterpret_cast<void*>(reply.container.theFile.name[1]),
				 strLength);

	reply.usePart = false;						// always set this to false 

	// create the preview 
	itsDesignator = GetUserSelection();
	::ThrowIfNULL_AC(itsDesignator);

	DoMakePreview(itsDesignator, reply.previewFormat, reply.preview);

	try
	{
		DoNewPublisherDialog(reply);			// query the user 
	}
	catch(CException_AC& theException)
	{
		DoCatchMessage_AC(theException);
		DisposeOfPreview(reply);
		throw;
	}
	
	
	DisposeOfPreview(reply);

	if (!reply.canceled)
	{
		if (!reply.replacing)
			::ThrowIfOSErr_AC(CreateEditionContainerFile(&(reply.container.theFile), GetEditionCreatorSignature(), reply.container.theFileScript));

		try
		{
			SectionHandle sectionH = NULL;
			TPublisher* aPublisher = NULL;
			TDesignator* newDesignator = NULL;
			
			// Prepare for call to NewSection
			short newSectionID = GetUniqueSectRsrcID();
	
			CFSSpec_AC aFSSpec;
			FSSpecPtr aFSSpecPtr = NULL;						// can pass in NULL to NewSection 
			TFile* aFile = GetFile();
			if (aFile && (aFile->HasValidFileSpec()))
			{
				aFSSpec = aFile->GetFileSpec();
				aFSSpecPtr = &aFSSpec;
			}
	
			// Call NewSection (which calls RegisterSection for us)
			err = NewSection(&(reply.container), aFSSpecPtr, stPublisher, newSectionID, pumOnSave, &sectionH);
			if ((err != noErr) && (err != multiplePublisherWrn) && (err != notThePublisherWrn))
				::ThrowIfOSErr_AC(err);
	
			try
			{
				// publisher owns its designator -- so clone it
				newDesignator = static_cast<TDesignator*>(itsDesignator->Clone());
		
				// Create the publisher object, add it to our list of sections,
				// mark it as changed, and publish it to disk.
				
				aPublisher = DoMakePublisher(newDesignator, sectionH, newSectionID);
				if ((err == multiplePublisherWrn) || (err == notThePublisherWrn))
					PoseMultPublishersAlert(aPublisher);
		
				AddSectionAndBorder(aPublisher);
				aPublisher->MarkAsChanged();
				aPublisher->Publish(aFile);
				
			}
			catch(CException_AC& theException)
			{
				DoCatchMessage_AC(theException);
				if (aPublisher)
					delete aPublisher;
				else
				{
					delete newDesignator;
					if (sectionH && (IsRegisteredSection(sectionH) == noErr))
						UnRegisterSection(sectionH);	// Ignore the warnings.
				}
				throw;
			}
			
		}
		catch(CException_AC& theException)
		{
			DoCatchMessage_AC(theException);
			err = DeleteEditionContainerFile(&(reply.container.theFile));
			throw;
		}
		

		// let the edition document know that there is a new publisher 
		fNewPublishers = true;
	}
}

//----------------------------------------------------------------------------------------
// TEditionDocument::DoMakePreview: 
//----------------------------------------------------------------------------------------

void TEditionDocument::DoMakePreview(TDesignator*	itsDesignator,
									 FormatType&	previewFormat,
									 Handle&		preview)
{
	preview = NULL;
	previewFormat = GetPublishPreference();

	if (previewFormat == kTextType_AC || previewFormat == kPictType_AC || previewFormat == kSoundType_AC)
	{
		CTempHandle_AC tempPreview(NewPermHandle(0));

		DoWriteData(previewFormat, itsDesignator, &THandleStream(tempPreview, 6));
		
		preview = tempPreview.release();
	}
}

//----------------------------------------------------------------------------------------
// TEditionDocument::DisposeOfPreview: 
//----------------------------------------------------------------------------------------

void TEditionDocument::DisposeOfPreview(NewPublisherReply& reply)
{
	if (reply.previewFormat == kPictType_AC)
		reply.preview = (Handle)DisposeIfPicHandle((PicHandle) reply.preview);
	else if (reply.previewFormat == kTextType_AC)
		reply.preview = ::DisposeIfHandle_AC(reply.preview);
}

//----------------------------------------------------------------------------------------
// TEditionDocument::GetPublishPreference: 
//----------------------------------------------------------------------------------------

FormatType TEditionDocument::GetPublishPreference()
{
	return kTextType_AC;						// by default, prefer to publish 'TEXT'
                                                // over 'PICT'
}

//----------------------------------------------------------------------------------------
// TEditionDocument::DoMakePublisher: 
//----------------------------------------------------------------------------------------

TPublisher* TEditionDocument::DoMakePublisher(TDesignator*	itsDesignator,
											  SectionHandle	itsSectionHandle,
											  short			itsSectionID)
{
	return TH_new TPublisher(this, itsDesignator, itsSectionHandle, itsSectionID);
}

//----------------------------------------------------------------------------------------
// TEditionDocument::DoNewPublisherDialog: 
//----------------------------------------------------------------------------------------

void TEditionDocument::DoNewPublisherDialog(NewPublisherReply& reply)
{
	// override this method if you decide to use the NewPublisherExpDialog instead 
	::ThrowIfOSErr_AC(MAInteractWithUser()); 

	gClipboardMgr->AboutToLoseControl(true);	// so scrap gets converted
	::ThrowIfOSErr_AC(NewPublisherDialog(&reply));
	gClipboardMgr->RegainControl(true);			// so scrap gets converted
}

//----------------------------------------------------------------------------------------
// TEditionDocument::DoNewSubscriber: 
//----------------------------------------------------------------------------------------

void TEditionDocument::DoNewSubscriber()
{
	NewSubscriberReply reply;
	OSErr err = GetLastEditionContainerUsed(&(reply.container));// fill in the reply 

	if ((err != noErr) && (err != fnfErr))		// allow fnfErr 
		::ThrowIfOSErr_AC(err);
	reply.formatsMask = GetSubscriberFormatsMask();// set up the formatsMask 
	DoNewSubscriberDialog(reply);

	if (!reply.canceled)
	{
		short newSectionID = GetUniqueSectRsrcID();
		// create a new section handle 
		CFSSpec_AC aFSSpec;
		FSSpecPtr aFSSpecPtr = NULL;
		TFile* aFile = GetFile();
		if (aFile && (aFile->HasValidFileSpec()))
		{
			aFSSpec = aFile->GetFileSpec();
			aFSSpecPtr = &aFSSpec;
		}
		SectionHandle sectionH;
		::ThrowIfOSErr_AC(NewSection(&(reply.container), aFSSpecPtr, stSubscriber, newSectionID, sumAutomatic, &sectionH));
		// NewSection calls RegisterSection for us 

		// create a TDesignator for the TSubscriber object 
		TDesignator* aDesignator = GetUserSelection();
		if (aDesignator)
			aDesignator = static_cast<TDesignator*>(aDesignator->Clone());// the subscriber owns the designator

		// create a TSubscriber object, add it to our list of sections, and mark it as changed
		TSubscriber* aSubscriber = DoMakeSubscriber(aDesignator, sectionH, newSectionID);
		AddSectionAndBorder(aSubscriber);
		aSubscriber->MarkAsChanged();
	}
}

//----------------------------------------------------------------------------------------
// TEditionDocument::DoMakeSubscriber: 
//----------------------------------------------------------------------------------------

TSubscriber* TEditionDocument::DoMakeSubscriber(TDesignator*	itsDesignator,
												SectionHandle	itsSectionHandle,
												short			itsSectionID)
{
	return TH_new TSubscriber(this, itsDesignator, itsSectionHandle, itsSectionID);
}

//----------------------------------------------------------------------------------------
// TEditionDocument::DoNewSubscriberDialog: 
//----------------------------------------------------------------------------------------

void TEditionDocument::DoNewSubscriberDialog(NewSubscriberReply& reply)
{
	// override this method if you decide to use the NewSubscriberExpDialog instead 
	::ThrowIfOSErr_AC(MAInteractWithUser()); 

	gClipboardMgr->AboutToLoseControl(true);		// so scrap gets converted
	::ThrowIfOSErr_AC(NewSubscriberDialog(&reply));		// pose the new subscriber dialog 
	gClipboardMgr->RegainControl(true);			// so scrap gets converted
}

//----------------------------------------------------------------------------------------
// TEditionDocument::DoPublisherOptions: 
//----------------------------------------------------------------------------------------

void TEditionDocument::DoPublisherOptions(TPublisher* aPublisher)
{
	SectionOptionsReply reply;

	reply.sectionH = aPublisher->GetSectionHandle();
	DoPublisherOptionsDialog(reply);
	if (!reply.canceled)
	{
		if (reply.changed)
			aPublisher->MarkAsChanged();

		if (reply.action == sectionWriteMsgID)
			aPublisher->Publish(GetFile());
		else if (reply.action == sectionCancelMsgID)
			PostCommand(TH_new TSectionCancelEventCommand(cCancelPublisher, this, aPublisher));
	}
}

//----------------------------------------------------------------------------------------
// TEditionDocument::DoPublisherOptionsDialog: 
//----------------------------------------------------------------------------------------

void TEditionDocument::DoPublisherOptionsDialog(SectionOptionsReply& reply)
{
	// override this method if you decide to use the SectionOptionsExpDialog instead 
	::ThrowIfOSErr_AC(MAInteractWithUser()); 

	gClipboardMgr->AboutToLoseControl(true);		// so scrap gets converted
	::ThrowIfOSErr_AC(SectionOptionsDialog(&reply));
	gClipboardMgr->RegainControl(true);			// so scrap gets converted
}

//----------------------------------------------------------------------------------------
// TEditionDocument::DoSubscriberOptions: 
//----------------------------------------------------------------------------------------

void TEditionDocument::DoSubscriberOptions(TSubscriber* aSubscriber)
{
	SectionOptionsReply reply;

	reply.sectionH = aSubscriber->GetSectionHandle();
	DoSubscriberOptionsDialog(reply);
	if (!reply.canceled)
	{
		if (reply.changed)
			aSubscriber->MarkAsChanged();

		if (reply.action == sectionReadMsgID)
			aSubscriber->Subscribe();
		else if (reply.action == 'goto')
			aSubscriber->OpenPublisher();
		else if (reply.action == sectionCancelMsgID)
			PostCommand(TH_new TSectionCancelEventCommand(cCancelSubscriber, this, aSubscriber));
	}
}

//----------------------------------------------------------------------------------------
// TEditionDocument::DoSubscriberOptionsDialog: 
//----------------------------------------------------------------------------------------

void TEditionDocument::DoSubscriberOptionsDialog(SectionOptionsReply& reply)
{
	// override this method if you decide to use the SectionOptionsExpDialog instead 
	::ThrowIfOSErr_AC(MAInteractWithUser()); 

	gClipboardMgr->AboutToLoseControl(true);	// so scrap gets converted
	::ThrowIfOSErr_AC(SectionOptionsDialog(&reply));
	gClipboardMgr->RegainControl(true);			// so scrap gets converted
}

//----------------------------------------------------------------------------------------
// TEditionDocument::DoSetupMenus: 
//----------------------------------------------------------------------------------------

void TEditionDocument::DoSetupMenus()
{
	TFileBasedDocument::DoSetupMenus();

	if (fNewPublishers)						// there are new publishers! 
	{
		Enable(cSave, true);
		Enable(cRevert, true);
	}

	Enable(cCreatePublisher, CanPublishSelection());
	Enable(cSubscribeTo, CanSubscribe());

	TSection * aSection = GetSelectedSection();
	if (aSection)
	{
		Enable(cOptions, true);
		if (aSection->GetSectionType() == stPublisher)
			SetIndividualCommandName(cOptions, kIDBuzzString, bzPublisherOptions);
		else if (aSection->GetSectionType() == stSubscriber)
			SetIndividualCommandName(cOptions, kIDBuzzString, bzSubscriberOptions);
#if qDebug
		else
			::ProgramBreak_AC("what kind of section is it anyway?");
#endif
	}

	Enable(cBorders, true);
	SetMenuState(cBorders, kIDBuzzString, bzShowBorders, bzHideBorders, fShowSectionBorders);

	EnableCheck(cStopAllEditions, true, fStopAllEditions);
}

//----------------------------------------------------------------------------------------
// TEditionDocument::GetNextEditionName: 
//----------------------------------------------------------------------------------------

CString_AC TEditionDocument::GetNextEditionName() const
// GetNextEditionName returns a string containing the name of a new edition.  The default
// behavior is to grab the 'untitled' string and plug in an edition number.  The edition
// number is then incremented.
//
// Call?		As needed.  MacApp calls this whenever a new publisher is created.
// Override?	As desired.  You would override this if you wanted to create a more
//				complex edition name.
{
	CString_AC				name(static_cast<ResNumber>(kIDBuzzString), bzUntitled);
	CString_AC::size_type	preInsert;
	CString_AC::size_type	constChars;
	CString_AC				newName(name);

	// We go through the trouble of calling GetSubstitutionMetrics (as opposed
	// to just calling DoSubstitution) so that we do not unnecessarily
	// increment the edition number.
	if (name.GetSubstitutionMetrics(preInsert, constChars))
	{
		CString_AC	numStr;
		stringprintf(numStr, "%d", fNextEditionNumber++);
		newName = name.DoSubstitution(numStr, preInsert, constChars);
	}
	
	return newName;
}

//----------------------------------------------------------------------------------------
// TEditionDocument::GetSubscriberFormatsMask: 
//----------------------------------------------------------------------------------------

SignedByte TEditionDocument::GetSubscriberFormatsMask()
{
	// Return a mask corresponding to the edition format type to display within the
    // subscriber dialog box. This mask may consist of as many types as are supported in
    // the application. Construct the mask as follows:
	//  GetSubscriberFormatsMask = [kPICTformatMask] [+] [kTextformatMask [+] [ksndFormatMask]

	SignedByte returnVal = 0;

	if (GetPublishPreference() == kTextType_AC)
		returnVal = kTEXTformatMask;
	else if (GetPublishPreference() == kPictType_AC)
		returnVal = kPICTformatMask;
	else if (GetPublishPreference() == kSoundType_AC)
		returnVal = ksndFormatMask;
	
	return returnVal;
}

//----------------------------------------------------------------------------------------
// TEditionDocument::GetUniqueSectRsrcID: 
//----------------------------------------------------------------------------------------

const short kFirstRsrcID	= 1000;
const short kLastRsrcID		= 32767;
const short kBitsInArray	= kLastRsrcID - kFirstRsrcID;

short TEditionDocument::GetUniqueSectRsrcID()
{
	short counter = 0;
	Size arraySize = (kBitsInArray / sizeof(Byte)) + 1;
	Ptr aPtr = NewPermPtr(arraySize);
	bool foundNewID;

	BlockZero_AC(aPtr, arraySize);			// zero it out
	
	for (CSectionIterator iter(this); iter.Current(); ++iter)
	{
		if ((*iter).GetRsrcID() >= kFirstRsrcID)
			BitSet(aPtr, (*iter).GetRsrcID() - kFirstRsrcID);
		else
		{
#if qDebug
			::ProgramBreak_AC("problem with section rsrc id");
#endif
		}
	}

	while (BitTst(aPtr, counter) && (counter < kBitsInArray))
		++counter;

	foundNewID =!BitTst(aPtr, counter);			// see if we got a new rsrc id 

	aPtr = ::DisposeIfPtr_AC(aPtr);					// dispose of the array 

	if (!foundNewID)
		::ThrowException_AC(minErr, 0);

	return (counter + kFirstRsrcID);			// return the new sect rsrc id 
}

//----------------------------------------------------------------------------------------
// TEditionDocument::DoPostMakeViews: 
//----------------------------------------------------------------------------------------

void TEditionDocument::DoPostMakeViews(bool forPrinting)
{
	// The case that we're concerned with here is the TApplication::OpenOld case, in which
    // our DoRead method will get called before there are any views. This method provides
    // a way for borders to be added to views "after the fact" to handle the OpenOld case.
    // The document will have been read in (DoRead), the views created (DoMakeViews) and
    // finally the post create method called (DoPostMakeViews) at which point the borders
    // can then be safely added.

	if (!forPrinting)
		for (CSectionIterator iter(this); iter.Current(); ++iter)
			DoAddBorder(iter);

	TFileBasedDocument::DoPostMakeViews(forPrinting);
}

//----------------------------------------------------------------------------------------
// TEditionDocument::DoAddBorder: 
//----------------------------------------------------------------------------------------

void TEditionDocument::DoAddBorder(TSection* aSection)
{
	#pragma unused (aSection)
	// subclasses should override this to create a border to adorn this section
}

//----------------------------------------------------------------------------------------
// TEditionDocument::DoAdjustBorder: 
//----------------------------------------------------------------------------------------

void TEditionDocument::DoAdjustBorder(TSection* aSection)
{
	#pragma unused (aSection)
	// subclasses should override this to create a border to adorn this section
}

//----------------------------------------------------------------------------------------
// TEditionDocument::DoDeleteBorder: 
//----------------------------------------------------------------------------------------

void TEditionDocument::DoDeleteBorder(TSection* aSection)
{
	#pragma unused (aSection)
	// subclasses should override this to remove the border adorning this section
}

//----------------------------------------------------------------------------------------
// TEditionDocument::IsBorderShown: 
//----------------------------------------------------------------------------------------

bool TEditionDocument::IsBorderShown(TSection* aSection)
{
	return !aSection->IsCanceled() ? fShowSectionBorders || GetSelectedSection() == aSection : false;
}

//----------------------------------------------------------------------------------------
// TEditionDocument::IsSectionSelected: 
//----------------------------------------------------------------------------------------

bool TEditionDocument::IsSectionSelected(TSection* aSection)
// !!! should really be called TEditionDocument::IsSectionInSelection
{
	bool returnVal = false;

	if (aSection && !aSection->IsCanceled() && aSection->GetDesignator())
	{
		TDesignator* userSelection = GetUserSelection();
		if (userSelection)
			returnVal = userSelection->IsContained(aSection->GetDesignator()) != kNotContained;
	}

	return returnVal;
}

//----------------------------------------------------------------------------------------
// TEditionDocument::AddSection: 
//----------------------------------------------------------------------------------------

void TEditionDocument::AddSection(TSection* aSection)
// AddSection adds the specified publisher or subscriber object to a list 
// of the document’s sections. This method prevents the publisher or subscriber 
// from being added to the list twice.
//
// aSection:	Specifies the publisher or subscriber section object.
//
// Call?		Seldom. MacApp calls this method for you when a publisher 
//				or subscriber is created for the document.
// Override?	As needed. Override this method to take application-specific 
//				actions necessary to add a section. For example, override this 
// 				method to register a subscriber as being dependent on a change in the
// 				document or to register a document as being dependent on a publisher.
{
	// Protect against double installation 
	if (!fSectionList.GetIdentityItemNo(aSection))// doesn't already exist in list 
			fSectionList.Insert(aSection);
	
	// add the section to the section mgr's list of registered sections
	TSectionMgr* aSectionMgr = dynamic_cast_AC(TSectionMgr*, gDispatcher->GetBehaviorWithIdentifier(kSectionMgrBehaviorID));
	if (aSectionMgr)
		aSectionMgr->fSectionList.Insert(aSection);
}

//----------------------------------------------------------------------------------------
// TEditionDocument::AddSectionAndBorder: 
//----------------------------------------------------------------------------------------

void TEditionDocument::AddSectionAndBorder(TSection* aSection)
// AddSectionAndBorder adds the specified publisher or subscriber object to 
// a list of the document’s sections. This method prevents the publisher or 
// subscriber from being added to the list twice. 
// It also calls the document’s DoAddBorder method to add a border.
// For example, MacApp calls this method when it creates a new publisher or 
// subscriber.
//
// aSection:	Specifies the publisher or subscriber section object.
//
// Call?		As needed, when the view hierarchy has already been 
//				created and you know which view to attach the border to.
// Override?	Seldom. Override your document’s AddSection and 
//				DoAddBorder methods instead.
{
	AddSection(aSection);
	// notify the document to create a border for this section
	DoAddBorder(aSection);
}

//----------------------------------------------------------------------------------------
// TEditionDocument::RemoveSection: 
//----------------------------------------------------------------------------------------

void TEditionDocument::RemoveSection(TSection* aSection)
{
		fSectionList.Delete(aSection);

	// add the section to the section mgr's list of registered sections
	TSectionMgr* aSectionMgr = dynamic_cast_AC(TSectionMgr*, gDispatcher->GetBehaviorWithIdentifier(kSectionMgrBehaviorID));
	if (aSectionMgr)
		aSectionMgr->fSectionList.Delete(aSection);
}

//----------------------------------------------------------------------------------------
// TEditionDocument::CancelSection: 
//----------------------------------------------------------------------------------------

void TEditionDocument::CancelSection(TSection* aSection, bool cancel)
// CancelSection cancels the specified publisher or subscriber, or uncancels 
// it. This method invokes the section’s CancelSection and either removes or
// adds the border.
//
// aSection:	Specifies the section to be cancelled or uncancelled.
// cancel:		True if unregistering the section with the Edition Manager.
//
// Call?		As needed.
// Override?	Seldom.
{
	aSection->CancelSection(cancel);
	
	// notify the document to add or delete a border for this section
	if (cancel)
		DoDeleteBorder(aSection);
	else
		DoAddBorder(aSection);
}

//----------------------------------------------------------------------------------------
// TEditionDocument::GetSelectedSection: 
//----------------------------------------------------------------------------------------

TSection* TEditionDocument::GetSelectedSection()
{
	TSection* selectedSection = NULL;

	for (CSectionIterator iter(this); iter.Current(); ++iter)
		if (IsSectionSelected(iter))
			if (!selectedSection)
				selectedSection = iter;
			else
			{	// in this case, >1 sections are in the user selection, so need to
				// determine which section is the preferred selected section
				if ((*iter).GetDesignator()->GetSize() < selectedSection->GetDesignator()->GetSize())
					selectedSection = iter;
			}
	
	return selectedSection;
}

//----------------------------------------------------------------------------------------
// TEditionDocument::SetSectionBorders: 
//----------------------------------------------------------------------------------------

void TEditionDocument::SetSectionBorders(bool state, bool invalidate)
{
	if (fShowSectionBorders != state)
	{
		fShowSectionBorders = state;

		if (invalidate)
			for (CWindowIterator iter(this); iter.Current(); ++iter)
				(*iter).ForceRedraw();
	}
	//••• This could be a lot smarter if we had a reference to the view that had the borders.
	// Something like the following could be done instead:
	//		CAdornerIterator iter(fViewWithBorders);
	//		for (CWindowIterator iter(this); iter.Current; ++iter)
	//			if ((iter->fIdentifier == kPublisherAdornerID) || (iter->fIdentifier == kSubscriberAdornerID))
	//				iter->InvalidateAdorner(fCellsView);
}

//----------------------------------------------------------------------------------------
// TEditionDocument::SetStopAllEditions: 
//----------------------------------------------------------------------------------------

void TEditionDocument::SetStopAllEditions(bool state)
{
	if (fStopAllEditions != state)
	{
		fStopAllEditions = state;
		if (!state)								// if turning "off" stop editions 
			for (CSectionIterator iter(this); iter.Current(); ++iter)
				if ((*iter).GetSectionType() == stSubscriber)
				{
					dynamic_cast_or_throw_AC(TSubscriber*,iter.Current())->SubscribeIfNewer();
				}
	}
}

//========================================================================================
// CLASS TNewSubscriberCommand
//========================================================================================

//----------------------------------------------------------------------------------------
// TNewSubscriberCommand::TNewSubscriberCommand: 
//----------------------------------------------------------------------------------------

TNewSubscriberCommand::TNewSubscriberCommand(CommandNumber	itsCommandNumber,
											 TDocument*		itsDocument)
	:	TCommand(itsCommandNumber, itsDocument, kCantUndo, kCausesChange, itsDocument)
{
}

//----------------------------------------------------------------------------------------
// TNewSubscriberCommand destructor
//----------------------------------------------------------------------------------------

TNewSubscriberCommand::~TNewSubscriberCommand()
{
}

//----------------------------------------------------------------------------------------
// TNewSubscriberCommand::DoIt: 
//----------------------------------------------------------------------------------------

void TNewSubscriberCommand::DoIt()
{
	dynamic_cast_or_throw_AC(TEditionDocument*,fContext)->DoNewSubscriber();
}

//========================================================================================
// CLASS TSectionBorderCommand
//========================================================================================

//----------------------------------------------------------------------------------------
// TSectionBorderCommand::TSectionBorderCommand: 
//----------------------------------------------------------------------------------------

TSectionBorderCommand::TSectionBorderCommand(CommandNumber	itsCommandNumber,
											 TDocument*		itsDocument)
	:	TCommand(itsCommandNumber,
				 itsDocument->GetContext(itsCommandNumber),
				 kCanUndo,
				 kCausesChange,
				 itsDocument),
		fShowSectionBorders(!dynamic_cast_or_throw_AC(TEditionDocument*,itsDocument)->GetShowSectionBorders())
{
}

//----------------------------------------------------------------------------------------
// TSectionBorderCommand destructor
//----------------------------------------------------------------------------------------

TSectionBorderCommand::~TSectionBorderCommand()
{
}

//----------------------------------------------------------------------------------------
// TSectionBorderCommand::DoIt: 
//----------------------------------------------------------------------------------------

void TSectionBorderCommand::DoIt()
{
	TEditionDocument* doc = dynamic_cast_or_throw_AC(TEditionDocument*,fContext);
	
	doc->SetSectionBorders(fShowSectionBorders, kInvalidate);
}

//----------------------------------------------------------------------------------------
// TSectionBorderCommand::UndoIt: 
//----------------------------------------------------------------------------------------

void TSectionBorderCommand::UndoIt()
{
	TEditionDocument* doc = dynamic_cast_or_throw_AC(TEditionDocument*,fContext);
	
	doc->SetSectionBorders(!fShowSectionBorders, kInvalidate);
}

//========================================================================================
// CLASS TStopAllEditionsCommand
//========================================================================================

//----------------------------------------------------------------------------------------
// TStopAllEditionsCommand::TStopAllEditionsCommand: 
//----------------------------------------------------------------------------------------

TStopAllEditionsCommand::TStopAllEditionsCommand(CommandNumber itsCommandNumber, TDocument* itsDocument) 
	:	TCommand(itsCommandNumber, itsDocument->GetContext(itsCommandNumber), kCanUndo, kCausesChange, itsDocument),
		fStopAllEditions(!dynamic_cast_or_throw_AC(TEditionDocument*,itsDocument)->GetStopAllEditions()) 
{
}

//----------------------------------------------------------------------------------------
// TStopAllEditionsCommand destructor
//----------------------------------------------------------------------------------------

TStopAllEditionsCommand::~TStopAllEditionsCommand()
{
}

//----------------------------------------------------------------------------------------
// TStopAllEditionsCommand::DoIt: 
//----------------------------------------------------------------------------------------

void TStopAllEditionsCommand::DoIt()
{
	TEditionDocument* doc = dynamic_cast_or_throw_AC(TEditionDocument*,fContext);
	doc->SetStopAllEditions(fStopAllEditions);
}

//----------------------------------------------------------------------------------------
// TStopAllEditionsCommand::UndoIt: 
//----------------------------------------------------------------------------------------

void TStopAllEditionsCommand::UndoIt()
{
	TEditionDocument* doc = dynamic_cast_or_throw_AC(TEditionDocument*,fContext);
	doc->SetStopAllEditions(!fStopAllEditions);
}


//========================================================================================
// CLASS TSectionAdorner
//========================================================================================

MA_DEFINE_CLASS(TSectionAdorner);

//----------------------------------------------------------------------------------------
// TSectionAdorner::TSectionAdorner: 
//----------------------------------------------------------------------------------------

TSectionAdorner::TSectionAdorner(IDType		itsID,
								 TSection*	itsSection,
								 RgnHandle	itsBorderRegion)
	:	TAdorner(itsID, kFreeOnDeletion),
		fSection(itsSection),
		fBorderRegion(itsBorderRegion)
{
}

//----------------------------------------------------------------------------------------
// TSectionAdorner destructor
//----------------------------------------------------------------------------------------

TSectionAdorner::~TSectionAdorner()
{
}

//----------------------------------------------------------------------------------------
// TSectionAdorner::InvalidateAdorner: 
//----------------------------------------------------------------------------------------

void TSectionAdorner::InvalidateAdorner(TView* itsView)

{
	if (itsView && fBorderRegion)
		itsView->Invalidate(fBorderRegion);
}

//----------------------------------------------------------------------------------------
// TSectionAdorner::DrawBorder: 
//----------------------------------------------------------------------------------------

void TSectionAdorner::DrawBorder(const Pattern& whichPattern)

{
	PenNormal();
	PenMode(patXor);
	PenSize(3, 3);
	PenPat(&whichPattern);

	// Don't use FillRgn since it ignores the penMode. 
	FrameRgn(fBorderRegion);
}

//========================================================================================
// CLASS TSubscriberAdorner
//========================================================================================

MA_DEFINE_CLASS(TSubscriberAdorner);

//----------------------------------------------------------------------------------------
// TSubscriberAdorner destructor
//----------------------------------------------------------------------------------------

TSubscriberAdorner::~TSubscriberAdorner()
{
}

//----------------------------------------------------------------------------------------
// TSubscriberAdorner::DoHighlightSelection: 
//----------------------------------------------------------------------------------------

void TSubscriberAdorner::DoHighlightSelection(TView*			itsView,
											  const CViewRect&	aViewRect,
											  HLState			fromHL,
											  HLState			toHL)
{
	#pragma unused (aViewRect)

	if (itsView)
	{
		TEditionDocument* itsDocument = dynamic_cast_AC(TEditionDocument*, itsView->GetDocument());
		if (itsDocument && (itsDocument->IsBorderShown(fSection)))
		{
			if ((fromHL == hlOn) && ((toHL == hlDim) || (toHL == hlOff)))
				DrawBorder(qd.dkGray);			// turning off 
			else if (((fromHL == hlOff) || (fromHL == hlDim)) && (toHL == hlOn))
				DrawBorder(qd.dkGray);			// turning on 
		}
	}
}


//========================================================================================
// CLASS TPublisherAdorner
//========================================================================================

MA_DEFINE_CLASS(TPublisherAdorner);

//----------------------------------------------------------------------------------------
// TPublisherAdorner destructor
//----------------------------------------------------------------------------------------

TPublisherAdorner::~TPublisherAdorner()
{
}

//----------------------------------------------------------------------------------------
// TPublisherAdorner::DoHighlightSelection: 
//----------------------------------------------------------------------------------------

void TPublisherAdorner::DoHighlightSelection(TView*				itsView,
											 const CViewRect&	aViewRect,
											 HLState			fromHL,
											 HLState			toHL)
{
	#pragma unused (aViewRect)

	if (itsView)
	{
		TEditionDocument* itsDocument = dynamic_cast_AC(TEditionDocument*, itsView->GetDocument());
		if ((itsDocument) && (itsDocument->IsBorderShown(fSection)))
		{
			if ((fromHL == hlOn) && ((toHL == hlDim) || (toHL == hlOff)))
				DrawBorder(qd.gray);			// turning off 
			else if (((fromHL == hlOff) || (fromHL == hlDim)) && (toHL == hlOn))
				DrawBorder(qd.gray);			// turning on 
		}
	}
}


//========================================================================================
// CLASS TSectionBehavior
//========================================================================================

MA_DEFINE_CLASS(TSectionBehavior);

//----------------------------------------------------------------------------------------
// TSectionBehavior destructor
//----------------------------------------------------------------------------------------

TSectionBehavior::~TSectionBehavior()
{
}

//----------------------------------------------------------------------------------------
// TSectionBehavior::DoMouseCommand: 
//----------------------------------------------------------------------------------------

bool TSectionBehavior::DoMouseCommand(CViewPoint&		theMouse,
									  TToolboxEvent*	event,
									  CPoint_AC			hysteresis)
{
	bool returnVal = false;

	TView* itsView = dynamic_cast_or_throw_AC(TView*,fOwner);
	
	// itsView->Focus();
	CPoint_AC qdMouse(itsView->ViewToQD(theMouse));

	for (CAdornerIterator iter(itsView); iter.Current() && !returnVal; ++iter)
		if ((iter->GetIdentifier() == kPublisherAdornerID) || (iter->GetIdentifier() == kSubscriberAdornerID))
		{
			TEditionDocument* itsEditionDocument = dynamic_cast_or_throw_AC(TEditionDocument*,itsView->GetDocument());
			
			TSectionAdorner* itsSectionAdorner = dynamic_cast_or_throw_AC(TSectionAdorner*,iter.Current());
			
			TSection* itsSection = itsSectionAdorner->GetSection();
			if ((event->GetClickCount() == 1) && (PtInRgn(qdMouse, itsSectionAdorner->GetBorderRegion())))
			{
				TDesignator* theSelection = itsSection->GetDesignator();
				if (theSelection)
				{
					theSelection = static_cast<TDesignator*>(theSelection->Clone());
					if (theSelection)
					{
						TView* view = dynamic_cast_or_throw_AC(TView*,fOwner);
						
						view->SetUserSelection(theSelection);
					}
				}
				returnVal =true;
			}
			else if ((event->GetClickCount() > 1) && (PtInRgn(qdMouse, itsSectionAdorner->GetBorderRegion())))
			{
				if (itsSection->GetSectionType() == stPublisher)
					itsEditionDocument->DoPublisherOptions(dynamic_cast_or_throw_AC(TPublisher*,itsSection));
				else
				{
					if (event->IsOptionKeyPressed())
					{
						TSubscriber* subscriber = dynamic_cast_or_throw_AC(TSubscriber*,itsSection);
						
						subscriber->OpenPublisher();
					}
					else
						itsEditionDocument->DoSubscriberOptions(dynamic_cast_or_throw_AC(TSubscriber*,itsSection));
				}
				returnVal = true;
			}
		}
	
	return returnVal || TBehavior::DoMouseCommand(theMouse, event, hysteresis);
}

//----------------------------------------------------------------------------------------
// TSectionBehavior::GetStandardSignature: 
//----------------------------------------------------------------------------------------

IDType TSectionBehavior::GetStandardSignature() const
{
	return kSectionBehavior;
}

//----------------------------------------------------------------------------------------
// End of UEditionDocument.cpp

/*
	Historical Change Record:
		----- R11 -----
		06/27/96	Make conditional tests implicit as in if(x) instead of if(x != 0).
		06/26/96	Changed nil back to NULL.
		06/26/96	Install release marker.  Scope many globals.  Change TRUE/FALSE/NULL.
		06/26/96	==/!=NULL to implicit tests, except in the case of assignment to or passing/returning as bool/bool.
		06/20/96	[1290382] (Strings) CStr255_AC could have constructor for STR# id & index
		06/19/96	SCpp and MrCpp can't handle declarations in the expression portion of while loops
							so we just changed them all to for loops
		05/09/96	Adjust the Failure Handling macros to allow for easy switching to native exceptions.
		 5/08/96	Create and use CFSSpec_AC. You should search/replace in your code to switch to
		 					CFSSpec_AC.
		05/02/95	Call FreeIfObject, don't call Free directly since it will eventually be removed.
		04/30/96	Can't inline TSubscriber/TPublisherAdorner::IFoo b/c we don't have knowledge
							that TSubscriber/TPublisher is a TSection in the interface.
		04/30/96	Make all constructors use initialization lists if they weren't already
							doing do. Switch several more empty constructors to inlines.
		04/23/96	Use CTempObject/Handle/Region/Ptr, etc.
		04/23/96	Update iterators to be OD stylish.
		04/18/96	More Use post-increment with iterators in while loops
		04/18/96	Use post-increment with iterators in while loops
		04/16/96	Use "while" style iteration
		----- R10 -----
		03/27/96	Switch last remaining Str255s to CStr255s_AC
		03/26/96	Cleanup references to gEmptyString and ""
		  1/4/96	Get rid of TFileHandler. 
		 12/8/95	Bring back MAInteractWithUser. 
							Split up includes for modular MacApp. 
		----- 3.3 -----
		11/03/95	Add a couple of calls to InteractWithUser.
		11/01/95	Use kMacAppTimeout in calls to InteractWithUser.
		10/31/95	Add CurResFile_AC, Fix UseResFile_AC to avoid unnecessary UseResFile calls.
		10/11/95	Add TSectionBehavior::GetStandardSignature.
		10/10/95	Call gDispatcher->InteractWithUser.
		----- 3.3b1 -----
		 7/18/95	PRAGMA_ALIGN_SUPPORTED. 
		 6/12/95	Support TAppleEvent::fgIdleProc
		 5/15/95	Remove pre-System 7 support. 
		 4/12/95	Use #if instead of if qDebug. 
		 4/12/95	Base class constructors called from mem initializers don't
		 					rely on default arguments.
		 3/21/95	ARM 8.4.3 x& cannot be initialized with volatile x. 
		 3/17/95	MAVolatile. 
		 3/13/95	Change Free methods to destructors. 
		 2/28/95	Use MA_REGISTER_SIGNATURE instead of macroDontDeadStrip
							and RegisterStdType. 
		 2/17/95	Use MAAddResource. 
		 1/26/95	Add fAskOnClose. 
		 9/23/94	Modified to support new TScriptEventDispatcher
							object.
*/