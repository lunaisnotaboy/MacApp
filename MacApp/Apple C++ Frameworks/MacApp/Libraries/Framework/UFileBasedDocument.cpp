//----------------------------------------------------------------------------------------
// UFileBasedDocument.cpp
// Copyright � 1984-2001 by Apple Computer, Inc. All rights reserved.
//
//	Our sincere thanks to George Varga & Juergen A. Mayrbaeurl of ARTMA Biomedical who
//  allowed us to pattern MacApp's Navigation Services support on their recommendations.
//----------------------------------------------------------------------------------------

/*
	Change History
		08/15/01	Test gPrintHandler in DoReadPrintInfo before retrieving the
					saved print info.
		06/15/01	Initialize validRecord to false when making a NavReplyRecord. 
		05/07/01	Comment out pragma messages for Carbon. 
		04/07/01	[PB] taking address of temporary. 
					Converting NULL to non-pointer type. 
		03/19/01	Use template version of BlockZero_AC
		03/19/01	Use BlockZero_AC, instead of BlockSet_AC(,,0)
		01/24/01	Include UAppleEvents.h, UScripting.h and AERegistry.h only if
					qAppleEventAware.
		01/11/01	Use CString_AC instead of CStr255_AC.
		01/02/01	Update copyright.
		12/12/00	Changed CTempDesc_AC initialization in RequestFileNameByNavSvcs
					and CommitSave.
		12/09/00	Workaround a gcc code-gen problem in RequestFileNameByNavSvcs.
		11/27/00	Back out casting of gEmptyString--no longer needed.
		11/10/00	Cosmetic.
		11/09/00	[PB] Change initialization order to match declaration. 
					[PB] Suppress GCC warnings about unused return variables. 
		11/03/00	[C] Don�t include StandardFile.h.  [PB] Cast gEmptyString
					for ParamText.
		11/01/00	[PB] Include MacErrors instead of Errors.
		10/23/00	Cast gEmptyString in DoWriteFinderString.
					[C] Do not implement SFPutParms.  Reworked NavPutFileParms so that
					it does not need SFPutParms.
		10/16/00	Check itsFile, not fFile, to see if it is locked in ExchangeFile.
		09/06/00	Added embedded documentation.
		09/01/00	Stripped dead code.  Cosmetic and pragma unused.
		08/15/00	Add a convenience macro for generating temp UPP classes.
		07/31/00	[W] Conditionalize implementation of CheckDiskSpace and
					DebugCheckEstimate.  Removed a this->.
		06/14/00	Eliminate unnecessary GetRegionCode calls. Call ACS::AddResource
					instead of MAAddResource.
		05/23/00	[2279264] Remove false from ProgramReport_AC.
		04/18/00	Include UPrintMgr.h instead of UPrintHandler.h.
		04/18/00	Just call fPrintInfo->GetSize directly in DoNeedDiskSpace.
		04/17/00	fPrintInfo is now a CRefCountingPtr_AC.
		04/11/00	Removed itsFile from the call to GetSavePrintInfoSize.  Added pragma
					unused (forPrinting) in a couple of places.
		02/28/00	MakeTempFile would improperly set tempFile upon failure to find temporary folder.
		02/22/00	[W] Do not call SetProxyIconByFile in UpdateWindowIcon.
		12/08/99	Took out MA_DEFINE_CLONE for TFileBasedDocument.  Added check for
					user cancelled RequestFileNameByNavSvcs.  Handle exception thrown
					when compiling using MrC in MakeAppleEvents.
		11/04/99	TFileBasedDocument::SFPutParms: CopyFrom needs a length.
		10/25/99	Have debug ::Close() now call GetClipboardDocument() instead of directly accessing
					the field variables.
		10/07/99	Use TemplateTempUPP_AC instead of TmplTmpRtnDescrptr.
		09/23/99	Carbon: Change TmplTmpRtnDescrptr to TmplTmpOpaqueRtnDescrptr.
		07/27/99	Removed qAllegro test in FileHasBeenSaved and SetTitle and around
					AddView, UpdateWindowIcons and UpdateWindowIcon.
		03/24/99	Update copyright notice.
		03/19/99	Rename GetMessage to GetExceptionMessage
					since it conflicts with a Windows define.
		03/19/99	Rename CreateFile to CreateCFile, DeleteFile to DeleteCFile,
					since they conflict with a Windows define.
		03/18/99	Removed '&' on parms to a variety of Toolbox calls.
		03/02/99	[2306530] Replace boolean test of fFile with fFile.IsNULL().
		02/04/99	[C] Cleaned up some Carbon messages and unused.
		01/15/99	CAEDesc_AC is now in ACS.
		11/13/98	[2279281] Use qAllegro in place of qPowerPC && (UNIVERSAL_INTERFACES_VERSION >= 0x0320).
					[2279264] Fixed improper parms passed to ProgramReport_AC.
		11/12/98	[2279244] Replaced dynamic_cast with dynamic_cast_AC.
		10/28/98	Include Navigation stuff only if qNavigation.
		10/15/98	[2279099] Changed logic in SaveFile in case of a new file
					so that the file is reopened if the file is to be kept open.
		10/27/98	Carbonize - no Std File in Carbon
*/

#ifndef __UFILEBASEDDOCUMENT__
#include "UFileBasedDocument.h"
#endif

// MacApp

#ifndef __PLATFORMMEMORY__
#include "PlatformMemory.h"
#endif

#if qAppleEventAware
	#ifndef __UAPPLEEVENTS__
	#include "UAppleEvents.h"
	#endif
#endif

#ifndef __UAPPLICATION__
#include "UApplication.h"
#endif

#ifndef __UCLIPBOARDMGR__
#include "UClipboardMgr.h"
#endif

#ifndef __UDESIGNATOR__
#include "UDesignator.h"
#endif

#ifndef __UDISPATCHER__
#include "UDispatcher.h"
#endif

#ifndef __UERRORMGR__
#include "UErrorMgr.h"
#endif

#ifndef __UFILE__
#include "UFile.h"
#endif

#ifndef __UFILESTREAM__
#include "UFileStream.h"
#endif

#ifndef __UMACAPPGLOBALS__
#include "UMacAppGlobals.h"
#endif

#ifndef __UMACAPPUTILITIES__
#include "UMacAppUtilities.h"
#endif

#ifndef __UMEMORY__
#include "UMemory.h"
#endif

#ifndef __UMENUMGR__
#include "UMenuMgr.h"
#endif

#ifndef __UPOINTEROBJECT__
#include "UPointerObject.h"
#endif

#ifndef __UPrintMgr__
#include "UPrintMgr.h"
#endif

#if qAppleEventAware
	#ifndef __USCRIPTING__
	#include "UScripting.h"
	#endif
#endif

#ifndef __USTREAM__
#include "UStream.h"
#endif

#ifndef __USUBSTITUTION__
#include "USubstitution.h"
#endif

#ifndef __UVIEW__
#include "UView.h"
#endif

#ifndef __UWINDOW__
#include "UWindow.h"
#endif

// ACS

#ifndef __CIterator_AC__
#include "CIterator_AC.h"
#endif

#ifndef __CList_AC__
#include "CList_AC.h"
#endif

#ifndef __CMultiLocal_AC__
#include "CMultiLocal_AC.h"
#endif

#ifndef __CPoint_AC__
#include "CPoint_AC.h"
#endif

#ifndef __CRect_AC__
#include "CRect_AC.h"
#endif

#ifndef __CString_AC__
#include "CString_AC.h"
#endif

#ifndef __CTempGrafPort_AC__
#include "CTempGrafPort_AC.h"
#endif

#ifndef __StdStringUtils_AC__
#include "StdStringUtils_AC.h"
#endif

#ifndef __TemplateUPP_AC__
#include "TemplateUPP_AC.h"
#endif

// Toolbox

#if qAppleEventAware
	#ifndef __AEREGISTRY__
	#include <AERegistry.h>
	#endif
#endif

#ifndef __FOLDERS__
#include <Folders.h>
#endif

#ifndef __MACERRORS__
#include <MacErrors.h>
#endif

#ifndef __RESOURCES__
#include <Resources.h>
#endif

#if !qCarbon
	#ifndef __STANDARDFILE__
	#include <StandardFile.h>
	#endif
#endif

#ifndef __TOOLUTILS__
#include <ToolUtils.h>
#endif

//========================================================================================
// GLOBAL Functions
//========================================================================================

static void RecoveryDeleteFile(TFile* theSaveFile);
static void DeleteIfFile(TFile* itsFile);

//----------------------------------------------------------------------------------------
// RecoveryDeleteFile
//----------------------------------------------------------------------------------------

void RecoveryDeleteFile(TFile* theSaveFile)
{
	if (theSaveFile)
	{
		OSErr recoverErr = theSaveFile->CloseFile();
#if qDebugMsg
		if (recoverErr != noErr)
			ProgramReport_AC("In recovery: error from CloseFile is %d\n", recoverErr);
#endif

		recoverErr = theSaveFile->DeleteCFile();
#if qDebugMsg
		if ((recoverErr != noErr) && (recoverErr != fnfErr))
			ProgramReport_AC("In recovery: error from DeleteCFile is %d\n", recoverErr);
#endif
	}
}

//----------------------------------------------------------------------------------------
// DeleteIfFile
//----------------------------------------------------------------------------------------

void DeleteIfFile(TFile* itsFile)
{
	OSErr err = itsFile->DeleteCFile();
	if ((err != noErr) && (err != fnfErr))
		ThrowError_AC(err);
}

//========================================================================================
// CLASS TFileBasedDocument
//========================================================================================

//----------------------------------------------------------------------------------------
// TFileBasedDocument constructor
//----------------------------------------------------------------------------------------

TFileBasedDocument::TFileBasedDocument(TFile* itsFile, OSType itsScrapType)
	:	TDocument(),
		fFile(itsFile),
		fHowToSave(svtAskUser),
		fScrapType(itsScrapType),							// need constant kNoScrapType
		fFileExists(false)
{
	if (!fFile)
		fFile = DoMakeFile(cNew); // ��� NOTE: this won't call the overloaded DoMakeFile... need to change protocol!!!
}

//----------------------------------------------------------------------------------------
// TFileBasedDocument::DoMakeFile:
//----------------------------------------------------------------------------------------

TFile* TFileBasedDocument::DoMakeFile(CommandNumber itsCommandNumber)
{
	return gDispatcher->DoMakeFile(itsCommandNumber);
}

//----------------------------------------------------------------------------------------
// TFileBasedDocument::Free:
//----------------------------------------------------------------------------------------

TFileBasedDocument::~TFileBasedDocument()
{
	if (!fFile.IsNULL())
		CloseFile();
}

//----------------------------------------------------------------------------------------
// TFileBasedDocument::DoInitialState:
//----------------------------------------------------------------------------------------

void TFileBasedDocument::DoInitialState()
{
	// don't need to call TDocument's method because it is empty
}

//----------------------------------------------------------------------------------------
// TFileBasedDocument::DoSetupMenus:
//----------------------------------------------------------------------------------------

void TFileBasedDocument::DoSetupMenus()
{
	TDocument::DoSetupMenus();

	Enable(cSaveAs, true);
	Enable(cSaveCopy, true);
	if (IsChanged())
	{
		Enable(cSave, true);
		Enable(cRevert, FileExists());
	}
}

//----------------------------------------------------------------------------------------
// TFileBasedDocument::FindDocument:
//----------------------------------------------------------------------------------------

bool TFileBasedDocument::FindDocument(TFile* aFile)
{
	return FileAlreadyOpen(aFile);
}

//----------------------------------------------------------------------------------------
// TFileBasedDocument::CheckFile:
//----------------------------------------------------------------------------------------

void TFileBasedDocument::CheckFile(ResNumber rsrcId, short rsrcIndex,  bool reverting)
// CheckFile is intended to specify actions to take if the document�s disk
// file has been changed by another application. TFileBasedDocument::CheckFile
// displays an alert if the file has changed. If the file is being reverted
// to its previous version on disk, I/O errors and file types that don�t
// match the original type cause failure.
//
// rsrcID:		specifies the 'STR#' resource containing strings used in the alert
// 				displayed if the file has changed since it was last opened by the application.
// rsrcIndex:	specifies the index for the string in the 'STR#' resource.
// reverting:	TRUE if the file is being restored to match the last version saved on the disk.
//
// Call?		Seldom. MacApp calls CheckFile for you when the user
//				issues a Save or Revert command.
// Override?	Seldom, unless you change the way MacApp handles
//				the saving of document files.
{
	OSErr err = FileChanged(reverting);	// don't care about the file type if saving
	if (err == errFileChanged)
	{
		ThrowIfOSErr_AC(MAInteractWithUser());
		CString_AC s(rsrcId, rsrcIndex);
		ParamText(CStr255_AC(fTitle), CStr255_AC(s), gEmptyString, gEmptyString);

		if (MacAppAlert(phFileChanged, NULL) == cancel)
			ThrowException_AC(noErr, messageCancelled);
	}
	else if ((err != noErr) && reverting)
		ThrowException_AC(err, 0);
}

//----------------------------------------------------------------------------------------
// TFileBasedDocument::Close:
//----------------------------------------------------------------------------------------

void TFileBasedDocument::Close()
{
	long changeCount;
	short poseResult = kYesButton;

#if qDebug
	if (gClipboardMgr->GetClipboardDocument() == this)
		::ProgramBreak_AC("TFileBasedDocument::Close: Attempt to close clipboard document.");
#endif

	changeCount = GetChangeCount();
	if (changeCount && fAskOnClose)
	{
		poseResult = PoseSaveDialog();
		if (poseResult == cancel)
			ThrowException_AC(noErr, messageCancelled);
	}

	if (changeCount)
	{
		if (poseResult == kYesButton)
			SaveDocument(cClose);				// Will fail if unable to save
		else if (poseResult == kNoButton)
			Abandon();
	}

	// Convert the document if necessary
	if (!fConversionParams.IsNULL())
		fConversionParams->CommitSave();
	TDocument::Close();
}

//----------------------------------------------------------------------------------------
// TFileBasedDocument::DoNeedDiskSpace:
//----------------------------------------------------------------------------------------

void TFileBasedDocument::DoNeedDiskSpace(TFile*		itsFile,
										 long&		dataForkBytes,
										 long&		rsrcForkBytes) const
{
	if (itsFile->HasRsrcFork())
	{
		CString_AC theName(gDispatcher->GetApplicationName());
		CString_AC theMessage(GetFinderMessage());

		if (!theMessage.empty())
			rsrcForkBytes += kRsrcTypeOverhead + kRsrcOverhead + theMessage.size() + 1;
		else if (!theName.empty())
			rsrcForkBytes += kRsrcTypeOverhead + kRsrcOverhead + theName.size() + 1;

		if (fSavePrintInfo && !fPrintInfo.IsNULL())
			rsrcForkBytes += kRsrcTypeOverhead
							+ kRsrcOverhead
							+ fPrintInfo->GetSize(itsFile->HasRsrcFork());
		if (fSaveUserSelection)
		{
			TDesignator* theSelection = GetUserSelection();
			if (theSelection)
			{
				TCountingStream aStream;
				aStream.WriteStreamObject(theSelection);
				rsrcForkBytes += kRsrcTypeOverhead + kRsrcOverhead + aStream.GetSize();
			}
		}
		rsrcForkBytes += kRsrcFileOverhead;
	}
	else if (fSavePrintInfo && !fPrintInfo.IsNULL())
		dataForkBytes += fPrintInfo->GetSize(itsFile->HasRsrcFork());
}

//----------------------------------------------------------------------------------------
// TFileBasedDocument::RegainControl:
//----------------------------------------------------------------------------------------

void TFileBasedDocument::RegainControl()
{
	if (ValidateFileSpec())
	{
		SetTitle(GetFileName());
	}
}

//----------------------------------------------------------------------------------------
// TFileBasedDocument::DoRead:
//----------------------------------------------------------------------------------------

void TFileBasedDocument::DoRead(TFile* aFile, bool forPrinting)
{
	if (fSavePrintInfo)
		DoReadPrintInfo(aFile, forPrinting);

	if (fSaveUserSelection)
		DoReadSelection(aFile, forPrinting);

#if qAttachable
	if (fSaveAttachedScript)
		DoReadScript(aFile, forPrinting);
#endif
}

//----------------------------------------------------------------------------------------
// TFileBasedDocument::DoReadPrintInfo:
//----------------------------------------------------------------------------------------

void TFileBasedDocument::DoReadPrintInfo(TFile* aFile, bool forPrinting)
{
	#pragma unused (forPrinting)

	if (FileExists() && TPrintHandler::gPrintHandler != NULL)
		fPrintInfo = TPrintHandler::gPrintHandler->RestorePrintInfo(aFile, aFile->HasRsrcFork());
}

#if qAttachable

//----------------------------------------------------------------------------------------
// TFileBasedDocument::DoReadScript:
//----------------------------------------------------------------------------------------

void TFileBasedDocument::DoReadScript(TFile* aFile, bool forPrinting)
{
	#pragma unused (forPrinting)

	if (HasAppleScript_AC() && FileExists())
	{
		if (aFile->HasRsrcFork())
		{
			if (aFile->IsRsrcForkOpen())
			{
				CTempDesc_AC scriptDesc;

				scriptDesc.ReadFrom(aFile, kScriptInfoRsrcType, kScriptInfoRsrcID);
				if (scriptDesc.descriptorType != typeNull)
					SetOSAScript(scriptDesc);
			}
		}
		else
		{
			TFileStream fileStream(aFile);
			ReadOSAScript(&fileStream);
		}
	}
}

#endif // qAttachable

//----------------------------------------------------------------------------------------
// TFileBasedDocument::DoReadSelection:
//----------------------------------------------------------------------------------------

void TFileBasedDocument::DoReadSelection(TFile* aFile, bool forPrinting)
{
	Handle theSelectionRsrc = NULL;
	if (FileExists() && aFile->HasRsrcFork() && aFile->IsRsrcForkOpen())
	{
		CTempUseResFile_AC tempUseResFile(aFile->GetRsrcRefNum());
		if (ResError() == noErr)
			theSelectionRsrc = CMultiLocale_AC::Get1Resource(kDesignatorResType, kSelectionRsrcID);
	}

	if (theSelectionRsrc && !forPrinting)
	{
		CTempHandleLock_AC tempHandleLock(theSelectionRsrc, eDontMoveHi, eReleaseIt, eDontLockIt);
		// read in the associated designator
		THandleStream aHandleStream(theSelectionRsrc, 10);

		bool wasValid;
		CAutoPtr_AC<TDesignator> aUserSelection = dynamic_cast_or_throw_AC(TDesignator*,aHandleStream.ReadStreamObject(wasValid));

		if (wasValid && aUserSelection)
		{
			SetUserSelection(aUserSelection);
			aUserSelection.release();
		}
#if qDebugMsg
		else
			::ProgramBreak_AC("TFileBasedDocument::DoReadSelection: Unknown TDesignator for selection.");
#endif
	}
}

//----------------------------------------------------------------------------------------
// TFileBasedDocument::AboutToSaveFile:
//----------------------------------------------------------------------------------------

void TFileBasedDocument::AboutToSaveFile(TFile*			theSaveFile,
										 CommandNumber	itsCmd,
										 bool&			makingCopy)
// AboutToSaveFile is intended to specify the actions to take before a document
// is saved to disk. TFileBasedDocument::AboutToSaveFile is an empty method and
// must be overridden to specify these actions.
//
// theSaveFile:	Specifies the file that is about to be saved.
// itsCmd:		Specifies the command number representing the command that caused
// 				AboutToSave to be called.
// makingCopy:	True when making a copy of the original file.
//
// Call?		Seldom. MacApp calls this method for you after the
//				Standard File dialog and before deciding to save in place or save via a temporary file.
// Override?	As needed.
{
	#pragma unused (theSaveFile, itsCmd, makingCopy)
}

//----------------------------------------------------------------------------------------
// TFileBasedDocument::DoWrite:
//----------------------------------------------------------------------------------------

void TFileBasedDocument::DoWrite(TFile* aFile, bool makingCopy)
{
	DoWriteFinderString(aFile, makingCopy);

	if (fSavePrintInfo && !fPrintInfo.IsNULL())
		DoWritePrintInfo(aFile, makingCopy);

	if (fSaveUserSelection)
		DoWriteSelection(aFile, makingCopy);

#if qAttachable
	if (fSaveAttachedScript)
		DoWriteScript(aFile, makingCopy);
#endif
}

//----------------------------------------------------------------------------------------
// TFileBasedDocument::DoWriteFinderString:
//----------------------------------------------------------------------------------------

void TFileBasedDocument::DoWriteFinderString(TFile* aFile, bool makingCopy)
{
	#pragma unused (makingCopy)

	if (aFile->HasRsrcFork())
	{
		CString_AC	theName(gDispatcher->GetApplicationName());
		CString_AC	theMessage(GetFinderMessage());

		if (!theMessage.empty())
		{
			bool		oldTemp = TemporaryAllocation(false);
			StringHandle messageHandle = NewString(CStr255_AC(theMessage));
			TemporaryAllocation(oldTemp);
			ThrowIfNULL_AC(reinterpret_cast<Handle>(messageHandle));

			try
			{
				CMultiLocale_AC::AddResource(reinterpret_cast<Handle>(messageHandle), kFinderStringType, kFinderMessageID, CStr255_AC(gEmptyString));
				ThrowIfResError_AC();
			}
			catch(CException_AC& theException)
			{
				DoCatchMessage_AC(theException);
				messageHandle = reinterpret_cast<StringHandle>(::DisposeIfHandle_AC(reinterpret_cast<Handle>(messageHandle)));
				throw;
			}

		}
		else if (!theName.empty())
		{
			bool oldTemp = TemporaryAllocation(false);
			StringHandle nameHandle = NewString(CStr255_AC(theName));
			TemporaryAllocation(oldTemp);
			ThrowIfNULL_AC(reinterpret_cast<Handle>(nameHandle));

			try
			{
				CMultiLocale_AC::AddResource(reinterpret_cast<Handle>(nameHandle), kFinderStringType, kFinderApplicationNameID, CStr255_AC(gEmptyString));
				ThrowIfResError_AC();
			}
			catch(CException_AC& theException)
			{
				DoCatchMessage_AC(theException);
				nameHandle = reinterpret_cast<StringHandle>(::DisposeIfHandle_AC(reinterpret_cast<Handle>(nameHandle)));
				throw;
			}

		}
	}
}

//----------------------------------------------------------------------------------------
// TFileBasedDocument::DoWritePrintInfo:
//----------------------------------------------------------------------------------------

void TFileBasedDocument::DoWritePrintInfo(TFile* aFile, bool makingCopy)
{
	#pragma unused (makingCopy)

	if (fPrintInfo)
		fPrintInfo->Save(aFile, aFile->HasRsrcFork());
#if qDebug
	else
		::ProgramBreak_AC("TFileBasedDocument::DoWritePrintInfo: No print record in document!");
#endif
}

#if qAttachable

//----------------------------------------------------------------------------------------
// TFileBasedDocument::DoWriteScript:
//----------------------------------------------------------------------------------------

void TFileBasedDocument::DoWriteScript(TFile* aFile, bool makingCopy)
{
	#pragma unused (makingCopy)

	if (HasOSAScript())
	{
		if (aFile->HasRsrcFork())
		{
			CString_AC	resourceName;
			fOSAScript->WriteOSAScript(aFile, kScriptInfoRsrcType, kScriptInfoRsrcID, resourceName);
		}
		else
		{
			TFileStream fileStream(aFile);
			WriteOSAScript(&fileStream, typeOSAGenericStorage);
		}
	}
}

#endif // qAttachable

//----------------------------------------------------------------------------------------
// TFileBasedDocument::DoWriteSelection:
//----------------------------------------------------------------------------------------

void TFileBasedDocument::DoWriteSelection(TFile* aFile, bool makingCopy)
{
	#pragma unused (makingCopy)

	TDesignator* theSelection = GetUserSelection();
	if (theSelection && aFile->HasRsrcFork())
	{
		// allocate a handle for the resource
		CTempHandle_AC theSelectionRsrc(NewPermHandle(50)); // ���  what's this magic number?

		// write the user selection to the handle
		THandleStream aHandleStream(theSelectionRsrc, 10);

		// write out the associated designator
		aHandleStream.WriteStreamObject(theSelection);

		// add the new selection resource
		CMultiLocale_AC::AddResource(theSelectionRsrc, kDesignatorResType, kSelectionRsrcID, CStr255_AC(gEmptyString));
		ThrowIfResError_AC();
		theSelectionRsrc.release();
	}
}

//----------------------------------------------------------------------------------------
// TFileBasedDocument::CloseFile:
//----------------------------------------------------------------------------------------

void TFileBasedDocument::CloseFile()
// CloseFile closes the file associated with a document.
//
// Call?		As needed.
// Override?	Seldom.
{
	if (!fFile.IsNULL())
		fFile->CloseFile();
}

//----------------------------------------------------------------------------------------
// TFileBasedDocument::ReadDocument:
//----------------------------------------------------------------------------------------

void TFileBasedDocument::ReadDocument(bool forPrinting)
{
	fTitle = GetFileName();
	ReadFile(forPrinting);
	SetChangeCount(0);
}

//----------------------------------------------------------------------------------------
// TFileBasedDocument::ReadStationery:
//----------------------------------------------------------------------------------------

void TFileBasedDocument::ReadStationery(TFile* itsNewFile)
{
	ReadFile(kForDisplay);
	SetFile(itsNewFile);
	SetChangeCount(1);
}

//----------------------------------------------------------------------------------------
// TFileBasedDocument::RevertDocument:
//----------------------------------------------------------------------------------------

void TFileBasedDocument::RevertDocument()
{
	CAutoPtr_AC<TFileBasedDocument> tempObject(this);
	// Failure will Free the document since the data may not be in any state to redisplay

	try
	{
		CheckFile(kIDBuzzString, bzRevertAnyways, true);

			CommitLastCommand();

		FreeData();

		if (FileExists())
			ReadFile(kForDisplay);
		else
		{
			for (TemplateIterator_AC<TView*> iter(&fViewList); iter; ++iter)
			{
				TPrintHandler* itsPrintHandler = (*iter).GetPrintHandler();
				if (itsPrintHandler)
					itsPrintHandler->Reset();
			}

			DoInitialState();
		}

		SetChangeCount(0);
	}
	catch(CException_AC& theException)
	{
		DoCatchMessage_AC(theException);

		if (theException.GetError() == fnfErr)
			theException.SetError(errRevertFNF);

		if (!theException.GetExceptionMessage())
			gErrorParm3 = fTitle;

		ThrowNewMessage_AC(theException.GetError(), theException.GetExceptionMessage(), messageRevertFailed);
	}
	tempObject.release();
}

#if qAppleEventAware

//----------------------------------------------------------------------------------------
// TFileBasedDocument::GetSaveLocation
//----------------------------------------------------------------------------------------

void TFileBasedDocument::GetSaveLocation(CommandNumber itsCommandNumber, CAEDesc_AC& theSaveDesc)
// Creates an CAEDesc_AC describing where the document would be saved
{
	bool askForFilename = !FileExists() || ((itsCommandNumber != cSave) && (itsCommandNumber != cClose));
	bool makingCopy = itsCommandNumber == cSaveCopy;
	CAutoPtr_AC<TFile> theSaveFile(DoMakeFile(itsCommandNumber));

	CSaveOptions* options = NULL;
	if (askForFilename)
		RequestFileName(itsCommandNumber, makingCopy, theSaveFile, options);
	else
		theSaveFile->SpecifyWithFile(GetFile());

	delete options;			// We don't use them so we can throw them away.
	ThrowIfOSErr_AC(::AECreateDesc(typeFSS, theSaveFile->GetFileSpec(), sizeof(theSaveDesc), theSaveDesc));
}

#endif	// #if qAppleEventAware

//----------------------------------------------------------------------------------------
// TFileBasedDocument::MakeSaveCommand:
//----------------------------------------------------------------------------------------

TSaveCommand* TFileBasedDocument::MakeSaveCommand(CommandNumber itsCommandNumber)
{
	return TH_new TSaveFileDocCommand(this, itsCommandNumber);
}

#if qAppleEventAware
TSaveCommand* TFileBasedDocument::MakeSaveCommand(TAppleEvent* message,
												  TAppleEvent* reply,
												  CommandNumber itsCommandNumber)
{
	return TH_new TSaveFileDocCommand(this, message, reply, itsCommandNumber);
}
#endif

//----------------------------------------------------------------------------------------
// TFileBasedDocument::SaveDocument:
//----------------------------------------------------------------------------------------

void TFileBasedDocument::SaveDocument(CommandNumber itsCommandNumber)
{
	SaveFile(itsCommandNumber, NULL, NULL);
}

//----------------------------------------------------------------------------------------
// TFileBasedDocument::MakeCloseCommand:
//----------------------------------------------------------------------------------------

TCloseDocCommand* TFileBasedDocument::MakeCloseCommand(CommandNumber itsCommandNumber)
{
	return TH_new TCloseFileDocCommand(itsCommandNumber, this);
}

#if qAppleEventAware
TCloseDocCommand* TFileBasedDocument::MakeCloseCommand(TAppleEvent* message,
													   TAppleEvent* reply)
{
	return TH_new TCloseFileDocCommand(this, message, reply);
}
#endif

//----------------------------------------------------------------------------------------
// TFileBasedDocument::FileHasBeenSaved:
//----------------------------------------------------------------------------------------

void TFileBasedDocument::FileHasBeenSaved(TFile* inFile)
{
	AssertNotNULL_AC(inFile);

	CString_AC newName(inFile->GetName());

	SetChangeCount(0);

	if (fTitle != newName)
		SetTitle(newName);
	else // else if file type or location has been changed
		UpdateWindowIcons();
}

#if !qCarbon

//----------------------------------------------------------------------------------------
// TFileBasedDocument::SFPutParms:
//----------------------------------------------------------------------------------------

void TFileBasedDocument::SFPutParms(CommandNumber			itsCommandNumber,
									CString_AC&				prompt,
									CString_AC&				defaultName,
									ResNumber&				dlgID,
									CPoint_AC&				where,
									DlgHookYDProcPtr&		dlgHook,
									ModalFilterYDProcPtr&	modalFilter,
									short*&					activeList,
									ActivateYDProcPtr&		activateProc,
									StandardFileReply*		reply,
									void*&					yourDataPtr) const
{
	#pragma unused (reply)

	dlgID = 0; // Let the system decide
	where = kBestSystemLocation;

	short idx = 0;
	switch (itsCommandNumber)
	{
		case cSave:
		case cSaveAs:
			idx = bzSaveAs;
			break;

		case cSaveCopy:
			idx = bzSaveCopy;
			break;
	}

	if (idx)
		prompt = CString_AC(static_cast<ResNumber>(kIDBuzzString), idx);
	else
		prompt.empty();

	defaultName = GetTitle();

	if (itsCommandNumber == cSaveCopy)
	{
		// Substitute the 'copy' into the string.
		MAParamText("^FILENAME", defaultName);
		defaultName = CString_AC(static_cast<ResNumber>(kIDBuzzString), bzSaveCopyFileName);
		MAReplaceText(defaultName);
	}

	dlgHook = NULL;
	modalFilter = gModalFilterYDProcPtr;
	activeList = NULL;
	activateProc = NULL;
	yourDataPtr = NULL;
}

#endif		// !qCarbon

#if qNavigation

//----------------------------------------------------------------------------------------
// TFileBasedDocument::NavPutFileParms
//----------------------------------------------------------------------------------------

void TFileBasedDocument::NavPutFileParms(CommandNumber			itsCommandNumber,
										AEDesc*&				defaultLocation,
										NavReplyRecord&			reply,
										NavDialogOptions&		dialogOptions,
										NavEventProcPtr&		eventProc,
										NavCallBackUserData&	callBackUD,
										OSType&					fileType,
										OSType&					fileCreator) const
// NavPutFileParms returns the parameters needed by NavPutFile.
//
// itsCommandNumber:	The command number of the command that caused
//						NavPutFileParms to be called.
// defaultLocation:		Returns item that you will want to show when you open the dialog.  Defaults
//						to NULL.
// reply:				Not used.
// dialogOptions:		Returns the various options like dialog location on screen, allow
//						multiple files, etc.
// eventProc:			Returns a modal�dialog filter function that is used by the Navigation
//						Services.  Defaults to MacAppNavigationEventFilter.
// callBackUD:			Returns a pointer to optional data supplied by your application
//						and used by your callback routines.  Defaults to NULL.
// fileType:			Returns the type of the file you want to save.  This is used by
//						Navigation Services to show post conversion options.  Off by default
// fileCreator:			Returns this application's creator.
//
// Call?		Never, MacApp calls it for you.
// Override?	As needed.  If you override SFPutParms you should usually override this method
//				too.
{
	#pragma unused (reply, fileType, fileCreator)

	CString_AC				prompt;
	CString_AC				filename(GetTitle());

	short idx = 0;
	switch (itsCommandNumber)
	{
		case cSave:
		case cSaveAs:
			idx = bzSaveAs;
			break;

		case cSaveCopy:
			{
				idx = bzSaveCopy;

				// Substitute the 'copy' into the string.
				MAParamText("^FILENAME", filename);
				filename = CString_AC(static_cast<ResNumber>(kIDBuzzString), bzSaveCopyFileName);
				MAReplaceText(filename);
			}
			break;
	}

	if (idx)
		prompt = CString_AC(static_cast<ResNumber>(kIDBuzzString), idx);

	defaultLocation = NULL;
	eventProc = MacAppNavigationEventFilter;
	callBackUD = NULL;

	// fileType already includes the type of the file.  If you need to change it, override
	// this method or override DoMakeFile.

	// The creator also gets set to the default value.

	::NavGetDefaultDialogOptions(&dialogOptions);

	CString_AC appName(gApplication->GetApplicationName());
	appName.AsStr255(dialogOptions.clientName);
	filename.AsStr255(dialogOptions.savedFileName);
	prompt.AsStr255(dialogOptions.message);
	dialogOptions.location = kBestSystemLocation;
	dialogOptions.dialogOptionFlags &= ~kNavDontAddTranslateItems;	// Let user choose translation options
}

#endif

//----------------------------------------------------------------------------------------
// TFileBasedDocument::AddView:
//----------------------------------------------------------------------------------------

void TFileBasedDocument::AddView(TView* aView)
{
	TDocument::AddView(aView);

	TWindow* aWindow = dynamic_cast_AC(TWindow*, aView);
	if (aWindow)
		UpdateWindowIcon(aWindow);
}

//----------------------------------------------------------------------------------------
// TFileBasedDocument::UpdateWindowIcons:
//----------------------------------------------------------------------------------------

void TFileBasedDocument::UpdateWindowIcons()
{
	for (CWindowIterator iter(this); iter.Current(); ++iter)
		UpdateWindowIcon(iter.Current());
}

//----------------------------------------------------------------------------------------
// TFileBasedDocument::UpdateWindowIcon:
//----------------------------------------------------------------------------------------

void TFileBasedDocument::UpdateWindowIcon(TWindow* aWindow)
{
#if !qMSWindows
	aWindow->SetProxyIconByFile(GetFile());
#else
	#pragma unused (aWindow)
#endif
}

//----------------------------------------------------------------------------------------
// TFileBasedDocument::SetTitle:
//----------------------------------------------------------------------------------------

void TFileBasedDocument::SetTitle(const CString_AC& aTitle)
{
	TDocument::SetTitle(aTitle);
	UpdateWindowIcons();
	SetFileName(aTitle);
}

//----------------------------------------------------------------------------------------
// TFileBasedDocument::GetFinderMessage:
//----------------------------------------------------------------------------------------

CString_AC TFileBasedDocument::GetFinderMessage() const
{
	return CString_AC();
}

//----------------------------------------------------------------------------------------
// File Handling
//----------------------------------------------------------------------------------------

//----------------------------------------------------------------------------------------
// TFileBasedDocument::FileAlreadyOpen:
//----------------------------------------------------------------------------------------

bool TFileBasedDocument::FileAlreadyOpen(TFile* aFile)
{
	return fFileExists ? fFile->IsSameFile(aFile) : false;
}

//----------------------------------------------------------------------------------------
// TFileBasedDocument::FileChanged:
//----------------------------------------------------------------------------------------

OSErr TFileBasedDocument::FileChanged(bool checkType)
{
	HParamBlockRec pb;
	OSErr err = noErr;

	if (fFileExists)
	{
		err = fFile->GetFileInfo(pb);

		if (err == noErr)
		{
			if (checkType && (pb.fileParam.ioFlFndrInfo.fdType != fFile->GetCachedFileType()))
				err = errFTypeChanged;
			else if (fFile->IsModified())
				err = errFileChanged;
		}
	}

	return err;
}

//----------------------------------------------------------------------------------------
// TFileBasedDocument::FileExists:
//----------------------------------------------------------------------------------------

bool TFileBasedDocument::FileExists()
{
	return fFileExists;
}

//----------------------------------------------------------------------------------------
// TFileBasedDocument::GetFile:
//----------------------------------------------------------------------------------------

TFile* TFileBasedDocument::GetFile()
{
	return fFile;
}

//----------------------------------------------------------------------------------------
// TFileBasedDocument::SetFile:
//----------------------------------------------------------------------------------------

void TFileBasedDocument::SetFile(TFile* itsNewFile)
{
	CloseFile();
	fFile = itsNewFile;
	fFileExists = false;			// Until we are shown otherwise
}

//----------------------------------------------------------------------------------------
// TFileBasedDocument::GetFileName:
//----------------------------------------------------------------------------------------

CString_AC TFileBasedDocument::GetFileName() const
{
	CString_AC	fileName;
	if (!fFile.IsNULL())
		fileName = fFile->GetName();
	return fileName;
}

//----------------------------------------------------------------------------------------
// TFileBasedDocument::GetSaveInfo:
//----------------------------------------------------------------------------------------

bool TFileBasedDocument::GetSaveInfo(CommandNumber	aCommandNumber,
									 bool			copyFInfo,
									 CInfoPBRec&	cInfo) const
{
	#pragma unused (aCommandNumber)

	bool saveInfo = false;

	if (fFileExists && copyFInfo)
	{
		OSErr err = fFile->GetCatInfo(cInfo);
		if (err == noErr)
			saveInfo = true;
	}
	// Set the type and creator in case it has changed; the file might be on
	// a file server and someone else could have changed the document
	cInfo.hFileInfo.ioFlFndrInfo.fdType = fFile->GetCachedFileType();
	cInfo.hFileInfo.ioFlFndrInfo.fdCreator = fFile->GetCachedFileCreator();
	cInfo.hFileInfo.ioFlFndrInfo.fdFlags &= ~kIsStationery;

	return saveInfo;
}

//----------------------------------------------------------------------------------------
// TFileBasedDocument::GetTempName:
//----------------------------------------------------------------------------------------

CString_AC TFileBasedDocument::GetTempName() const
{
	CString_AC						fileName;
	const CString_AC::size_type		maxName = 31;					// maximum name size to generate
	const CString_AC::size_type		maxNumber = 10;					// maximum # digits of the random number
	const CString_AC::size_type		maxPrefix = maxName - maxNumber;

	CString_AC		tempName;
	unsigned long	ramdomNum;

	// If the file is untitled, use the application name.
	if (!fFile.IsNULL())
		tempName = fFile->GetName();

	if (tempName.empty())
		tempName = gDispatcher->GetApplicationName();

	fileName = tempName;

	// Check prefix length, and trim it down if too large.
	if (fileName.size() > maxPrefix)
		fileName.resize(maxPrefix);

	// Append a pseudo-random number.
	GetDateTime(&ramdomNum);
	ramdomNum = (ramdomNum ^ (TickCount() >> 16)) & 0x7FFF;	// don't have neg number
	CString_AC	randomString;
	stringprintf(randomString, "%d", ramdomNum);
	fileName += randomString;

	// Check name length, and trim it down if too large.
	if (fileName.size() > maxName)
		fileName.resize(maxName);
		
	return fileName;
}

//----------------------------------------------------------------------------------------
// TFileBasedDocument::ReadFile:
//----------------------------------------------------------------------------------------

void TFileBasedDocument::ReadFile(bool forPrinting)
{
	if (!fFile.IsNULL())
	{
		OSType itsType = 0;
		try
		{
			ThrowIfOSErr_AC(fFile->GetFileType(itsType));

			if (itsType != kFolderType_AC)
			{
				ThrowIfOSErr_AC(fFile->OpenFile());

				// Just in case the file was left open, reset to the beginning of the file
				fFile->SetDataMark(0, fsFromStart);
			}

			fFileExists = true;

			DoRead(fFile, forPrinting);
		}
		catch(CException_AC& theException)
		{
			DoCatchMessage_AC(theException);
			if (itsType != kFolderType_AC)
				CloseFile();
			throw;
		}

		// We normally close the file once we have finished reading it's data
		// into memory.
		if (itsType != kFolderType_AC)
			ThrowIfOSErr_AC(fFile->CloseFileIfNotKeptOpen());

		fFile->Modified();						// Set the modification date
	}
}

//----------------------------------------------------------------------------------------
// TFileBasedDocument::RequestFileName:
//----------------------------------------------------------------------------------------

void TFileBasedDocument::RequestFileName(CommandNumber		itsCommandNumber,
										 bool				makingCopy,
										 TFile*				aFile,
										 CSaveOptions*&		conversionParams) const
{
#if qCarbon
	RequestFileNameByNavSvcs(itsCommandNumber, makingCopy, aFile, conversionParams);
#else
#if qNavigation
	if (gApplication && ::NavServicesAvailable()
			&& gApplication->WantsNavigationServices())
		RequestFileNameByNavSvcs(itsCommandNumber, makingCopy, aFile, conversionParams);
	else
#endif
		RequestStdFileName(itsCommandNumber, makingCopy, aFile, conversionParams);
#endif
}

//----------------------------------------------------------------------------------------
// TFileBasedDocument::RequestStdFileName
//----------------------------------------------------------------------------------------

void TFileBasedDocument::RequestStdFileName(CommandNumber	itsCommandNumber,
										 	bool			makingCopy,
										 	TFile*			aFile,
										 	CSaveOptions*&	conversionParams) const
{
#if qCarbon
	#pragma unused (itsCommandNumber, makingCopy, aFile, conversionParams)
	//#pragma message ("TFileBasedDocument::RequestStdFileName: Need to add some kind of switch like qNavigation for StdFile.")
#else
	#pragma unused (makingCopy)

	CString_AC prompt;
	CString_AC filename;
	short dlgID;
	CPoint_AC dlgLoc;
	DlgHookYDProcPtr dlgHook;
	ModalFilterYDProcPtr modalFilter;
	short* activeList;
	ActivateYDProcPtr activateProc;
	void* yourDataPtr;
	StandardFileReply customReply;

	conversionParams = NULL;

	SFPutParms(itsCommandNumber, prompt, filename, dlgID, dlgLoc, dlgHook,
					 modalFilter, activeList, activateProc, &customReply, yourDataPtr);

	gRsrcCheck = 0;								// Force immediate check

	ThrowIfOSErr_AC(MAInteractWithUser());

	if (!yourDataPtr)
		yourDataPtr = &itsCommandNumber;

	gClipboardMgr->AboutToLoseControl(true);	// so scrap gets converted

	CTempDlgHookYDUPP		cpfDlgHook(dlgHook);
	CTempModalFilterYDUPP	cpfModalFilter(modalFilter);
	CTempActivateYDUPP 		cpfActivateProc(activateProc);

	CustomPutFile(CStr255_AC(prompt), CStr255_AC(filename), &customReply, dlgID, dlgLoc, cpfDlgHook, cpfModalFilter, activeList, cpfActivateProc, yourDataPtr);

	gClipboardMgr->RegainControl(true);			// so scrap gets converted

	bool goodReply = customReply.sfGood;
	if (goodReply)
		aFile->Specify(customReply.sfFile);		// Don't use SpecifyWithStandardFile
                                                // here since that would clobber the
                                                // filetype.
	if (goodReply)
	{
		// See if there is an open document with the same name.	If there is, tell it
		// we're trying to save it again, which will ordinarily result in failure.
		TDocument* otherDoc = gDispatcher->FindDocument(aFile);
		if (otherDoc)
			otherDoc->SaveAgain(itsCommandNumber, this);

		// Formerly, we did the actual deletion of the file here but now that
		// is postponed until the command is performed.  We assume that if we
		// make it to that point and there is a file in the way that it is
		// okay to delete it based on prior approval.
	}
	else
		ThrowException_AC(noErr, messageCancelled);			// user canceled

	conversionParams = TH_new CStdSaveOptions();
#endif	// non-Carbon code
}

#if qNavigation

//----------------------------------------------------------------------------------------
// TFileBasedDocument::RequestFileNameByNavSvcs
//----------------------------------------------------------------------------------------

void TFileBasedDocument::RequestFileNameByNavSvcs(CommandNumber		itsCommandNumber,
												  bool				makingCopy,
												  TFile*			aFile,
												  CSaveOptions*&	conversionParams) const
// Asks the user for a filename for the document. Calls TFileBasedDocument::NavPutFileParms
// and then ::NavPutFile.  Fails if the user clicks the Cancel button to end the put
// file dialog.
{
	#pragma unused (makingCopy)

	AEDesc*				defaultLocation;
	NavReplyRecord		reply;
	reply.validRecord = false;
	NavDialogOptions	dialogOptions;
	NavEventProcPtr		eventProc;
	NavCallBackUserData	callBackUD;
	OSType				fileType;
	OSType				fileCreator;

	conversionParams = NULL;

	fileType = aFile->GetCachedFileType();		// Either I pass in itsFile to NavPutFileParms or just put it here
	fileCreator = aFile->GetCachedFileCreator();

	NavPutFileParms(itsCommandNumber, defaultLocation, reply,
		dialogOptions, eventProc, callBackUD, fileType, fileCreator);

	gRsrcCheck = 0;								// Forces an immediate check.
	::ThrowIfOSErr_AC(::MAInteractWithUser());	// Make sure user interaction is okay.
	gClipboardMgr->AboutToLoseControl(true);	// So scrap gets converted

	CTempNavEventUPP cgfEventProc(eventProc);

	// Safety harness for NavSvcs which crashes if there is no current port.
	OSErr err = noErr;
	{
#if !qCarbon
		CTempGrafPort_AC tempPort(gWorkPort);
#else
		CTempGrafPort_AC tempPort(gWorkCPort);
#endif
		err = ::NavPutFile(defaultLocation, &reply, &dialogOptions,
								cgfEventProc, fileType, fileCreator, callBackUD);
	}
	CAutoPtr_AC<CSaveOptions> convOptions(TH_new CNavSvcsSaveOptions(reply));
			// Note: CNavSvcsSaveOptions will also convert the stationery flag

	if (defaultLocation)
		::AEDisposeDesc(defaultLocation);

	gClipboardMgr->RegainControl(true);			// So scrap gets reconverted

	bool goodReply = reply.validRecord;
	
	if (goodReply && noErr == err)
	{
		CAEDesc_AC directObj = reply.selection;
		CTempDesc_AC theItem(directObj.GetNthItem(1, typeFSS));
		CFSSpec_AC theFSSpec = theItem.GetFSSpec();
		aFile->Specify(theFSSpec);			// Don't use SpecifyWithNavReply
                                            // here since that would clobber the
											// filetype.
		aFile->SetScript(reply.keyScript);
	}

	if (err == userCanceledErr)
		ThrowException_AC(noErr, messageCancelled);

	::ThrowIfOSErr_AC(err);

	if (goodReply)
	{
		// See if there is an open document with the same name.	If there is, tell it
		// we're trying to save it again, which will ordinarily result in failure.
		TDocument* otherDoc = gDispatcher->FindDocument(aFile);
		if (otherDoc)
			otherDoc->SaveAgain(itsCommandNumber, this);

		// Formerly, we did the actual deletion of the file here but now that
		// is postponed until the command is performed.  We assume that if we
		// make it to that point and there is a file in the way that it is
		// okay to delete it based on prior approval.
	}
	else
		ThrowException_AC(noErr, messageCancelled);			// user canceled

	// On failure the reply is disposed by convOptions
	conversionParams = convOptions.release();
}

#endif

//----------------------------------------------------------------------------------------
// TFileBasedDocument::CheckDiskSpace:
//----------------------------------------------------------------------------------------

TFileBasedDocument::HowToSave TFileBasedDocument::CheckDiskSpace(TFile* theSaveFile,
																 unsigned long& neededBlocks) const
{
#if !qMSWindows
	HowToSave canSave = kDiskFull;

	// Get information about the volume saving to
	unsigned long freeBlocks = 0;
	ThrowIfOSErr_AC(theSaveFile->GetFreeBlocks(freeBlocks));

	// Don't fill the disk completely.
	--freeBlocks;

	// compute size needed to save document
	unsigned long blockSize;
	ThrowIfOSErr_AC(theSaveFile->GetBlockSize(blockSize));

	{
		long dataBytes = 0;
		long rsrcBytes = 0;
		DoNeedDiskSpace(theSaveFile, dataBytes, rsrcBytes);
		neededBlocks = NumBlocks(dataBytes, blockSize) + NumBlocks(rsrcBytes, blockSize);
	}

	// If there is enough space we're done.  Save the file by the method specified
	if (freeBlocks >= neededBlocks)
	{
		if ((fHowToSave == svtAskUser) || (fHowToSave == svtAlways))
			canSave = kSaveViaTemp;
	}

	// Is there enough space to save the file in place?
	if (canSave == kDiskFull)
	{
		// See if we can save in place be recovering the space used by the existing file
		unsigned long usedBlocks = 0;
		{
			long dataBytes = 0;
			long rsrcBytes = 0;
			OSErr err = theSaveFile->GetPhysicalSize(dataBytes, rsrcBytes);
			if (err == noErr)
				usedBlocks = NumBlocks(dataBytes, blockSize) + NumBlocks(rsrcBytes, blockSize);
		}

		if (neededBlocks <= usedBlocks + freeBlocks)
		{
			// Saving in place purges the existing file.  Should we ask before going ahead?
			if ((fHowToSave == svtAskUser) || (fHowToSave == sipAskUser))
			{
				ThrowIfOSErr_AC(MAInteractWithUser());
				CString_AC name(theSaveFile->GetName());
				ParamText(CStr255_AC(name), gEmptyString, gEmptyString, gEmptyString);

				if (MacAppAlert(phPurgeOld, NULL) == kYesButton)
					canSave = kSaveInPlace;
				else
					canSave = kSaveCancelled;	//	ThrowException_AC(noErr, messageCancelled);
			}
			else if (fHowToSave == sipAlways)
				canSave = kSaveInPlace;
		}
	}

	return canSave;

#else
	#pragma unused (theSaveFile, neededBlocks)
	#pragma message("TFileBasedDocument::CheckDiskSpace: Implement.")
	return kSaveInPlace;
#endif
}

#if qDebugMsg

//----------------------------------------------------------------------------------------
// TFileBasedDocument::DebugCheckEstimate:
//----------------------------------------------------------------------------------------

void TFileBasedDocument::DebugCheckEstimate(TFile* theSaveFile, unsigned long neededBlocks) const
{
#if !qMSWindows
	unsigned long blockSize;
	ThrowIfOSErr_AC(theSaveFile->GetBlockSize(blockSize));

	unsigned long usedBlocks = 0;
	{
		long dataBytes = 0;
		long rsrcBytes = 0;
		OSErr err = theSaveFile->GetPhysicalSize(dataBytes, rsrcBytes);
		if (err == noErr)
			usedBlocks = NumBlocks(dataBytes, blockSize) + NumBlocks(rsrcBytes, blockSize);
	}

	if (usedBlocks != neededBlocks)
	{
		ProgramReport_AC("DoNeedDiskSpace estimated disk space incorrectly.\n");
		ProgramReport_AC("estimated # disk blocks = %ld\n", neededBlocks);
		ProgramReport_AC("   actual # disk blocks = %ld\n", usedBlocks);
	}
#else
	#pragma unused (theSaveFile, neededBlocks)
	#pragma message("TFileBasedDocument::DebugCheckEstimate: Implement.")
#endif
}
#endif // qDebugMsg

//----------------------------------------------------------------------------------------
// TFileBasedDocument::SaveFile:
//----------------------------------------------------------------------------------------

void TFileBasedDocument::SaveFile(CommandNumber		itsCommandNumber,
								TFile*				theSaveFile,
								CSaveOptions*		itsOptions)
{
	bool makingCopy = itsCommandNumber == cSaveCopy;
	CAutoPtr_AC<CSaveOptions> conversionOptions(itsOptions);

	bool copyFInfo = fFileExists;
	if (copyFInfo)
		CheckFile(kIDBuzzString, bzSaveAnyways, false);

	if (!theSaveFile && !makingCopy)
		theSaveFile = fFile;

	if (!theSaveFile)
	{
		// This can't fail or we won't be able to save in low memory conditions.
		{
			CTempObjectAllocation tempObjectAllocation(true);
			theSaveFile = DoMakeFile(itsCommandNumber);
		}
		CSaveOptions* options;
		RequestFileName(itsCommandNumber, makingCopy, theSaveFile, options);
		conversionOptions = options;
	}
	ThrowIfNonObject_AC(theSaveFile);

	if (fCommitOnSave || (!makingCopy) )
		CommitLastCommand();

	try
	{
		AboutToSaveFile(theSaveFile, itsCommandNumber, makingCopy);

		// Actually save the document
		unsigned long neededBlocks;
		switch (CheckDiskSpace(theSaveFile, neededBlocks))
		{
			case kDiskFull:
				ThrowError_AC(dskFulErr);
				break;

			case kSaveCancelled:
				ThrowException_AC(noErr, messageCancelled);
				break;

			case kSaveViaTemp:
				SaveViaTemp(itsCommandNumber, makingCopy, copyFInfo, theSaveFile);
				break;

			case kSaveInPlace:
				SaveInPlace(itsCommandNumber, makingCopy, copyFInfo, theSaveFile);
				break;
		}

		// Flush before checking.
		OSErr flushErr = theSaveFile->FlushVolume();
#if qProjectBuilder
		(void) flushErr;
#endif

#if qDebugMsg
		DebugCheckEstimate(theSaveFile, neededBlocks);
#endif

		// For Save or Save As, use the new file
		if (!makingCopy)
		{
			bool isANewFile = !theSaveFile->IsSameFile(fFile);
			if (isANewFile)
			{
				// Close the file on purpose so Specify doesn't think it's by accident.
				CloseFile();

				if (!fConversionParams.IsNULL())		// Convert the old file
					fConversionParams->CommitSave();
				fConversionParams = conversionOptions;	// Store the new settings for later use

				fFile->SpecifyWithFile(theSaveFile);
			}
			FileHasBeenSaved(theSaveFile);

			fFileExists = true;
			fFile->Modified();

			if (isANewFile)
				ThrowIfOSErr_AC(fFile->OpenFileIfKeptOpen());
		}
		else
			if (!conversionOptions.IsNULL())
				conversionOptions->CommitSave();
	}
	catch(CException_AC& theException)
	{
		DoCatchMessage_AC(theException);

		if (theSaveFile)
		{
			OSErr recoverErr = theSaveFile->FlushVolume();
#if qProjectBuilder
			(void) recoverErr;
#endif
			if (!theException.GetExceptionMessage())
				gErrorParm3 = theSaveFile->GetName();
		}

		long newMsg = messageSaveAsFailed;
		if (itsCommandNumber == cSave)
			newMsg = messageSaveFailed;
		else if (makingCopy)
			newMsg = messageSaveCopyFailed;

		ThrowNewMessage_AC(theException.GetError(), theException.GetExceptionMessage(), newMsg);
	}
}

//----------------------------------------------------------------------------------------
// TFileBasedDocument::SaveInPlace:
//----------------------------------------------------------------------------------------

void TFileBasedDocument::SaveInPlace(CommandNumber	itsCommandNumber,
									 bool			makingCopy,
									 bool			copyFInfo,
									 TFile*			itsFile)
{
	if (fFileExists && itsFile->IsSameFile(fFile))
	{
		// If we're saving to the same file we've already got,
		// we can take some shortcuts.
		SaveOver();
	}
	else
	{
		// Save to a different file.
		SaveTo(itsCommandNumber, makingCopy, copyFInfo, itsFile);
	}
}

//----------------------------------------------------------------------------------------
// TFileBasedDocument::SaveOver:
//----------------------------------------------------------------------------------------

void TFileBasedDocument::SaveOver()
{
	// When saving in place just write into the existing file after setting
	// position and then truncating.
	try
	{
		fFile->SetPermissions(fsRdWrPerm, fsRdWrPerm);// Since we intend to write to it
		ThrowIfOSErr_AC(fFile->OpenFile());

		fFile->SetPosition(0);

		DoWrite(fFile, false);	// we're clearly not making a copy

		ThrowIfOSErr_AC(fFile->SetDataLength(fFile->GetPosition()));

		ThrowIfOSErr_AC(fFile->CloseFileIfNotKeptOpen());
	}
	catch(CException_AC& theException)
	{
		DoCatchMessage_AC(theException);
		RecoveryDeleteFile(fFile);
		fFileExists = false;
		throw;
	}
}

//----------------------------------------------------------------------------------------
// TFileBasedDocument::SaveTo:
//----------------------------------------------------------------------------------------

void TFileBasedDocument::SaveTo(CommandNumber	itsCommandNumber,
								bool			makingCopy,
								bool			copyFInfo,
								TFile*			itsFile)
{
	// Retain finder information. The document will have a file object
	// even if it doesn't have a file yet.
	CInfoPBRec cInfo;
	bool validInfo = GetSaveInfo(itsCommandNumber, copyFInfo, cInfo);

	// Delete the file if it already exists since the user will have
	// already said "replace existing."
	DeleteIfFile(itsFile);

	// We need to create the file since it doesn't exist or it's
	// different from our current file.
	try
	{
		ThrowIfOSErr_AC(itsFile->CreateCFile());	// Create the file.

		if (validInfo)			// Change attributes of itsFile?
			ThrowIfOSErr_AC(itsFile->SetCatInfo(cInfo));

		itsFile->SetPermissions(fsRdWrPerm, fsRdWrPerm);// Since we intend to write to it
		ThrowIfOSErr_AC(itsFile->OpenFile());		// And open it.

		DoWrite(itsFile, makingCopy);
	}
	catch(CException_AC& theException)
	{
		DoCatchMessage_AC(theException);
		RecoveryDeleteFile(itsFile);
		throw;
	}

	ThrowIfOSErr_AC(itsFile->CloseFile());
}

//----------------------------------------------------------------------------------------
// TFileBasedDocument::SaveViaTemp:
//----------------------------------------------------------------------------------------

void TFileBasedDocument::SaveViaTemp(CommandNumber	itsCommandNumber,
									 bool			makingCopy,
									 bool			copyFInfo,
									 TFile*			itsFile)
//	This function is a better modularized version of TFileBasedDocument's SaveViaTemp
//	function. By making a separate object for the temp file, we don't modify the save
//	file specification in itsFile. That also makes it easier to reuse SaveInPlace.
//
//	We make a temp file on the correct volume, save the document into it,
//	then give it the desired name and folder location.
{
	CAutoPtr_AC<TFile> tempFile = MakeTempFile(itsCommandNumber, itsFile);

	SaveInPlace(itsCommandNumber, makingCopy, copyFInfo, tempFile);

	ExchangeFile(makingCopy, copyFInfo, itsFile, tempFile);
}

//----------------------------------------------------------------------------------------
// TFileBasedDocument::MakeTempFile:
//----------------------------------------------------------------------------------------

TFile* TFileBasedDocument::MakeTempFile(CommandNumber itsCommandNumber,
										const TFile* itsFile)
//	This function is the first third of TFileBasedDocument's SaveViaTemp function.
//	However, instead of changing the save file specification to point to the temp folder,
//	we make a new temp file object.
{
	CAutoPtr_AC<TFile> tempFile = NULL;
	{
		// This can't fail or we won't be able to save in low memory conditions.
		CTempObjectAllocation tempObjectAllocation(true);
		tempFile = DoMakeFile(itsCommandNumber);
	}

	CString_AC tmpName(GetTempName());

#if !qMSWindows
	short tmpVRefNum;
	long tmpDirID;

	OSErr anErr = FindFolder(itsFile->GetVolRefNum(), kTemporaryFolderType, kCreateFolder, &tmpVRefNum, &tmpDirID);
	if (anErr == noErr)
		ThrowIfOSErr_AC(tempFile->SpecifyWithTrio(tmpVRefNum, tmpDirID, tmpName));
	else
#endif
	{
		CFSSpec_AC	tempSpec = itsFile->GetFileSpec();
		tempSpec.SetName(tmpName);
		tempFile->Specify(tempSpec);
	}

	return tempFile.release();
}

//----------------------------------------------------------------------------------------
// TFileBasedDocument::ExchangeFile:
//----------------------------------------------------------------------------------------

void TFileBasedDocument::ExchangeFile(bool		makingCopy,
									  bool		copyFInfo,
									  TFile*	itsFile,
									  TFile*	tempFile)
//	This function is the last third of TFileBasedDocument's SaveViaTemp function.
//	At this point the document has been saved to a temp file. All we need to do is
//	exchange the temp file for the save file so the temp file shows up in the right
//	folder with the right name.
//
//	If we are saving over the document's old file, the old file needs to be closed
//	now. Otherwise it can be left open, at least for a little while longer.
{
	bool closedFile = false;

	// Close the document's file but only if we're about to overwrite it.
	if ((!makingCopy) && fFileExists && itsFile->IsSameFile(fFile))
	{
		closedFile = true;
		CloseFile();
	}

	try
	{
		bool itsFileExists = (itsFile->GetModificationDate() != 0);
		if (itsFileExists && copyFInfo)
		{
			// Since ExchangeFiles doesn't check that the destination file is locked
			// we need to check ourselves.
			CInfoPBRec cInfo;

			BlockZero_AC(cInfo);// zero-out our storage
			ThrowIfOSErr_AC(itsFile->GetCatInfo(cInfo));

			if (cInfo.hFileInfo.ioFlAttrib & 0x01)
				ThrowIfOSErr_AC(fLckdErr);

			// Exchange the existing file for the one in the temporary folder�
			ThrowIfOSErr_AC(tempFile->ExchangeFiles(itsFile));

			// and delete the one left in the temporary folder
			DeleteIfFile(tempFile);
		}
		else
		{
			// Delete the file if it already exists since the user will have
			// already said "replace existing."
			DeleteIfFile(itsFile);

			// The temp file was created in the temporary directory.
			// Move it back where it belongs
			CFSSpec_AC saveFileSpec(itsFile->GetFileSpec());
			ThrowIfOSErr_AC(tempFile->MoveAndRename(saveFileSpec));
		}
	}
	catch(CException_AC& theException)
	{
		DoCatchMessage_AC(theException);

		RecoveryDeleteFile(tempFile);

		// Re-open the document's file that we closed.
		if (closedFile)
		{
			OSErr recoverErr = fFile->OpenFileIfKeptOpen();
#if qDebugMsg
			if (recoverErr != noErr)
				ProgramReport_AC("In SaveViaTemp error recovery: error from OpenFileIfKeptOpen is %d\n", recoverErr);
#elif qProjectBuilder
			(void) recoverErr;
#endif
		}

		throw;
	}
}

//----------------------------------------------------------------------------------------
// TFileBasedDocument::SetFileName:
//----------------------------------------------------------------------------------------

void TFileBasedDocument::SetFileName(const CString_AC& aName)
{
	if (!fFile.IsNULL())
		fFile->SetName(aName);
}

//----------------------------------------------------------------------------------------
// TFileBasedDocument::ValidateFileSpec:
//----------------------------------------------------------------------------------------

bool TFileBasedDocument::ValidateFileSpec()
{
	return fFile.IsNULL() ? false : fFile->UpdateFileSpec();
}

//----------------------------------------------------------------------------------------
// Scripting
//----------------------------------------------------------------------------------------

#if qAppleEventAware

//----------------------------------------------------------------------------------------
// TFileBasedDocument::CountContainedObjects:
//----------------------------------------------------------------------------------------

long TFileBasedDocument::CountContainedObjects(DescType desiredType)
{
	return desiredType == cFile ? (FileExists() ? 1 : 0) : TDocument::CountContainedObjects(desiredType);
}

//----------------------------------------------------------------------------------------
// TFileBasedDocument::GetContainedObject:
//----------------------------------------------------------------------------------------

MScriptableObject* TFileBasedDocument::GetContainedObject(DescType			desiredType,
														  DescType			selectionForm,
														  const CAEDesc_AC&	selectionData)
{
	MScriptableObject * result = NULL;
	if (desiredType == cFile)
	{
		if (FileExists())
		{
			if (selectionForm == formName)
			{
				TFile * resultFile = DoMakeFile(cOpen);
				CString_AC thePathName = selectionData.GetString();
				resultFile->SpecifyWithTrio(0, 0, thePathName);
				TOSADispatcher::fgDispatcher->AddTemporaryToken(resultFile);
				result = resultFile;
			}
			else
			{
				TFile * myFile = GetFile();
				if (myFile)
				{
					TFile * resultFile = DoMakeFile(cOpen);
					resultFile->SpecifyWithFile(myFile);
					TOSADispatcher::fgDispatcher->AddTemporaryToken(resultFile);
					result = resultFile;
				}
			}
		}
	}
	else
		result = TDocument::GetContainedObject(desiredType, selectionForm, selectionData);

	return result;
}

#endif	// #if qAppleEventAware

//========================================================================================
// CLASS TSaveFileDocCommand
//========================================================================================

//----------------------------------------------------------------------------------------
// TSaveFileDocCommand constructor:
//----------------------------------------------------------------------------------------

TSaveFileDocCommand::TSaveFileDocCommand(TFileBasedDocument* fileDocument, EventNumber saveType)
	:	TSaveCommand(fileDocument, saveType)
{
	if ((fIdentifier != cSaveCopy) && !fileDocument->FileExists())
		fIdentifier = cSaveAs;
}

#if qAppleEventAware

//----------------------------------------------------------------------------------------
// TSaveFileDocCommand constructor:
//----------------------------------------------------------------------------------------

TSaveFileDocCommand::TSaveFileDocCommand(TFileBasedDocument* fileDocument,
										 TAppleEvent* message,
										 TAppleEvent* reply,
										 EventNumber saveType)
	:	TSaveCommand(fileDocument, message, reply, saveType)
{
	// We determine what kind of save is to be performed:
	//		1. Save - Message has no file and we do or file specified
	//			 in message is the same as ours.
	//		2. SaveAs - Message has a file, it's not the same file,
	//			 or the file has never been saved.
	//		3. SaveCopy - Message has 'makeCopy' argument and it's true.

	fIdentifier = cSaveAs;

	// It's cSaveCopy if the 'makeCopy' parameter is supplied and is true.  This
	// might get reset below if the target file is the same as our current file.
	if (message->HasParameter(keyAESaveCopy) && message->ReadBoolean(keyAESaveCopy))
		fIdentifier = cSaveCopy;

	// If a file is provided then we stick with the default cSaveAs (unless it's
	// already be set to cSaveCopy) unless we're saving as our current file.
	if (message->HasParameter(keyAEFile))
	{
		// It has a file specifier so we know right where to save it.
		DescType		returnedType;
		CFSSpec_AC		theFSSpec;
		Size			actualSize;

		//ThrowIfOSErr_AC(AEGetParamPtr(message, keyAEFile, typeFSS, &returnedType, (Ptr) &theFSSpec, sizeof(theFSSpec), &actualSize));
		message->ReadParameterPtr(keyAEFile, typeFSS, returnedType, (Ptr) &theFSSpec,
								  sizeof(theFSSpec), actualSize);

		fSaveFile = fileDocument->DoMakeFile(fIdentifier);
		fSaveFile->Specify(theFSSpec);

		if (message->HasParameter(keyAEFileType))
			fSaveFile->SetFileType(message->ReadType(keyAEFileType));

		if (fileDocument->FileExists() && fSaveFile->IsSameFile(fileDocument->GetFile()))
		{
			fSaveFile.reset();
			fIdentifier = cSave;
		}
	}
	else if ((fIdentifier != cSaveCopy) && fileDocument->FileExists())
	{
		// And if no file was specified, we're not doing a cSaveCopy, and
		// we already have a file then we're just a simple cSave.
		fIdentifier = cSave;
	}
}

#endif	// #if qAppleEventAware

//----------------------------------------------------------------------------------------
// TSaveFileDocCommand::RequestSaveFile
//----------------------------------------------------------------------------------------

void TSaveFileDocCommand::RequestSaveFile()
{
	TFileBasedDocument* fileDocument = static_cast_AC(TFileBasedDocument*, fDocument);
	if ((fIdentifier == cSaveAs) || (fIdentifier == cSaveCopy) || !fileDocument->FileExists())
	{
		// Ask the user for the destination file location and name.
		ThrowIfOSErr_AC(MAInteractWithUser());
		try
		{
			// If this fails (i.e. user cancels) then we want it to be caught
			// in elsewhere with a more appropriate error code.
			fSaveFile = fileDocument->DoMakeFile(fIdentifier);
			CSaveOptions* options;
			fileDocument->RequestFileName(fIdentifier, false, fSaveFile, options);
			fConversionOptions = options;
		}
		catch(CException_AC& theException)
		{
			if (theException.GetError() == noErr && theException.GetExceptionMessage() == messageCancelled)
				theException.SetError(userCanceledErr);

			// Remember the error
			SetValidationError(theException.GetError());
			throw;
		}

		// Check to see if we've just been told to save on top of ourselves.
		// If so then change our cSaveAs to a cSave.
		if (fileDocument->FileExists() && fSaveFile->IsSameFile(fileDocument->GetFile()))
		{
			fSaveFile.reset();
			fIdentifier = cSave;
		}
	}
}

#if qAppleEventAware

//----------------------------------------------------------------------------------------
// TSaveFileDocCommand::MakeAppleEvent:
//----------------------------------------------------------------------------------------

TAppleEvent* TSaveFileDocCommand::MakeAppleEvent()
{
	// We have to save the file specifier in the AppleEvent.
	CAutoPtr_AC<TAppleEvent> theEvent(TSaveCommand::MakeAppleEvent());

	// Get the save file, if any
	if (!fSaveFile)
#if defined(__MRC__) && !FIXED_MPW_BUG
		// Workaround MrCpp throwing exception bug workaround to force to call the destructors
		// run time error: when save dialog is dismissed by "cancel", it results in memory leak
		// due to the exception raised and call to theEvent's destructor being missed.
		try
		{
			RequestSaveFile();
		}
		catch(CException_AC&)
		{
			theEvent.reset();
			throw;
		}
#else
		RequestSaveFile();
#endif

	// Don't need to include the file spec unless it is different
	if (fSaveFile)
	{
		CAEDesc_AC aSaveFileDesc;
		aSaveFileDesc.PutFSSpec(fSaveFile->GetFileSpec());

		theEvent->WriteParameter(keyAEFile, aSaveFileDesc);
	}

	// Add the 'makeCopy' parameter.
	if (fIdentifier == cSaveCopy)
		theEvent->WriteBoolean(keyAESaveCopy, true);

	return theEvent.release();
}

#endif	// #if qAppleEventAware

//----------------------------------------------------------------------------------------
// TSaveFileDocCommand::DoIt:
//----------------------------------------------------------------------------------------

void TSaveFileDocCommand::DoIt()
{
	ThrowIfNonObject_AC(fDocument);
	TFileBasedDocument* fileDocument = static_cast_AC(TFileBasedDocument*,fDocument);

	// If we were created from an Apple Event, the save file will already be known.
	// Otherwise, we still have to ask for it.
	if (!fSaveFile)
		RequestSaveFile();

	fileDocument->SaveFile(fIdentifier, fSaveFile, fConversionOptions.release());
}

//========================================================================================
// CLASS TCloseFileDocCommand
//========================================================================================

//----------------------------------------------------------------------------------------
// TCloseFileDocCommand constructor
//----------------------------------------------------------------------------------------

TCloseFileDocCommand::TCloseFileDocCommand(CommandNumber		itsCommandNumber,
										   TFileBasedDocument*	fileDocument)
	:	TCloseDocCommand(itsCommandNumber, fileDocument),
		fSaveCommand(cClose)
{
	SetUseAppleEvent(true);		// We want to default here.

	// If the file doesn't already exist, we will have to ask for it,
	// but we can wait until MakeAppleEvent or DoIt.
	fSaveCommand = fileDocument->FileExists() ? cClose : cSaveAs;
}

#if qAppleEventAware

//----------------------------------------------------------------------------------------
// TCloseFileDocCommand constructor
//----------------------------------------------------------------------------------------

TCloseFileDocCommand::TCloseFileDocCommand(TFileBasedDocument*	fileDocument,
										   TAppleEvent*			message,
										   TAppleEvent*			reply)
	:	TCloseDocCommand(fileDocument, message, reply),
		fSaveCommand(cClose)
{
	if (fSavingState != kDontSave)
	{
		// Does the AppleEvent specifically say where to save the file;
		if (message->HasParameter(keyAEFile))
		{
			DescType		returnedType;
			CFSSpec_AC		theFSSpec;
			Size			actualSize;

			//ThrowIfOSErr_AC(AEGetParamPtr(message, keyAEFile, typeFSS, &returnedType, (Ptr) & theFSSpec, sizeof(theFSSpec), &actualSize));
			message->ReadParameterPtr(keyAEFile, typeFSS, returnedType, (Ptr) & theFSSpec,
									  sizeof(theFSSpec), actualSize);

			fCloseFile = fileDocument->DoMakeFile(fIdentifier);
			fCloseFile->Specify(theFSSpec);

			fSaveCommand = cSaveAs;
		}
	}
}

#endif	// #if qAppleEventAware

//----------------------------------------------------------------------------------------
// TCloseFileDocCommand::RequestSaveFile
//----------------------------------------------------------------------------------------

void TCloseFileDocCommand::RequestSaveFile()
{
	// Are we saving?
	if ((fSavingState != kDontSave) && (fSaveCommand == cSaveAs))
	{
		try
		{
			ThrowIfOSErr_AC(MAInteractWithUser());

			// Ask the user for the destination file location and name.
			TFileBasedDocument*	fileDocument = static_cast_AC(TFileBasedDocument*, fDocument);
			fCloseFile = fileDocument->DoMakeFile(cSaveAs);
			CSaveOptions* options;
			fileDocument->RequestFileName(cSaveAs, false, fCloseFile, options);
			fConversionOptions = options;
		}
		catch(CException_AC& theException)
		{
			DoCatchMessage_AC(theException);
			// If this fails because user cancels then we want it
			// to be caught with a more appropriate error code.
			if (theException.GetError() == noErr && theException.GetExceptionMessage() == messageCancelled)
				theException.SetError(userCanceledErr);

			// Remember the error
			SetValidationError(theException.GetError());

			if (theException.GetError() == userCanceledErr)
				fSavingState = kCanceled;
			throw;
		}
	}
}

#if qAppleEventAware

//----------------------------------------------------------------------------------------
// TCloseFileDocCommand::MakeAppleEvent:
//----------------------------------------------------------------------------------------

TAppleEvent* TCloseFileDocCommand::MakeAppleEvent()
{
	// We have to save the file specifier in the AppleEvent.
	CAutoPtr_AC<TAppleEvent> theEvent(TCloseDocCommand::MakeAppleEvent());

	if (fSavingState == kDoSave)
	{
		// Which file to store it into, if any.
		if (!fCloseFile)
		{
#if defined(__MRC__) && !FIXED_MPW_BUG
			// Workaround MrCpp throwing exception bug workaround to force to call the destructors
			// run time error: when save dialog is dismissed by "cancel", it results in memory leak
			// due to the exception raised and call to theEvent's destructor being missed.
			try
			{
				RequestSaveFile();
			}
			catch(CException_AC&)
			{
				theEvent.reset();
				throw;
			}
#else
			RequestSaveFile();
#endif
			if (fSavingState == kCanceled)
				theEvent.reset();
		}

		if (fSavingState == kDoSave)
		{
			// Don't need to include the file spec unless it is different
			if (!fCloseFile.IsNULL())
			{
				CAEDesc_AC aCloseFileDesc;
				aCloseFileDesc.PutFSSpec(fCloseFile->GetFileSpec());

				theEvent->WriteParameter(keyAEFile, aCloseFileDesc);
			}
		}
	}

	return theEvent.release();
}

#endif	// #if qAppleEventAware

//----------------------------------------------------------------------------------------
// TCloseFileDocCommand::DoIt:
//----------------------------------------------------------------------------------------

void TCloseFileDocCommand::DoIt()
{
	if (fDocument)
	{
		// Some documents want us to specifically ask if they should be saved.
		if (fSavingState == kAskSave)
			AskToSave();

		if (fSavingState == kDoSave)
		{
			// If we were created from an Apple Event, the close file will already be known.
			// Otherwise, we still have to ask for it.
			if (!fCloseFile)
				RequestSaveFile();

			if (fSavingState == kDoSave)
			{
				TFileBasedDocument* fileDocument = static_cast_AC(TFileBasedDocument*, fDocument);
				fileDocument->SaveFile(cSave, fCloseFile, fConversionOptions.release());	// ��� Shouldn't we pass fIdentifier ???
			}
		}

		if (fSavingState != kCanceled)
		{
			// If there is actually some saving to do it should have already been done.
			fDocument->SetChangeCount(0);
			fDocument->Close();
			delete fDocument;
			fDocument = NULL;
		}
		else
			::ThrowIfOSErr_AC(userCanceledErr);
	}
}

#if qNavigation

//========================================================================================
// CLASS CNavSvcsSaveOptions
//========================================================================================

//----------------------------------------------------------------------------------------
// CNavSvcsSaveOptions ctor
//----------------------------------------------------------------------------------------

CNavSvcsSaveOptions::CNavSvcsSaveOptions(NavReplyRecord& theData)
	:	fNavReply(theData)
{
}

//----------------------------------------------------------------------------------------
// CNavSvcsSaveOptions dtor
//----------------------------------------------------------------------------------------

CNavSvcsSaveOptions::~CNavSvcsSaveOptions()
{
	::NavDisposeReply(&fNavReply);
}

//----------------------------------------------------------------------------------------
// CNavSvcsSaveOptions::CommitSave
//----------------------------------------------------------------------------------------

OSErr CNavSvcsSaveOptions::CommitSave()
{
	OSErr err = ::NavCompleteSave(&fNavReply, kNavTranslateInPlace);
	// See if the stationery option has been set, use it if so
	if (fNavReply.isStationery && err == noErr)
	{
		// Get the filespec
		CAEDesc_AC directObj = fNavReply.selection;
		CTempDesc_AC theItem(directObj.GetNthItem(1, typeFSS));
		CFSSpec_AC theFSSpec = theItem.GetFSSpec();

		// Set the stationery bit
		CInfoPBRec cInfo;

		BlockZero_AC(cInfo);// Zero-out our storage
		cInfo.hFileInfo.ioCompletion = NULL;
		cInfo.hFileInfo.ioNamePtr = const_cast<StringPtr>(theFSSpec.name);
		cInfo.hFileInfo.ioVRefNum = theFSSpec.vRefNum;
		cInfo.hFileInfo.ioFDirIndex = 0;
		cInfo.hFileInfo.ioDirID = theFSSpec.parID;

		err = PBGetCatInfoSync(&cInfo);

		if (err == noErr && cInfo.hFileInfo.ioResult == noErr)
		{
			cInfo.hFileInfo.ioFlFndrInfo.fdFlags |= kIsStationery;
			cInfo.hFileInfo.ioDirID = theFSSpec.parID;		// Changed during PBGetCatInfoSync
			err = PBSetCatInfoSync(&cInfo);
		}
	}
	return err;
}

#endif

//----------------------------------------------------------------------------------------
// End of UFileBasedDocument.cpp

/*
	Historical Change Record:
		----- R13 -----
		07/16/97	Changed ProgramBreak_AC to ProgramReport_AC in SaveFile, SaveInPlace, and SaveViaTemp
		07/11/97	Prefer TemporaryAllocation terminology over PermAllocation.
		07/11/97	Changed 7/9's changes to use TempObjectAllocation.
		07/09/97	Replaced AllocateObjectsFromPerm with TempAllocation.
		07/09/97	[1651927] Set up file name for Save Copy in TFileBasedDocument::SFPutParms.
		07/03/97	[1615710] Ask for file name in SaveFile if fFile has never been
							specified.
		07/02/97	[1351352] Retain stationery settings in TFileBasedDocument::GetSaveInfo.
		06/30/97	[1664110] Changed test of fCloseFile in TCloseFileDocCommand::
							MakeAppleEvent.
		06/30/97	[1353169] fprinf(stderr, blah) to ProgramBreak_AC(blah)
		06/25/97	Removed excessive blank lines.
		06/17/97	[1615790] SaveViaTemp now has an alternative way of finding
							a place for the temporary file.
		06/17/97	[1615680] Removed TFileBasedDocument::DoClose and DoAEClose which are
							now fully handles by TDocument's.  Added command number to interface
							of MakeCloseCommand.  Added a MakeCloseCommand which uses an AppleEvent
							for making the command.
		06/17/97	In TFileBasedDocument::SaveFile there was a left over AllocateObectFromTemp call
							in the recovery code that should have been removed when we went to using a
							CTempAllocateObjectsFromTemp stack base utility.
		06/12/97	[1141811] Change FileHasBeenChanged to take a TFile.
		06/09/97	Use dynamic_cast_AC where we expected dynamic_cast to always work.
		06/04/97	[1615892] Check result of dynamic_cast.
		05/28/97	[1357034] Setup of cSave et al moved to TFileBasedDocument::DoSetupMenus from TDocument
		04/23/97	Remove Clone declarations from classes we don't clone.
		04/19/97	TFileBasedDocment::DoReadSelection was freeing the newly created selection.
		04/16/97	TSaveFileDocCommand::DoIt was not passing the commandNumber stored
							in fIdentifer to the SaveDocument call.
		04/14/97	Update for real xxx_cast operators.
		04/13/97	Update List and Dependency names for ACS.
		04/09/97	properly use dynamic casting for all down/side casts
		04/07/97	Added TSaveAsDocFileCommand and TSaveCopyDocFileCommand.
							Stripped qContainer stuff.  Replaced all Inherited's.
							Added DoSetupMenus to TFileBasedDocument so that unmodified
							documents cannot be reverted.
		04/08/97	Update for TAdorner/TBehavior/TEventHandler/TCommandHandler/TCommand/
							TFileBasedDocument/TSection/TEditionDocument protected fields.
		04/04/97	Update for TView/TWindow protected fields.
		03/25/97	AC_ to _AC Name change.
		03/24/97	Migrated Dependencies and Lists to ACS
		03/17/97	Switch many qPowerPC flags to q68K to prepare better for QTML
		03/11/97	Update exception support to latest.
		03/07/97	Massive Changes: Use Exceptions_AC, new to TH_new, use Blah_AC,
							Update Copyright, Moved Obsolete APIs into Compatibility.h, etc..
		02/19/97	Use embedded objects instead of auto_ptr based object where possible.
		12/18/96	Use accessors for TFile member data.
		10/14/96	[1349420] Removed unnecessary code from TCloseFileDocCommand::DoIt.
		09/30/96	Change local MAauto_ptrs to stack based object allocations where possible
		09/20/96	Cosmetic
		09/18/96	Remove the last few remaining assignments to volatile temporary vars.
		08/15/96	Use constructors for all TCommand descendents
		08/14/96	Use constructors for all TDispatcher descendents
		08/13/96	Use constructors for all TDocument descendents
		08/12/96	Use constructors for all TStream descendents
		08/12/96	Use constructors for all CDynamicArray_AC descendents
		08/10/96	Fixed -noload compiles, made more datamembers auto_ptrs, FreeIfObject->delete
		08/01/96	T[Sorted]List now takes a void* T[Sorted]VoidList now typedefed to T[Sorted]List
		07/22/96	Use templates for many Iterator subclasses.
		07/17/96	define template CAutoPtr_AC and use it in place of CTempObject
		07/16/96	Removed MAVolatile
		07/16/96	Replacing Failxxx with Throwxx procs
		07/16/96	Changed references to failinfos to references of CException_AC
		07/16/96	Goodbye Exception Macros (TRY, CATCH_ALL, ENDTRY)
		07/15/96	Boolean->bool
		----- R11 -----
		06/27/96	Make conditional tests implicit as in if(x) instead of if(x != 0).
		06/26/96	Changed nil back to NULL.
		06/26/96	Install release marker.  Scope many globals.  Change TRUE/FALSE/NULL.
		06/26/96	==/!=NULL to implicit tests, except in the case of assignment to or passing/returning as bool/bool.
		06/20/96	[1349420] Removed unnecessary existingFileCopy and currFileExists
							from TCloseFileCommand::DoIt.
		06/20/96	[1290382] (Strings) CStr255_AC could have constructor for STR# id & index
		06/19/96	[1340423] Don't create existingFileCopy in TSaveFileDocCommand::DoIt
							if doing a cSaveCopy.  Also don't call CommitLastCommand since that's
							already done in SaveDocument.
		06/19/96	SCpp and MrCpp can't handle declarations in the expression portion of while loops
							so we just changed them all to for loops
		06/18/96	[1329904] Saving As over our own file now works.  This required a small
							change in having RequestFileName: it no longer immediately deletes the
							target file being saved over, this is postponed until the command is
							completed.  Also added some global scoping.
		06/17/96	[114989] Record all quitting-related commands.  Default recording
							in command I method to true.
		06/12/96	Started the release process, removing triple-�, initials,
							inappropriate comments.
		06/09/96	Removed UStreamable to a separate file from UObject
		05/31/96	Made two minor changes to make buildable again. Removed a reference (&) to go
							with the new interface to MakeUniqueDatedFSSpec and corrected type-o where
							there was a non-function call (aFile->GetFileSpec);
		05/10/96	Use CustomGetFilePreview if running on machine with quicktime. Toss the old
							SFPut/GetFile and use CustomPut/GetFile in all cases since it is always present w/system 7
		05/09/96	Adjust the Failure Handling macros to allow for easy switching to native exceptions.
		 5/08/96	Create and use CFSSpec_AC. You should search/replace in your code to switch to
		 					CFSSpec_AC.
		05/07/96	Made TAppleEvent derive from CAEDesc_AC as well as TObject.
		05/07/96	Made CAEDesc_AC a derivative of AEDesc.
		05/07/96	Use enums for parameters of CTempHandleLock_AC constructor.
		05/06/96	Combine Lockhandle and LockHandleHigh. Create CTempHandleLock_AC.
		05/02/95	Call FreeIfObject, don't call Free directly since it will eventually be removed.
		04/30/96	Make all constructors use initialization lists if they weren't already
							doing do. Switch several more empty constructors to inlines.
		04/25/96	More use of CTempxxx classes instead of Failure handling where poss.
		04/24/96	Use PRE-Increment/Decrement operators whenever possible for eff.
		04/23/96	Use CTempObject/Handle/Region/Ptr, etc.
		04/18/96	Use post-increment with iterators in while loops
		04/16/96	Use "while" style iteration
		----- R10 -----
		03/30/96	removed include for UPrinting, replaced with UPrintHandler. Removed knowledge
							of TPrintInfo other than as blind pointer. Calls to generic routines to save/
							restore printinfo now. Moved constants for identifying printinfo resources
							to the UPrinting.h file
		03/27/96	Replace several BlockMoves_AC with string operations
		03/26/96	Cleanup references to gEmptyString and ""
		02/21/96	GX: Added NewPrintInfo .
		03/06/96	Reactivated #include for UClipboardMgr.
		02/28/96	[115887] Unesscessary ReSignals in RevertDocument, SaveFile
		02/22/96	Clean up includes.
		02/20/96	[1325512] Initialize value before using in ReadFrom.
		01/29/96	Add methods for manipulating the list of ODPartViews.
							Add Register and Delete calls to put the document in the
							applications list of the current container documents. Change
							copyright to 1996.
		01/15/96	Add RegisterCAHandlers call in DoInitialState for Container
							documents, Cosmetic.
		01/04/96	Get rid of TFileHandler.
		12/19/95	Don't need failure handler in DoIt just for SetValidationError.
		12/18/95	Remove linkedCommand argument from ICloseFileDocCommand.
		12/14/95	Change TApplication CA handlers to TDispatcher.
		12/12/95	Moved container support in from TShapesDocument including
							MakeDatedUniqueFSSpec, GetContainer, and DoInitialState.
							Modified DoNeedDiskSpace to include container requirements.
							Destructor gets rid of container and constructor initializes
							container data members.  Modified IsChanged to check contained
							document change checking.  Added RegisterCAHandlers.   Modified
							DoWrite and DoRead to write and read the embedded part.  Include
							CALib.h and UContainer.h.
		12/08/95	Bring back MAInteractWithUser.
							Split up includes for modular MacApp.
		----- 3.3 -----
		11/15/95	Modified TFileBasedDocument::DoWritePrintInfo to fix bug where
							a WriteResource is performed on a non-resource handle.
		11/15/95	Added TDocument::RegainControl.
		11/02/95	Check interaction level in CheckFile.
		11/01/95	Use kMacAppTimeout in calls to InteractWithUser.
		10/30/95	::DoReadScript checks ScriptDesc.fAEDesc.descriptorType
							for a null script.
		10/28/95	[1296945] (Printing) Page Setup info not saved.
							Also fixed in DoReadSelection.
		10/25/95	DoReadScript, DoWriteScript write script out to resource
							without prepending type/size data.
		10/11/95	[1263154] Cleaned up the AllocateObjectsFromPerm calling.
		10/10/95	Call gDispatcher->InteractWithUser.
		10/04/95	[1289760] Don't attempt to get resource if there is no resource
		 					fork in DoReadPrintInfo, DoReadScript, and DoReadSelection.
		09/22/95	[1287420] Removed the linkedCommand argument from the
		 					TFileBasedDocument::DoClose interface and from
							its call to ICloseFileDocCommand.
		----- 3.3b1 -----
		09/07/95	It's that const problem.  Don't use it lightly.
		09/06/95	Made changes to the error handling.  Immediately process
							the close command in TFileBasedDocument::DoAEClose.
		08/30/95	Moved all user interaction for save/close doc commands
		 					back into the I-methods so that recording would work
							properly.  Caught userCanceledError in DoSave and DoClose.
		 					If a document's change count is 0 then record kDontSave in
		 					TCloseFileDocCommand.  Added a bunch'o MAVolatiles.
		08/23/95	TFileBasedDocument::DoClose now returns void rather than bool and links with
							another command if required.  Call SetValidationErrir in TFileDocCommand::DoIt.
		08/22/95	Oops.  Fixed problem in non-AE processing of closing and saving documents.
		08/22/95	Modifications to TSaveFileDocCommand and TCloseFileDocCommand
		 					to derive from TServerCommand.  Removed modal looping and
							RequestFileName from commands.
		08/16/95	Removed modal loop in DoAESave since TCloseDocCommand was
		 					changed to derive from TServerCommand.
		08/10/95	Repaired document saving command which would not perform
		 					a cSaveAs unless the document was dirty.
		08/09/95	Execution of DoAESave was made modal so that errors
		  					could be reported to the client properly.
		08/09/95	Add StandardFileReply to SFPutParms.
		08/07/95	Cleaned up closing and saving document commands by removing
		  					the Make functions and getting rid of virtual I-methods.
		08/02/95	If the print info stored as a resource, then if it is default
		  					don't store it and even remove the old one.
		08/04/95	Add RequestFileName method to TCloseFileDocCommand.
							Actually save only if it is supposed to.
		08/03/95	Include UClipboardMgr. Test fSaveFile/fCloseFile before
		  					calling GetModificationDate.
		08/03/95	Enhanced scripting of document closing and saving.
		08/02/95	Change DoReadPrintInfo/DoWritePrintInfo to use handle streams
							instead of resource streams.
		08/02/95	Have the TPrintInfo stream itself.
		07/30/95	Need to include UPrinting to get TPrintInfo.
							Change DoReadScript/DoWriteScript to use handle streams
							instead of resource streams.
		07/26/95	change fLastPrinterName to gLastPrinterName of static CStr255_AC, it doesn't need to be
							in the freestore and it is shared for the whole application.
							Removed RedoIt method of TPrintStyleChangeCommand and added default
							Parameter to IPrintStyleChangeCommand for isUndoable. The command is
							created and executed in all cases now. Changed PrinterDriverHasChanged
							to HasPrinterDriverChanged.
							StripToPage now takes a CCoordPoint_AC to identify the strip.
							Created a TPrinter object and a TPrintInfo object
		07/27/95	Conditionalize attachability support.
		06/29/95	Remove references to TApplication::GetMyAddress.
		06/12/95	Moved PowerTalk support to TMailDocument.
		06/12/95	Support TAppleEvent::fgIdleProc, TOSADispatcher::fgDispatcher
		04/14/95	Save/lock and restore handle state instead of lock and unlock.
							Remove pre-System 7 support.
		03/30/95	Avoid cast to TObject*& in call to ReadStreamObject.
		03/17/95	MAVolatile.
		03/14/95	Add TLetter and TFileBaseLetter classes.
		03/13/95	Change Free methods to destructors.
		02/22/95	1222850 MacApp should use BlockMove_AC and BlockMoveOverlap_AC everywhere
		02/22/95	1185932 add kBestSystemLocation for -1,-1 window locations
		02/19/95	Remove unused locals from DoWriteScript. Fix DoAESave to
		 					use qPowerTalk.
		02/17/95	Use MAAddResource.
		02/14/95	Second batch of attachability changes.
							In GetContainedObject, use DoMakeFile instead of new TFile
							to make a file. Change DoAESave so it can do cSave as well
							as cSaveAs.
		02/06/95	Add () to call to HasOSAScript.
		01/26/95	Add DoReadScript, DoWriteScript, GetSaveLocation and
							DoSave. Remove DoAEClose. Fill in DoAESave.
		11/13/94	Support conditional compile based on qPowerTalk.
		09/23/94	Modified to support TScriptEventDispatcher.
		09/14/94	Add Ken Ryall's AOCE support.
		07/26/94	Include UAppleEvents.
		07/18/94	Call Inherited::GetContainedObject instead of
							MScriptableObject::GetContainedObject (as per Ken Ryall).
							Change NULL to nil.
		07/14/94	Merged with Ken Ryall's MAScript changes.
*/