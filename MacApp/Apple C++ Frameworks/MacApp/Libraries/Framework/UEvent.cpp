//----------------------------------------------------------------------------------------
// UEvent.cpp
// Copyright © 1984-2001 by Apple Computer, Inc. All rights reserved.
//----------------------------------------------------------------------------------------

/*
	Change History
		05/21/01	Organize includes. 
		03/01/01	Don't include Windows_AC. 
		01/02/01	Update copyright.
		11/13/00	Need to get C string from standard string for printing. 
		11/09/00	Ticks are unsigned. 
		11/03/00	[C] Don’t include EPPC.h.
		05/23/00	[2279264] Remove false from ProgramReport_AC. 
		03/31/00	[G] Do not call AsText.
		03/24/99	Update copyright notice.
		03/19/99	Rename GetMessage to GetEventMessage,
					ReportEvent to ReportTheEvent since they conflict with a Windows define.
		10/29/98	[W] It is no longer necessary to include QTMLMapNames.h.
					Use FindWindow_AC.  Include WindowUtils_AC.h.
		10/08/98	Add DeleteEvent. 
					Merge TCommandHandler into TEventHandler. 
					TEventList is really a TCommandList. 
					fContext and fHandler are the same. 
					Move fPriority to TCommand. 
					Move fFreeOnCompletion to TEvent. 
					Add SetMainEvent method. 
		10/07/98	Use AsText instead of casting to char*. 
*/

#ifndef __UEVENT__
#include "UEvent.h"
#endif

// MacApp

#ifndef __UCOREUTILITIES__
#include "UCoreUtilities.h"
#endif

#ifndef __UDISPATCHER__
#include "UDispatcher.h"
#endif

#ifndef __UEVENTHANDLER__
#include "UEventHandler.h"
#endif

#ifndef __UMACAPPUTILITIES__
#include "UMacAppUtilities.h"
#endif

// ACS

#ifndef __WindowUtils_AC__
#include "WindowUtils_AC.h"
#endif

// Toolbox

#if !qCarbon
	#ifndef __EPPC__
	#include <EPPC.h>
	#endif
#endif

#ifndef __MACWINDOWS__
#include <MacWindows.h>
#endif

#ifndef __RESOURCES__
#include <Resources.h>
#endif

#ifndef __TOOLUTILS__
#include <ToolUtils.h>
#endif

//========================================================================================
// CLASS TEvent
//========================================================================================
//----------------------------------------------------------------------------------------
// TEvent constructor
//----------------------------------------------------------------------------------------

TEvent::TEvent(EventNumber itsEventNumber,
			   TEventHandler* itsSource,
			   TEventHandler* itsHandler) :
	fSource(itsSource),
	fContext(itsHandler),
	fIdentifier(itsEventNumber),
	fAffectsMenus(false),
	fFreeOnCompletion(true)				// event/command will be freed after DoIt or Commit
{
}

//----------------------------------------------------------------------------------------
// TEvent::Free: 
//----------------------------------------------------------------------------------------

TEvent::~TEvent()
{
//#if qDebug
//	if (gDispatcher)
//	{
//		TCommandList* eventList = gDispatcher->GetCommandList();
//		if (eventList && eventList->GetIdentityItemNo(this))
//			::ProgramBreak_AC("You are trying to free an event that is still on the event queue.");
//	}
//#endif
}

//----------------------------------------------------------------------------------------
// TEvent::GetHandler: 
//----------------------------------------------------------------------------------------

TEventHandler* TEvent::GetHandler()
{
	return fContext ? fContext : gDispatcher;
}

//----------------------------------------------------------------------------------------
// TEvent::ShouldFreeOnCompletion: 
//----------------------------------------------------------------------------------------

bool TEvent::ShouldFreeOnCompletion()
{
	return fFreeOnCompletion;
}

//----------------------------------------------------------------------------------------
// TEvent::IsReadyToPost: 
//----------------------------------------------------------------------------------------

bool TEvent::IsReadyToPost()
{
	return true;
}

//----------------------------------------------------------------------------------------
// TEvent::IsReadyToExecute: 
//----------------------------------------------------------------------------------------

bool TEvent::IsReadyToExecute()
{
	return true;
}

//----------------------------------------------------------------------------------------
// TEvent::IsRecurring: 
//----------------------------------------------------------------------------------------

bool TEvent::IsRecurring()
{
	return false;
}

//----------------------------------------------------------------------------------------
// TEvent::Process: 
//----------------------------------------------------------------------------------------

void TEvent::Process()	
{
	TEventHandler* handler = GetHandler();
	if (handler)
		handler->HandleEvent(fIdentifier, fSource, this);
}

#if qDebug
//----------------------------------------------------------------------------------------
// TEvent::ReportTheEvent: 
//----------------------------------------------------------------------------------------

void TEvent::ReportTheEvent()
{
}
#endif

//----------------------------------------------------------------------------------------
// TEvent::DeleteEvent:
//----------------------------------------------------------------------------------------

TEvent* TEvent::DeleteEvent(TEvent* event)
{
	if (event && event->ShouldFreeOnCompletion())
	{
		delete event;
		event = NULL;
	}
	return event;
}


//========================================================================================
// CLASS TToolboxEvent
//========================================================================================

//----------------------------------------------------------------------------------------
// TToolboxEvent constructor
//----------------------------------------------------------------------------------------

TToolboxEvent::TToolboxEvent(TEventHandler* itsHandler,
							 const EventRecord* theEvent,
							 bool freeOnCompletion) :
	TEvent(cNoCommand, NULL, itsHandler),

	fKeyScript(static_cast<short>(GetScriptManagerVariable(smKeyScript))), 
	fKeyCode(0),					// Default, we don't know if this is a keystroke yet
	fClickCount(0),
	fDoubleEvent(false)
#if qBackwardCompatible
	, fEventRecord(fEventRecords[0]),
	fCharacter(fText[1])
#endif
{
	fAffectsMenus = true;			// assume going in that this event affects the menus
	fFreeOnCompletion = freeOnCompletion;

	if (theEvent)
	{
		fIdentifier = static_cast<unsigned short>(theEvent->what);
		fEventRecords[0] = *theEvent;
	}
}

//----------------------------------------------------------------------------------------
// TToolboxEvent destructor
//----------------------------------------------------------------------------------------

TToolboxEvent::~TToolboxEvent()
{
}

//----------------------------------------------------------------------------------------
// TToolboxEvent::SetMainEvent
//----------------------------------------------------------------------------------------

void TToolboxEvent::SetMainEvent(const EventRecord& theEvent)
{
	fKeyScript = static_cast<short>(GetScriptManagerVariable(smKeyScript));
	fKeyCode = 0;					// Default, we don't know if this is a keystroke yet
	fClickCount = 0;
	fDoubleEvent = false;

	fAffectsMenus = true;			// assume going in that this event affects the menus

	fIdentifier = static_cast<unsigned short>(theEvent.what);
	fEventRecords[0] = theEvent;
}

//----------------------------------------------------------------------------------------
// TToolboxEvent::IsDoubleEvent: 
//----------------------------------------------------------------------------------------

bool TToolboxEvent::IsDoubleEvent()
{
	bool returnVal = false;

	if ((fEventRecords[0].what == keyDown) || (fEventRecords[0].what == keyUp) || (fEventRecords[0].what == autoKey))
	{
		unsigned char theCharacter = static_cast<unsigned char>(fEventRecords[0].message & charCodeMask);
		returnVal = MACharacterByteType((Ptr)&theCharacter, 0, fKeyScript) == smFirstByte;
	}

	return returnVal;
}

//----------------------------------------------------------------------------------------
// TToolboxEvent::AddSecondaryKeyEvent: 
//----------------------------------------------------------------------------------------

void TToolboxEvent::AddSecondaryKeyEvent(const EventRecord& theEvent)
{
	fDoubleEvent = true;
	fEventRecords[1] = theEvent;
}

//----------------------------------------------------------------------------------------
// TToolboxEvent::IsButtonPressed: 
//----------------------------------------------------------------------------------------

bool TToolboxEvent::IsButtonPressed() const
{
	return ((fEventRecords[0].modifiers) & btnState) != 0;
}

//----------------------------------------------------------------------------------------
// TToolboxEvent::IsCommandKeyPressed: 
//----------------------------------------------------------------------------------------

bool TToolboxEvent::IsCommandKeyPressed() const
{
	return ((fEventRecords[0].modifiers) & cmdKey) != 0;
}

//----------------------------------------------------------------------------------------
// TToolboxEvent::IsShiftKeyPressed: 
//----------------------------------------------------------------------------------------

bool TToolboxEvent::IsShiftKeyPressed() const
{
	return ((fEventRecords[0].modifiers) & shiftKey) != 0;
}

//----------------------------------------------------------------------------------------
// TToolboxEvent::IsAlphaLock: 
//----------------------------------------------------------------------------------------

bool TToolboxEvent::IsAlphaLock() const
{
	return ((fEventRecords[0].modifiers) & alphaLock) != 0;
}

//----------------------------------------------------------------------------------------
// TToolboxEvent::IsOptionKeyPressed: 
//----------------------------------------------------------------------------------------

bool TToolboxEvent::IsOptionKeyPressed() const
{
	return ((fEventRecords[0].modifiers) & optionKey) != 0;
}

//----------------------------------------------------------------------------------------
// TToolboxEvent::IsControlKeyPressed: 
//----------------------------------------------------------------------------------------

bool TToolboxEvent::IsControlKeyPressed() const
{
	return ((fEventRecords[0].modifiers) & controlKey) != 0;
}

//----------------------------------------------------------------------------------------
// TToolboxEvent::IsAutoKeyEvent: 
//----------------------------------------------------------------------------------------

bool TToolboxEvent::IsAutoKeyEvent() const
{
	return fEventRecords[0].what == autoKey;
}

//----------------------------------------------------------------------------------------
// TToolboxEvent::Process: 
//----------------------------------------------------------------------------------------

void TToolboxEvent::Process()	
{
	gDispatcher->HandleToolboxEvent(this);
}

//----------------------------------------------------------------------------------------
// TToolboxEvent::GetWhat: 
//----------------------------------------------------------------------------------------

short TToolboxEvent::GetWhat() const
{
	return fEventRecords[0].what;
}

//----------------------------------------------------------------------------------------
// TToolboxEvent::GetWhen: 
//----------------------------------------------------------------------------------------

unsigned long TToolboxEvent::GetWhen() const
{
	return fEventRecords[0].when;
}

//----------------------------------------------------------------------------------------
// TToolboxEvent::GetWhere: 
//----------------------------------------------------------------------------------------

CPoint_AC TToolboxEvent::GetWhere() const
{
	return fEventRecords[0].where;
}

//----------------------------------------------------------------------------------------
// TToolboxEvent::GetEventMessage: 
//----------------------------------------------------------------------------------------

long TToolboxEvent::GetEventMessage(short zeroOrOne) const
{
	return fEventRecords[zeroOrOne].message;
}

//----------------------------------------------------------------------------------------
// TToolboxEvent::GetModifiers: 
//----------------------------------------------------------------------------------------

short TToolboxEvent::GetModifiers(short zeroOrOne) const
{
	return fEventRecords[zeroOrOne].modifiers;
}

#if qDebug
//----------------------------------------------------------------------------------------
// TToolboxEvent::ReportTheEvent: 
//----------------------------------------------------------------------------------------

void TToolboxEvent::ReportTheEvent()		// override 
{
	ProgramReport_AC("t = %d", fEventRecords[0].when);
	CStr63_AC mods = " ---------";
	//		1234567890 

	if (IsControlKeyPressed())
		mods[2] = 'C';
	if (IsOptionKeyPressed())
		mods[3] = 'O';
	if (IsAlphaLock())
		mods[4] = 'L';
	if (IsShiftKeyPressed())
		mods[5] = 'S';
	if (IsCommandKeyPressed())
		mods[6] = 'C';
	if (IsButtonPressed())
		mods[7] = 'M';
	if (fEventRecords[0].what == activateEvt)
		mods[8] = fEventRecords[0].modifiers & activeFlag ? 'A' : 'D';
	ProgramReport_AC("%s", CChar255_AC(mods));

	switch (fEventRecords[0].what)
	{
		case nullEvent:
			ProgramReport_AC("nullEvent\n");
			break;
		case mouseDown:
		case mouseUp:
		{
			if (fEventRecords[0].what == mouseDown)
				ProgramReport_AC("mouseDown   ");
			else
				ProgramReport_AC("mouseUp     ");

			ProgramReport_AC("%s", CPoint_AC(fEventRecords[0].where).AsText().c_str());

			CStr255_AC aString;
			WindowRef aWMgrWindow;
			switch (::FindWindow_AC(fEventRecords[0].where, &aWMgrWindow))
			{
				case inMenuBar:
					aString = "inMenuBar";
					break;
					
				case inSysWindow:
					aString = "inSysWindow";
					break;
					
				case inDrag:
					aString = "inDrag";
					break;
					
				case inGrow:
					aString = "inGrow";
					break;
					
				case inGoAway:
					aString = "inGoAway";
					break;
					
				case inContent:
					aString = "inContent";
					break;
					
				case inZoomIn:
					aString = "inZoomIn";
					break;
					
				case inZoomOut:
					aString = "inZoomOut";
					break;
					
				default:
					aString = "Mouse clicked in an unknown place.";
					break;
			}

			ProgramReport_AC("%5s\n", CChar255_AC(aString));
			break;
		}
		case keyDown:
		case autoKey:
		case keyUp:
		{
			if (fEventRecords[0].what == keyDown)
				ProgramReport_AC("keyDown     ");
			else if (fEventRecords[0].what == autoKey)
				ProgramReport_AC("autoKey     ");
			else
				ProgramReport_AC("keyUp       ");

			short ch = static_cast<short>(fEventRecords[0].message & charCodeMask);
			short cap = static_cast<short>(fEventRecords[0].message >> 8);

			if (ch >= chSpace && ch <= 0xD8 && ch != 0x7F)
				ProgramReport_AC("\"%c\"", ch);
			else
				ProgramReport_AC("   ");

			ProgramReport_AC("( %1d / %1d )\n", ch, cap);
			break;
		}

		case updateEvt:
		case activateEvt:
		{
			if (fEventRecords[0].what == updateEvt)
				ProgramReport_AC("updateEvt   ");
			else
				ProgramReport_AC("activateEvt ");

			CStr255_AC aString;
			GetWTitle((WindowRef)(fEventRecords[0].message), aString);
			ProgramReport_AC("\"%s\"\n", CChar255_AC(aString));
			break;
		}
		case diskEvt:
			ProgramReport_AC("diskEvt     d = %1d e = %1d \n", LoWord(fEventRecords[0].message), HiWord(fEventRecords[0].message));
			break;

		case osEvt:
			switch ((((fEventRecords[0].message) & osEvtMessageMask)) >> 24)
			{
				case suspendResumeMessage:
					if (fEventRecords[0].message & 1)
						ProgramReport_AC("resume      ");
					else
						ProgramReport_AC("suspend     ");
					break;
					
				case mouseMovedMessage:
				{
					ProgramReport_AC("mouse moved ");
					ProgramReport_AC("%s", CPoint_AC(fEventRecords[0].where).AsText().c_str());
					break;
				}
					
				default:
					ProgramReport_AC("osEvt     ");
					break;
			}
			WrLblHexLongint(", message", fEventRecords[0].message);
			ProgramReport_AC("\n");
			break;
			
		case kHighLevelEvent:
			WrLblHexLongint("kHighLevelEvent     , message", fEventRecords[0].message);
			ProgramReport_AC("\n");
			break;
			
		default:
			ProgramReport_AC("??? unknown = %1d   ", fEventRecords[0].what);
			WriteHexLongint(fEventRecords[0].message);
			break;
	}
}

#endif

//----------------------------------------------------------------------------------------
// End of UEvent.cpp

/*
	Historical Change Record:
		----- R13 -----
		07/16/97	Changed all ProgramBreak_AC to ProgramReport_AC in TToolboxEvent::ReportEvent
		07/14/97	[1665220] (Cursor/Sleep) Cursor regions seem to be broken/latent
		06/30/97	[1353169] fprinf(stderr, blah) to ProgramBreak_AC(blah)
		06/05/97	EXPORT_AC, EXPORT_MA, no-load fixes, Memory_AC, Windows_AC, no CW11orLATER, removed segmentation, etc...
		04/23/97	Remove Clone declarations from classes we don't clone.
		04/14/97	Update for real xxx_cast operators.
		04/08/97	Update for TToolBoxEvent protected fields.
		04/04/97	Update for TView/TWindow/TDispatcher protected fields.
		03/25/97	AC_ to _AC Name change.
		03/07/97	Massive Changes: Use Exceptions_AC, new to TH_new, use Blah_AC,
							Update Copyright, Moved Obsolete APIs into Compatibility.h, etc..
		02/19/97	Use embedded objects instead of auto_ptr based object where possible.
		01/17/97	Updated qMSWindows conditionals.
		01/13/97	Updated qWindows conditionals.
		12/05/96	Added qWindows conditionals.
		08/16/96	Use constructors for all TView descendents
		08/14/96	Use constructors for all TDispatcher descendents
		08/13/96	Use constructors for all TDocument descendents
		08/07/96	Removed more TObject ancestry.
		07/15/96	Boolean->bool
		----- R11 -----
		06/27/96	Make conditional tests implicit as in if(x) instead of if(x != 0).
		06/26/96	Changed nil back to NULL.
		06/26/96	Install release marker.  Scope many globals.  Change TRUE/FALSE/NULL.
		06/25/96	[1345531] Added #include "UMacAppUtilities.h" for noload buids
		04/15/96	Removed TToolboxEvent::RemoveDependenciesOnFree since we will soon
							stop mixing MDependent in at TObject
		----- R10 -----
		03/31/96	Conditioned TEvent::ReportEvent on qDebug
		03/26/96	Move initialization to CTOR
		03/26/96	CStr255_AC to char* conversion now requires const
		03/26/96	Added TToolboxEvent::fDoubleEvent to indicate if there is a second event available
		03/26/96	coerce CStrxxx_AC to const char* to get copies of the strings as c style strings
		03/25/96	TToolboxEvent::fCharacter is obsolete
							Made empty UAdorners constructors inline
		03/22/96	Changed TToolBoxEvent::fCharacter to CStr2_AC, added
							TToolBoxEvent::fKeyScript, added
							TToolBoxEvent::AddSecondaryKeyEvent, made
							TToolBoxEvent::IsxxxPressed non-virtual and const
		03/18/96	Remove compatibility hacks.
		 12/8/95	Split up includes for modular MacApp. 
		----- 3.3 -----
		----- 3.3b1 -----
		 6/17/95	Might as well also test fEventList. 
		 6/16/95	TEvent::~TEvent() tests gDispatcher
		 5/17/95	More WindowRef. 
		 5/16/95	WindowRef
		 3/23/95	Add compatibility hacks for 2.0f1 headers. 
		 3/13/95	Change Free methods to destructors. 
		 12/7/94	Remove erroneous & from fprintf of localWhere. 
		11/13/94	In TToolboxEvent::ReportEvent, use osEvtMessageMask
							as a mask rather than shift. 
		11/11/94	Removed TDragEvent. It was obsoleted by design changes.
		 9/12/94	Added TDragEvent class per Eric Hanig's
							MADrag additions.
*/