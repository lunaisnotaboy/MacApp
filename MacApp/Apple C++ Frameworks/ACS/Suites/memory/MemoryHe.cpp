//------------------------------------------------------------------------------
// MemoryHe.cpp
// Copyright © 1993-2001 by Apple Computer, Inc., all rights reserved.
//------------------------------------------------------------------------------

// Contains:	MemoryHeap class implementation

/*
	Change History
		03/01/01	Don't include Memory_AC. 
		01/02/01	Update copyright.
		11/09/00	[PB] Suppress GCC warnings about unused return variables. 
					[PB] Make the magic number types consistent. 
		09/20/00	Don’t start file with C-style quotes -- VC++ complains.
		09/01/00	Stripped dead code.
		08/22/00	CW Pro 6: Make operator delete to go with new(MMHeapLocation). 
		03/24/99	Update copyright notice.
		01/14/99	Split SearchForBlock into two functions: PlaceForBlock finds
					where a new free block belongs in the tree. SearchFreeBlocks
					finds a free block of the desired size or larger. 
					Changed the root block size back to 0, so it will never be
					used as a block, and so searches will never go down its
					left (smaller) branch. Put the FreeTree block self-address
					before the root block, because that's where StuffAddressAtEnd
					will set it. 
		11/16/98	[2284717] Add room for block address at end to FreeTree
					so its constructor doesn't stomp fHugeBlockSize. 
*/

#ifndef _MEMORYHE_
#include "MemoryHe.h"
#endif

// ACS

#ifndef _PLATFMEM_
#include "PlatfMem.h"
#endif

#ifndef _MEMMGRPV_
#include "MemMgrPv.h"
#endif

// Toolbox

#ifndef __MACMEMORY__
#include <MacMemory.h>
#endif

// ANSI

#ifndef __LIMITS__
#include <limits.h>
#endif

#ifndef __STRING__
#include <string.h>
#endif

#ifndef __STDIO__
#include <stdio.h>
#endif


#define BLOCKS_ON_4BYTE 1		// Allocate blocks on 4-byte boundaries.

//========================================================================================
// GLOBAL Functions
//========================================================================================

void CheckOneFreeBlock(const MemoryHeap::FreeBlock* blk);


//========================================================================================
// CLASS MemoryHeap::BlockHeaderBits
//========================================================================================

//----------------------------------------------------------------------------------------
// MemoryHeap::BlockHeaderBits constructor
//----------------------------------------------------------------------------------------

MemoryHeap::BlockHeaderBits::BlockHeaderBits(int busy, int previousBusy, long size) :
	fBits((kBlockTypeId << kBlockTypeShift) | (kBlockMagicNumber << kMagicNumberShift))
{
//	// ***** Setting these 4 bits can be greatly optimized -- slam a constant into fFlags
//	SetIsFirst(false);
//	SetIsObject(false);
//	SetBlockType(kBlockTypeId);
//	SetMagicNumber(kMagicNumber);

	SetBusy(busy);
	SetPrevBusy(previousBusy);
	SetSize(size);
}

//========================================================================================
// CLASS MemoryHeap::BlockHeader
//========================================================================================

//----------------------------------------------------------------------------------------
// MemoryHeap::BlockHeader constructor
//----------------------------------------------------------------------------------------

MemoryHeap::BlockHeader::BlockHeader(int busy, int previousBusy, long size)
	:	/* MemoryHeap:: */ BlockHeaderBits(busy, previousBusy, size)
{
}

//----------------------------------------------------------------------------------------
// MemoryHeap::BlockHeader copy constructor
//----------------------------------------------------------------------------------------

MemoryHeap::BlockHeader::BlockHeader(const MemoryHeap::BlockHeader& blk)
	:	/* MemoryHeap:: */ BlockHeaderBits(blk.fBits)
{
}

//----------------------------------------------------------------------------------------
// MemoryHeap::BlockHeader::operator >
//----------------------------------------------------------------------------------------

bool MemoryHeap::BlockHeader::operator >(const MemoryHeap::BlockHeader& blk) const
{
	if (GetSize() == blk.GetSize())
		return this > &blk;
	else
		return GetSize() > blk.GetSize();
}

//----------------------------------------------------------------------------------------
// MemoryHeap::BlockHeader::operator <
//----------------------------------------------------------------------------------------

bool MemoryHeap::BlockHeader::operator <(const MemoryHeap::BlockHeader& blk) const
{
	if (GetSize() == blk.GetSize())
		return this < &blk;
	else
		return GetSize() < blk.GetSize();
}

//----------------------------------------------------------------------------------------
// MemoryHeap::BlockHeader::operator ==
//----------------------------------------------------------------------------------------

bool MemoryHeap::BlockHeader::operator ==(const MemoryHeap::BlockHeader& blk) const
{
	return GetSize() == blk.GetSize() && this == &blk;
}

//----------------------------------------------------------------------------------------
// MemoryHeap::BlockHeader::GetNextBlock
//----------------------------------------------------------------------------------------

MemoryHeap::BlockHeader* MemoryHeap::BlockHeader::GetNextBlock() const
{
	BlockHeader* nextBlock = reinterpret_cast<BlockHeader*>(reinterpret_cast<MMBytePtr>(this) + GetSize());
#if MM_DEBUG
	MM_ASSERT(nextBlock->GetMagicNumber() == kBlockMagicNumber);
// Test for block size will fail on the small block at the end of the segment
//	MMSize blkSize = nextBlock->GetSize();
//	MM_ASSERT(blkSize >= kMinBlockSize && blkSize <= kMaxBlockSize);
#endif
	return nextBlock;
}


//========================================================================================
// CLASS MemoryHeap::Block
//========================================================================================

//----------------------------------------------------------------------------------------
// MemoryHeap::Block constructor
//----------------------------------------------------------------------------------------

MemoryHeap::Block::Block(int previousBusy, long size, MemoryHeap* heapPtr)
	:	/* MemoryHeap:: */ BlockHeader(true, previousBusy, size),
		fHeap(heapPtr)
{
}

//----------------------------------------------------------------------------------------
// MemoryHeap::Block copy constructor
//----------------------------------------------------------------------------------------

MemoryHeap::Block::Block(const MemoryHeap::Block& blk)
	:	/* MemoryHeap:: */ BlockHeader(blk),
		fHeap(blk.fHeap)
{
}


//========================================================================================
// CLASS MemoryHeap::FreeBlock
//========================================================================================

//----------------------------------------------------------------------------------------
// MemoryHeap::FreeBlock constructor
//----------------------------------------------------------------------------------------

MemoryHeap::FreeBlock::FreeBlock(int previousBusy, long size)
	:	/* MemoryHeap:: */BlockHeader(false, previousBusy, size),
		fParent(NULL),
		fLeft(NULL),
		fRight(NULL)
{
	StuffAddressAtEnd();
}


//----------------------------------------------------------------------------------------
// MemoryHeap::FreeBlock copy constructor
//----------------------------------------------------------------------------------------

MemoryHeap::FreeBlock::FreeBlock(const MemoryHeap::FreeBlock& blk)
	:	/* MemoryHeap:: */ BlockHeader(blk),
		fParent(blk.fParent),
		fLeft(blk.fLeft),
		fRight(blk.fRight)
{
	StuffAddressAtEnd();
}

//----------------------------------------------------------------------------------------
// MemoryHeap::FreeBlock::operator =
//----------------------------------------------------------------------------------------

MemoryHeap::FreeBlock& MemoryHeap::FreeBlock::operator =(const MemoryHeap::FreeBlock& blk)
{
	fBits = blk.fBits;
	fParent = blk.fParent;
	fLeft = blk.fLeft;
	fRight = blk.fRight;

	// Probably should SetBusy(true) but let's allow copying blocks that aren't free. 
	if (!GetBusy())
		StuffAddressAtEnd();

	return (*this);
}

//----------------------------------------------------------------------------------------
// MemoryHeap::FreeBlock::StuffAddressAtEnd
//----------------------------------------------------------------------------------------

void MemoryHeap::FreeBlock::StuffAddressAtEnd()
{
	// coalescence possible in constant time.

	if (!GetBusy())
	{
		void** addr= reinterpret_cast<void**>(reinterpret_cast<MMBytePtr>(this) + GetSize() - sizeof(BlockHeader*));
		*addr = this;
	}
#if MM_DEBUG
	else
		MM_WARN("MemoryHeap::FreeBlock::StuffAddressAtEnd: corrupt heap!");
#endif
}

//----------------------------------------------------------------------------------------
// MemoryHeap::FreeBlock::GetPreviousBlock
//----------------------------------------------------------------------------------------

MemoryHeap::FreeBlock* MemoryHeap::FreeBlock::GetPreviousBlock() const
{
	FreeBlock* previousBlock = NULL;

	if (!GetPreviousBusy())
	{
		// Get the address of the previous block from its end,
		// which is the long word just before this block
		previousBlock = *reinterpret_cast<FreeBlock**>(reinterpret_cast<MMBytePtr>(this) - sizeof(MMSize));
	}
#if MM_DEBUG
	MM_ASSERT(previousBlock->GetMagicNumber() == kBlockMagicNumber);
	MM_ASSERT(previousBlock->GetNextBlock() == reinterpret_cast<const BlockHeader*>(this));
#endif

	return previousBlock;
}

//----------------------------------------------------------------------------------------
// MemoryHeap::FreeBlock::Append:
//----------------------------------------------------------------------------------------

void MemoryHeap::FreeBlock::Append(MemoryHeap::FreeBlock* following)
{
#if MM_DEBUG
	MM_ASSERT(!GetBusy() && !following->GetPreviousBusy());
	if (following->GetSize() < kMinBlockSize)
		MM_WARN("MemoryHeap::FreeBlock::Append: corrupt heap!");
#endif
	SetSize(GetSize() + following->GetSize());
	StuffAddressAtEnd();
}


//========================================================================================
// CLASS MemoryHeap::Segment
//========================================================================================

//----------------------------------------------------------------------------------------
// MemoryHeap::Segment::InitSegment
//----------------------------------------------------------------------------------------

MemoryHeap::FreeBlock* MemoryHeap::Segment::InitSegment(unsigned long size, Segment* nextSegment,
														MemoryHeap* heapPtr)
{
	// The actual usable space is offset by the size of the fields
	// of a Segment.

	fSegmentSpace = reinterpret_cast<void*>(reinterpret_cast<MMBytePtr>(this) + Segment::kSegmentPrefixSize);
	fSegmentSize = size - Segment::kSegmentPrefixSize;

	// Add the segment to the list of segments in this heap.
	fNextSegment = nextSegment;

	// Suffix the segment with a busy block of zero length so that the last free
	// block is not coalesced with a block past the fEnd of the segment.

	MMSize freeSize = fSegmentSize - sizeof(Block);
	void* atEnd = reinterpret_cast<void*>(reinterpret_cast<MMBytePtr>(fSegmentSpace) + freeSize);
	Block* blk = new(atEnd) Block(false, sizeof(Block), heapPtr);
#if qProjectBuilder
	(void) blk;
#endif

	// Create one free block out of this entire segment and add it to the
	// free block list.

	FreeBlock* newBlk = new(fSegmentSpace) FreeBlock(true, freeSize);

	// First segment is NOT disposable
	if (nextSegment != NULL)
	{
		// This is the 1st block (positionally) in the heap, so set its bit:  --jpa
		newBlk->SetIsFirst(true); 
	}
	
	return newBlk;
}

//----------------------------------------------------------------------------------------
// MemoryHeap::Segment::CheckSegment
//----------------------------------------------------------------------------------------

bool MemoryHeap::Segment::CheckSegment( HeapWalkProc proc, void* refCon, MMSize hdrSize )
{
	Block* blk = reinterpret_cast<Block*>(fSegmentSpace);
	void* segmentEnd = static_cast<char*>(fSegmentSpace) + fSegmentSize;
	unsigned long blksScanned = 0;

	// ----- spin through all the blocks in segment do some consistency checks
	
	while (blk < segmentEnd)
	{
		Block* nextBlk;
		MM_ASSERT(blk->GetMagicNumber() == Block::kBlockMagicNumber);
		MM_ASSERT(blk->GetBlockType() == Block::kBlockTypeId);
		nextBlk = reinterpret_cast<Block*>(reinterpret_cast<char*>(blk) +  blk->GetSize());
		if(nextBlk==blk)
		{
			MM_WARN("Block %p header damaged -- skipping segment",blk);
			return false;
		}
		else if( nextBlk > segmentEnd )
		{
			MM_WARN("Block %p unnaturally large -- skipping segment",blk);
			return false;
		}
		else if (nextBlk < segmentEnd)
			MM_ASSERT(nextBlk->GetPreviousBusy() == blk->GetBusy());
		
		if( proc )			// Call user proc if they supplied one
			if( blk->GetBusy() && nextBlk<segmentEnd )
			{
				MMBytePtr userBlk = reinterpret_cast<MMBytePtr>(blk) + kBusyOverhead + hdrSize;
				if( (*proc)(reinterpret_cast<void*>(userBlk), blk->GetSize() - hdrSize, blk->GetIsObject(), refCon) == false )
					return false;		// proc can return false to abort
			}
		
		blksScanned++;
		blk = nextBlk;
	}

	// ----- if sizes are valid we should be exactly at the end of the segment
	
	MM_ASSERT(blk == segmentEnd);
	return true;
}

#if MM_DEBUG
//----------------------------------------------------------------------------------------
// MemoryHeap::Segment::FindBlockContaining
//----------------------------------------------------------------------------------------

MMBoolean MemoryHeap::Segment::FindBlockContaining( const void* start, const void* end,
													 const void* &blockStart, const void* &blockEnd ) const
{
	Block* blk = reinterpret_cast<Block*>(fSegmentSpace);
	void* segmentEnd = static_cast<char*>(fSegmentSpace) + fSegmentSize;
	
	if ( end <= blk || start >= segmentEnd )
		return false;
	else
	{
		// Memory range intersects range of this segment:
		while (blk < segmentEnd)
		{
			blockStart = blockEnd = NULL;
			Block* nextBlk = reinterpret_cast<Block*>(reinterpret_cast<char*>(blk) +  blk->GetSize());
			if( blk->GetBusy() && nextBlk < segmentEnd )
			{
				if( start <= nextBlk )
				{
					// The memory range starts before the next block, so return:
					blockStart = blk->GetContents();
					blockEnd   = nextBlk;
					break;
				}
			}
			blk = nextBlk;
		}
		return true;
	}
}

#endif


//========================================================================================
// CLASS MemoryHeap::FreeTree
//========================================================================================

//----------------------------------------------------------------------------------------
// MemoryHeap::FreeTree constructor
//----------------------------------------------------------------------------------------

MemoryHeap::FreeTree::FreeTree() :
	fRoot(true, 0)
{
}

//----------------------------------------------------------------------------------------
// MemoryHeap::FreeTree copy constructor
//----------------------------------------------------------------------------------------

MemoryHeap::FreeTree::FreeTree(const MemoryHeap::FreeTree& blk) :
	fRoot(blk.fRoot)
{
}

//----------------------------------------------------------------------------------------
// MemoryHeap::FreeTree::operator =
//----------------------------------------------------------------------------------------

MemoryHeap::FreeTree& MemoryHeap::FreeTree::operator =(const MemoryHeap::FreeTree& blk)
{
	fRoot = blk.fRoot;
	return (*this);
}

//----------------------------------------------------------------------------------------
// MemoryHeap::FreeTree::AddBlock
//----------------------------------------------------------------------------------------

void MemoryHeap::FreeTree::AddBlock(MemoryHeap::FreeBlock* blk)
{	
#if MM_DEBUG
	if( gValidate>0 )
		CheckTree();

#ifdef OD_INTENSE_DEBUG
	MM_PRINT("MemoryHeap::FreeTree::AddBlock Entry-------------------------------------\n");
	PrintTree();
#endif
#endif

	FreeBlock* parent = PlaceForBlock(blk);

	blk->SetRight(NULL);
	blk->SetLeft(NULL);
	blk->SetParent(parent);

	// This is really comparing the sizes
	if (*blk > *parent)
		parent->SetRight(blk);
	else
		parent->SetLeft(blk);

#if MM_DEBUG
	if( gValidate>0 )
		CheckTree();

#ifdef OD_INTENSE_DEBUG
	MM_PRINT("MemoryHeap::FreeTree::AddBlock Exit\n");
	PrintTree();
	MM_PRINT("\n");
#endif
#endif
}

#if MM_DEBUG
//----------------------------------------------------------------------------------------
// MemoryHeap::FreeTree::CheckTree
//----------------------------------------------------------------------------------------

void MemoryHeap::FreeTree::CheckTree() const
{
	CheckTreeHelper(&fRoot);
}
#endif

#if MM_DEBUG
//----------------------------------------------------------------------------------------
// MemoryHeap::FreeTree::PrintTree
//----------------------------------------------------------------------------------------

void MemoryHeap::FreeTree::PrintTree() const
{
	PrintTreeHelper(&fRoot);
}
#endif

//----------------------------------------------------------------------------------------
// MemoryHeap::FreeTree::RemoveBlock
//----------------------------------------------------------------------------------------

MemoryHeap::Block* MemoryHeap::FreeTree::RemoveBlock(MemoryHeap::FreeBlock* blk)
{
#if MM_DEBUG
	if( gValidate > 0 )
		CheckTree();

#ifdef OD_INTENSE_DEBUG
	MM_PRINT("MemoryHeap::FreeTree::RemoveBlock Entry----------------------------------\n");
	PrintTree();
#endif
#endif

	FreeBlock* spliceOutBlk;

	// Decide which block to splice out of the tree. Either the block being
	// removed, or its successor block in the tree.

	if (blk->GetLeft() == NULL || blk->GetRight() == NULL)
		spliceOutBlk = blk;
	else
		spliceOutBlk = GetSuccessorBlk(blk);

	// Splice the node out of the tree

	FreeBlock* tmp;
	FreeBlock* parent = spliceOutBlk->GetParent();
	if (spliceOutBlk->GetLeft())
		tmp = spliceOutBlk->GetLeft();
	else
		tmp = spliceOutBlk->GetRight();
	if (tmp)
		tmp->SetParent(parent);
	if (spliceOutBlk == parent->GetLeft())
		parent->SetLeft(tmp);
	else
		parent->SetRight(tmp);

	// If we spliced out the successor to blk above then we need to patch the successor
	// back in, in place of blk.

	if (spliceOutBlk != blk)
	{
		FreeBlock* parent = blk->GetParent();

		// Fix up the parent's child pointer.

		if (parent->GetLeft() == blk)
			parent->SetLeft(spliceOutBlk);
		else
			parent->SetRight(spliceOutBlk);

		// Fix up the splice in block's pointers.

		spliceOutBlk->SetParent(parent);
		spliceOutBlk->SetLeft(blk->GetLeft());
		spliceOutBlk->SetRight(blk->GetRight());

		// Fix up the children of the splice in block's parent pointers.

		if (spliceOutBlk->GetLeft())
			(spliceOutBlk->GetLeft())->SetParent(spliceOutBlk);
		if (spliceOutBlk->GetRight())
			(spliceOutBlk->GetRight())->SetParent(spliceOutBlk);
	}

#if MM_DEBUG
	if( gValidate>0 )
		CheckTree();

#ifdef OD_INTENSE_DEBUG
	MM_PRINT("MemoryHeap::FreeTree::RemoveBlock Exit\n");
	PrintTree();
	MM_PRINT("\n");
#endif
#endif
	return reinterpret_cast<Block*>(blk);
}

//----------------------------------------------------------------------------------------
// MemoryHeap::FreeTree::PlaceForBlock
//----------------------------------------------------------------------------------------

MemoryHeap::FreeBlock* MemoryHeap::FreeTree::PlaceForBlock(const FreeBlock* blk)
{
#if MM_DEBUG
	if( gValidate>0 )
		CheckTree();

#ifdef OD_INTENSE_DEBUG
	char str[80];
	sprintf(str, "MemoryHeap::FreeTree::PlaceForBlock(%d)---------------------------------\n", size);
	::Assertion_AC(::strlen(str) < sizeof(str),
				   "MemoryHeap::FreeTree::PlaceForBlock: Write beyond end of str.");
	MM_PRINT(str);
	PrintTree();
#endif
#endif

	MMSize size = blk->GetSize();

	FreeBlock* insertLeaf = NULL;
	FreeBlock* currentBlock = &fRoot;
	do
	{
		insertLeaf = currentBlock;

		// Determine which branch of the tree to continue down. Since duplicate keys are
		// difficult to deal with in binary trees, we use the address of blocks to break
		// ties, in the case of two blocks whose size are equal.

		long diff = currentBlock->GetSize() - size;
		if (diff > 0)
			currentBlock = currentBlock->GetLeft();
		else if (diff < 0)
			currentBlock = currentBlock->GetRight();
		else if (blk)
		{
			if (blk <= currentBlock)
				currentBlock = currentBlock->GetLeft();
			else
				currentBlock = currentBlock->GetRight();
		}
		else
			currentBlock = currentBlock->GetLeft();
	}
	while (currentBlock != NULL);

	return insertLeaf;
}

//----------------------------------------------------------------------------------------
// MemoryHeap::FreeTree::SearchFreeBlocks
//----------------------------------------------------------------------------------------

MemoryHeap::FreeBlock* MemoryHeap::FreeTree::SearchFreeBlocks(MMSize size)
{
#if MM_DEBUG
	if( gValidate>0 )
		CheckTree();

#ifdef OD_INTENSE_DEBUG
	char str[80];
	sprintf(str, "MemoryHeap::FreeTree::SearchFreeBlocks(%d)---------------------------------\n", size);
	::Assertion_AC(::strlen(str) < sizeof(str),
				   "MemoryHeap::FreeTree::SearchFreeBlocks: Write beyond end of str.");
	MM_PRINT(str);
	PrintTree();
#endif
#endif

	long minDiff = LONG_MAX;
	FreeBlock* minDiffBlock = NULL;
	FreeBlock* currentBlock = &fRoot;
	do
	{
		long diff = currentBlock->GetSize() - size;
		if (diff >= 0 && diff < minDiff)
		{
			minDiffBlock = currentBlock;
			minDiff = diff;
			if (minDiff == 0)
				break;
		}

		if (diff < 0)
			currentBlock = currentBlock->GetRight();
		else
			currentBlock = currentBlock->GetLeft();
	}
	while (currentBlock != NULL);

	return minDiffBlock;
}

//----------------------------------------------------------------------------------------
// MemoryHeap::FreeTree::FindLargestBlock
//----------------------------------------------------------------------------------------

const MemoryHeap::FreeBlock* MemoryHeap::FreeTree::FindLargestBlock() const
{
	// The block to the right in the tree is always larger...
	
	const FreeBlock* currentBlock = &fRoot;
	const FreeBlock* nextBlock;
	while( (nextBlock = currentBlock->GetRight()) != NULL )
		currentBlock = nextBlock;
	return currentBlock;
}

//----------------------------------------------------------------------------------------
// MemoryHeap::FreeTree::TreeInfo
//----------------------------------------------------------------------------------------

void MemoryHeap::FreeTree::TreeInfo(unsigned long& bytesFree,
									unsigned long& numberOfNodes) const
{
	bytesFree = numberOfNodes = 0;
	TreeInfoHelper(&fRoot, bytesFree, numberOfNodes);

	// Subtract one from the number of nodes to account for the header node which
	// is always empty.

	numberOfNodes--;
}

#if MM_DEBUG
// •••  get these updates back into the OpenDoc Version
//----------------------------------------------------------------------------------------
// CheckOneFreeBlock
//----------------------------------------------------------------------------------------

void CheckOneFreeBlock(const MemoryHeap::FreeBlock* blk)
{
	//  Part of a revised algorithm for checking the free block tree.
	//  May be used freely. Please send suggestions or enhancements to
	//  Adam Wildavsky <adamw@panix.com>
	
	//  CheckOneFreeBlock() could/should be a BestFitBlock method. It's
	//  not only because I did not want to modify MemoryHeap.h. In any
	//  case it's called only by FreeBlockTree::CheckTreeHelper().
	
	//  Additional tests here would be nice. I'm open to suggestion!
	//
	//  - Adam Wildavsky 9/14/95

	if (blk->GetMagicNumber() != (unsigned long)MemoryHeap::FreeBlock::kBlockMagicNumber)
	{
		MM_WARN("CheckOneFreeBlock - " "Corrupt free list tree: " "Bad magic number in block.");
	}

	if ((blk->GetRight() && blk->GetRight()->GetParent() != blk) ||
		(blk->GetLeft() && blk->GetLeft()->GetParent() != blk))
	{
		MM_WARN("CheckOneFreeBlock - " "Corrupt free list tree: " "I am not my child's parent.");
	}
}

//----------------------------------------------------------------------------------------
// MemoryHeap::FreeTree::CheckTreeHelper
//----------------------------------------------------------------------------------------

void MemoryHeap::FreeTree::CheckTreeHelper(const MemoryHeap::FreeBlock* blk) const
{
	//  Updated by Adam Wildavsky 8/16/95. Replaced the recursive tree walk with
	//  an iterative one which uses the "Right hand rule." It always walks down
	//  the right child if it can, then the left child, then back to the parent.
	//  It determines its state by checking to see where it came from.

	//  Make sure the loop will terminate!
	if (blk->GetParent())
	{
		MM_WARN("FreeBlockTree::CheckTreeHelper - " "Corrupt free list tree: " "Root node's parent must be NULL.");
	}

	const FreeBlock* previousBlock = NULL;

	while (blk)
	{
		if (previousBlock == blk->GetParent())
		{
			//  Make certain I can come back before I go down!
			CheckOneFreeBlock(blk);

			previousBlock = blk;
			if (previousBlock->GetRight())
				blk = previousBlock->GetRight();
			else if (previousBlock->GetLeft())
				blk = previousBlock->GetLeft();
			else
				blk = previousBlock->GetParent();
		}
		else if (previousBlock == blk->GetRight())
		{
			previousBlock = blk;
			if (previousBlock->GetLeft())
				blk = previousBlock->GetLeft();
			else
				blk = previousBlock->GetParent();
		}
		else if (previousBlock == blk->GetLeft())
		{
			previousBlock = blk;
			blk = previousBlock->GetParent();
		}
		else
		{
			MM_WARN("Programmer error in " "FreeBlockTree::CheckTreeHelper().");
		}
	}
}

#endif

//----------------------------------------------------------------------------------------
// MemoryHeap::FreeTree::GetSuccessorBlk
//----------------------------------------------------------------------------------------

MemoryHeap::FreeBlock* MemoryHeap::FreeTree::GetSuccessorBlk(const MemoryHeap::FreeBlock* blk) const
{
	if (blk->GetRight())
	{
		FreeBlock* current = blk->GetRight();
		while (current->GetLeft())
			current = current->GetLeft();
		return current;
	}
	else
	{
		FreeBlock* parent = blk->GetParent();
		FreeBlock* current = NULL;
		while (parent != NULL && current == parent->GetRight())
		{
			current = parent;
			parent = parent->GetParent();
		}
		return parent;
	}
}

#if MM_DEBUG
//----------------------------------------------------------------------------------------
// MemoryHeap::FreeTree::PrintTreeHelper
//----------------------------------------------------------------------------------------

void MemoryHeap::FreeTree::PrintTreeHelper(const MemoryHeap::FreeBlock* blk, int level) const
{
	for (int i = 0; i < level; i++)
		MM_PRINT("\t");

	if (blk == NULL)
	{
		MM_PRINT("NULL\n");
		return;
	}

	PrintTreeHelper(blk->GetLeft(), level + 1);
	PrintTreeHelper(blk->GetRight(), level + 1);
}
#endif

//----------------------------------------------------------------------------------------
// MemoryHeap::FreeTree::TreeInfoHelper
//----------------------------------------------------------------------------------------

void MemoryHeap::FreeTree::TreeInfoHelper(const MemoryHeap::FreeBlock* blk,
										   unsigned long& bytesFree,
										   unsigned long& numberOfNodes) const
{
	if (blk == NULL)
		return;

	TreeInfoHelper(blk->GetLeft(), bytesFree, numberOfNodes);

	numberOfNodes++;
	bytesFree += blk->GetSize();

	TreeInfoHelper(blk->GetRight(), bytesFree, numberOfNodes);
}


//========================================================================================
// CLASS MemoryHeap
//========================================================================================

MemoryHeap *MemoryHeap::fHeapList;								// Don't initialize!
#if MM_DEBUG
const char *MemoryHeap::kDefaultDescription = "Give this MemoryHeap a description";
const char *MemoryHeap::kDeadHeapDescription = "Dead heap, dead heap, dead heap!";
#endif

//----------------------------------------------------------------------------------------
// MemoryHeap constructor
//----------------------------------------------------------------------------------------

MemoryHeap::MemoryHeap(unsigned long sizeInitial,
					   unsigned long sizeIncrement,
					   unsigned long hugeBlockSize,		// "0" means sizeIncrement/2
					   MMHeapLocation memSrc) :
	fNextHeap(NULL),
	fMemSource(memSrc),
	fZapOnAllocate(false),
	fZapOnFree(false),
#if MM_DEBUG
	fAutoValidation(false),
#endif
	fBytesAllocated(0),
	fNumberAllocatedBlocks(0),
	fMagicNumber(kHeapMagicNumber),
	fSlushFund(NULL),
	fSlushFundSize(0),
	fSlushFundAllocSizeLimit(0),
	fSegments(NULL),
	fSizeIncrement(sizeIncrement),
	fSizeInitial(sizeInitial),
	fHugeBlockSize(hugeBlockSize)
{
#if MM_DEBUG
	SetDescription();
#endif
	
	// Add to the static list of heaps
	
	fNextHeap = fHeapList;
	fHeapList = this;

#if MM_DEBUG
	CompilerCheck();
#endif

	if( hugeBlockSize == 0 )
		fHugeBlockSize = sizeIncrement >> 1;
	
	if( fHugeBlockSize > kMaxHugeBlockSize )
		fHugeBlockSize = kMaxHugeBlockSize;
		
	if( fHugeBlockSize > sizeIncrement )
	{
		MM_WARN("hugeSize must be <= sizeIncrement");
		fHugeBlockSize = sizeIncrement;		// Cannot allow range between huge size & sizeIncrement
	}
}

//----------------------------------------------------------------------------------------
// MemoryHeap destructor
//----------------------------------------------------------------------------------------

MemoryHeap::~MemoryHeap()
{
	ValidateMagicNumber();

	DeleteSegments();

	// ----- Remove from the static list of heaps
	
	MemoryHeap *lastHeap = NULL;
	MemoryHeap *currentHeap = fHeapList;
	
	while (currentHeap != NULL)
	{
		if (this == currentHeap)
		{
			if (lastHeap == NULL)
				fHeapList = currentHeap->GetNextHeap();
			else
				lastHeap->fNextHeap = currentHeap->GetNextHeap();
			
			currentHeap = NULL;
		}
		else
		{
			lastHeap = currentHeap;
			currentHeap = currentHeap->GetNextHeap();
		}
	}

#if MM_DEBUG
	SetDescription(kDeadHeapDescription);
#endif
	
	fMagicNumber = 0;
}

//----------------------------------------------------------------------------------------
// MemoryHeap::IMemoryHeap
//----------------------------------------------------------------------------------------

void MemoryHeap::IMemoryHeap()
{
	GrowHeap(fSizeInitial);
}

//----------------------------------------------------------------------------------------
// MemoryHeap::operator new
//----------------------------------------------------------------------------------------

void* MemoryHeap::operator new(size_t size, MMHeapLocation src)
{
	return PlatformAllocateBlock(size, src);
}

//----------------------------------------------------------------------------------------
// MemoryHeap::operator delete
//----------------------------------------------------------------------------------------

#if __MWERKS__ >= 0x2400
void MemoryHeap::operator delete(void* ptr, MMHeapLocation /*src*/)
{
	PlatformFreeBlock(ptr);
}
#endif

void MemoryHeap::operator delete(void* ptr)
{
	PlatformFreeBlock(ptr);
}

//----------------------------------------------------------------------------------------
// The Essentials
//----------------------------------------------------------------------------------------

//----------------------------------------------------------------------------------------
// MemoryHeap::Allocate
//----------------------------------------------------------------------------------------

void *MemoryHeap::Allocate(MMSize size)
{
	ValidateMagicNumber();

	MMSize originalSize = size;
	MMSize allocatedSize = 0;
	void *blk = DoAllocate( size, allocatedSize);
	
	if( blk == NULL && originalSize <= fSlushFundAllocSizeLimit )
	{
		// Free slush fund. Do not try again, let the caller know it ran out of memory.
		// But a little memory will now be available to make cleanup possible.
		MM_WARN( GetSlushFundSize()>0 ?"Out of memory. Freed slush fund."
										:"Out of memory, no slush fund. Oh, dear." );
		FreeSlushFund();
	}
	
	if (blk != NULL)
	{
		if (fZapOnAllocate)
			PlatformZapMem(blk, allocatedSize, 0xBBBBBBBB);
		fBytesAllocated += allocatedSize;
		fNumberAllocatedBlocks++;
	}

	return blk;
}

//----------------------------------------------------------------------------------------
// MemoryHeap::Reallocate
//----------------------------------------------------------------------------------------

void *MemoryHeap::Reallocate(void *ptr, MMSize newSize)
{
	ValidateMagicNumber();

	if (ptr == NULL)
		return Allocate(newSize);

	MMSize oldBlkSize = BlockSize(ptr);

	MMSize allocatedSize = 0;
	void* newBlock = DoAllocate(newSize, allocatedSize);
	if (newBlock != NULL)
	{
		MMSize copySize = newSize <= oldBlkSize ? newSize : oldBlkSize;
		PlatformCopyMemory(ptr, newBlock, copySize);

		if (fZapOnFree)
		{
			unsigned char* chrBlk = static_cast<unsigned char*>(ptr);
			for (MMSize i = 0; i < oldBlkSize; i++)
				*chrBlk++ = 0xDD;
		}

		DoFree(ptr);

		fBytesAllocated += allocatedSize - oldBlkSize;
	}
	else
	{
		if (newSize <= oldBlkSize)
		{
			// if unable to get new fMem, and newSize is <= real size
			// then return original ptr unchanged
			newBlock = ptr;
		}
	}

	return newBlock;
}

//----------------------------------------------------------------------------------------
// MemoryHeap::Free
//----------------------------------------------------------------------------------------

void MemoryHeap::Free(void* ptr)
{
	ValidateMagicNumber();

	if (ptr == NULL)
		return;
		
#if MM_DEBUG
	if (fAutoValidation)
		ValidateAndReport(ptr);
#endif
	
	MMSize allocatedSize = BlockSize(ptr);
	
	if (fZapOnFree)
		PlatformZapMem(ptr, allocatedSize, 0xDDDDDDDD);

	DoFree(ptr);

	fBytesAllocated -= allocatedSize;
	fNumberAllocatedBlocks--;
}

//----------------------------------------------------------------------------------------
// Block Functions
//----------------------------------------------------------------------------------------

//----------------------------------------------------------------------------------------
// MemoryHeap::BlockSize
//----------------------------------------------------------------------------------------

MMSize MemoryHeap::BlockSize(const void *ptr) const
{
	ValidateMagicNumber();

	if (ptr == NULL)
		return 0;
		
#if MM_DEBUG
	if (fAutoValidation)
		ValidateAndReport(ptr);
#endif

	const Block* blk = Block::GetBlock(ptr);
#if MM_DEBUG
	MM_ASSERT(blk->GetBusy());
#endif
	return blk->GetAllocatedSize();
}

//----------------------------------------------------------------------------------------
// MemoryHeap::GetBlockHeap
//----------------------------------------------------------------------------------------

MemoryHeap* MemoryHeap::GetBlockHeap( const void* ptr ) const
{
	// This makes the assumption (in a debug build) that the block's heap
	// has the same memory hooks installed as this one. In reality this is the
	// case; but at some future point it might cause trouble......
	// In any case this will not occur in a non-debug build.
	
	ValidateMagicNumber();

#if MM_DEBUG
	if (!ValidBlock(ptr))
	{
		MM_WARN("GetBlockHeap(%p): bogus block", ptr);
		return NULL;
	}
#endif
	
	const Block* blk = Block::GetBlock(ptr);

	MemoryHeap* heap = blk->GetHeap();
#if MM_DEBUG
	if( !heap->ValidateMagicNumber() )
		return NULL;
#endif
	return heap;
}

//----------------------------------------------------------------------------------------
// MemoryHeap::SetBlockIsObject
//----------------------------------------------------------------------------------------

void MemoryHeap::SetBlockIsObject( void* ptr, bool isObject )
{
	ValidateMagicNumber();

#if MM_DEBUG
	MM_ASSERT(IsValidBlock(ptr));
#endif
	Block* blk = Block::GetBlock(ptr);
	blk->SetIsObject(isObject);
}

//----------------------------------------------------------------------------------------
// MemoryHeap::BlockIsObject
//----------------------------------------------------------------------------------------

bool MemoryHeap::BlockIsObject( const void* ptr ) const
{
	ValidateMagicNumber();

#if MM_DEBUG
	MM_ASSERT(IsValidBlock(ptr));
#endif
	const Block* blk = Block::GetBlock(ptr);
	return blk->GetIsObject();
}

#if MM_DEBUG
//----------------------------------------------------------------------------------------
// MemoryHeap::IsValidBlock (MM_DEBUG only)
//----------------------------------------------------------------------------------------

bool MemoryHeap::IsValidBlock(const void *ptr) const
{
	ValidateMagicNumber();

	if (ptr == NULL)
		return false;
	
	if (IsMyBlock(ptr))
	{
		const Block* blk = ValidBlock(ptr);
		if( !blk )
			return false;
		else
			// Verify that a huge block must be the first block in its segment:
			return blk->GetIsFirst() || blk->GetSize() < fHugeBlockSize;
	}
	else
		return false;
}
#endif

#if MM_DEBUG
//----------------------------------------------------------------------------------------
// MemoryHeap::IsMyBlock
//----------------------------------------------------------------------------------------

bool MemoryHeap::IsMyBlock(const void* ptr) const
{
	bool myBlock = false;

	Segment* segment = fSegments;
	while (segment != NULL && myBlock == false)
	{
		myBlock = segment->AddressInSegment(ptr);
		segment = segment->fNextSegment;
	}

	return myBlock;
}
#endif

//----------------------------------------------------------------------------------------
// Heap Functions
//----------------------------------------------------------------------------------------

//----------------------------------------------------------------------------------------
// MemoryHeap::Reset
//----------------------------------------------------------------------------------------

void MemoryHeap::Reset()
{
	ValidateMagicNumber();

	fBytesAllocated = 0;
	fNumberAllocatedBlocks = 0;
	
	DeleteSegments();
	fSegments = NULL;
	fFreeTree = FreeTree();

	GrowHeap(fSizeInitial);
}

//----------------------------------------------------------------------------------------
// MemoryHeap::BytesFree
//----------------------------------------------------------------------------------------

unsigned long MemoryHeap::BytesFree() const
{
	unsigned long bytesFree, numberOfNodes;

	fFreeTree.TreeInfo(bytesFree, numberOfNodes);
	bytesFree -= numberOfNodes * kBusyOverhead;

	return bytesFree;
}

//----------------------------------------------------------------------------------------
// MemoryHeap::HeapSize
//----------------------------------------------------------------------------------------

unsigned long MemoryHeap::HeapSize() const
{
	unsigned long heapSize = 0;

	Segment* segment = fSegments;
	while (segment != NULL)
	{
		heapSize += segment->fSegmentSize;
		segment = segment->fNextSegment;
	}

	return heapSize;
}

//----------------------------------------------------------------------------------------
// MemoryHeap::LargestFreeBlock
//----------------------------------------------------------------------------------------

unsigned long MemoryHeap::LargestFreeBlock() const
{
	long result = 0;

	const FreeBlock* blk = fFreeTree.FindLargestBlock();
	if ( blk )
	{
		result = blk->GetAllocatedSize();
		if (result < 0)
			result = 0;
	}

	return result;
}

//----------------------------------------------------------------------------------------
// MemoryHeap::AllocateSlushFund
//----------------------------------------------------------------------------------------

MMBoolean MemoryHeap::AllocateSlushFund(size_t size, size_t allocSizeLimit)
{
	if ( size == 0 )
	{
		FreeSlushFund();
		return true;
	}
	Free(fSlushFund);
	size_t oldLimit = fSlushFundAllocSizeLimit;
#if qProjectBuilder
	(void) oldLimit;
#endif
	fSlushFundAllocSizeLimit = 0;
	MMBlock slushy = Allocate(size);
	if( !slushy )
	{
		if( fSlushFund )
		{
			fSlushFund = Allocate(fSlushFundSize);
			if( !fSlushFund ) 
				MM_WARN("Yow! Lost slush fund accidentally");
		}
		return false;
	}
	fSlushFund = slushy;
	fSlushFundSize = size;
	fSlushFundAllocSizeLimit = allocSizeLimit;
	return true;
}

//----------------------------------------------------------------------------------------
// MemoryHeap::FreeSlushFund
//----------------------------------------------------------------------------------------

size_t MemoryHeap::FreeSlushFund()
{
	Free(fSlushFund);
	fSlushFund = NULL;
	size_t size = fSlushFundSize;
	fSlushFundSize = fSlushFundAllocSizeLimit = 0;
	return size;
}

#if MM_DEBUG
//----------------------------------------------------------------------------------------
// MemoryHeap::SetDescription (MM_DEBUG only)
//----------------------------------------------------------------------------------------

void MemoryHeap::SetDescription(const char *description)
{
	ValidateMagicNumber();

	// ------ Set the description without depending on other code
	
	const char *src = description;
	char *dst = fDescription;
	int i;
	
	for (i = 0; i < kDescriptionLength - 1 && *src; i++)
		*dst++ = *src++;
	fDescription[i] = 0;
}
#endif

#if MM_DEBUG
//----------------------------------------------------------------------------------------
// MemoryHeap::FindBlockContaining (MM_DEBUG only)
//----------------------------------------------------------------------------------------

MMBoolean MemoryHeap::FindBlockContaining(const void *start, const void *end,
										  const void* &blockStart, const void* &blockEnd) const
{
	ValidateMagicNumber();

	for ( Segment* segment = fSegments; segment != NULL; segment = segment->fNextSegment )
		if ( segment->FindBlockContaining(start, end, blockStart, blockEnd) )
			return true;

	return false;
}
#endif

#if MM_DEBUG
//----------------------------------------------------------------------------------------
// MemoryHeap::Check (MM_DEBUG only)
//----------------------------------------------------------------------------------------

void MemoryHeap::Check(HeapWalkProc proc, void* refCon) const
{
	// ----- validate each segment
	
	for ( Segment* segment = fSegments; segment != NULL; segment = segment->fNextSegment )
		if( !segment->CheckSegment(proc, refCon, 0) )
			return;

	// ----- check the free tree
	
	fFreeTree.CheckTree();
}
#endif

#if MM_DEBUG
//----------------------------------------------------------------------------------------
// MemoryHeap::Print
//----------------------------------------------------------------------------------------

void MemoryHeap::Print(char* /* msg */) const
{
	MM_PRINT("********** MemoryHeap **********\n");
	fFreeTree.PrintTree();
	MM_PRINT("\n");
}
#endif

//----------------------------------------------------------------------------------------
// Internal Implementation
//----------------------------------------------------------------------------------------

//----------------------------------------------------------------------------------------
// MemoryHeap::AllocateRawMemory
//----------------------------------------------------------------------------------------

void *MemoryHeap::AllocateRawMemory(MMSize size)
{
	return PlatformAllocateBlock(size, fMemSource);
}

//----------------------------------------------------------------------------------------
// MemoryHeap::FreeRawMemory
//----------------------------------------------------------------------------------------

void MemoryHeap::FreeRawMemory(void* ptr)
{
	PlatformFreeBlock(ptr);
}

#if MM_DEBUG
//----------------------------------------------------------------------------------------
// MemoryHeap::ValidBlock
//----------------------------------------------------------------------------------------

const MemoryHeap::Block* MemoryHeap::ValidBlock(const void* ptr)
{
	if ( ptr == NULL )
		return NULL;
#if BLOCKS_ON_4BYTE
	if ( (long)ptr & 0x00000003 )
		return NULL;					// Not on a 4-byte boundary
#endif
		
	const Block* blk = Block::GetBlock(ptr);

	MMSize blkSize = blk->GetSize();
	if (blkSize >= kMinBlockSize && blkSize <= kMaxBlockSize)
	{
		if (blk->GetBusy())
		{
			unsigned int magicNumber = blk->GetMagicNumber();
			if (magicNumber == Block::kBlockMagicNumber)
				return blk;
		}
	}

	return NULL;
}
#endif

#if MM_DEBUG
//----------------------------------------------------------------------------------------
// MemoryHeap::ValidateAndReport (MM_DEBUG only)
//----------------------------------------------------------------------------------------

void MemoryHeap::ValidateAndReport(const void *ptr) const
{
	MM_ASSERT(IsValidBlock(ptr));
}
#endif

#if MM_DEBUG
//----------------------------------------------------------------------------------------
// MemoryHeap::ValidateMagicNumber  (MM_DEBUG only)
//----------------------------------------------------------------------------------------

MMBoolean MemoryHeap::ValidateMagicNumber() const
{
	if (fMagicNumber != kHeapMagicNumber)
	{
		MM_WARN("Invalid magic number for heap %d -- is this a valid heap?",this);
		return false;
	}
	else
		return true;
}
#endif

//----------------------------------------------------------------------------------------
// Old BestFitHeap Functions
//----------------------------------------------------------------------------------------

//----------------------------------------------------------------------------------------
// MemoryHeap::ExpandHeap
//----------------------------------------------------------------------------------------

void MemoryHeap::ExpandHeap(unsigned long sizeInitial, unsigned long sizeIncrement)
{
	if (sizeInitial > fSizeInitial)
		fSizeInitial = sizeInitial;
	if (sizeIncrement > fSizeIncrement)
		fSizeIncrement = sizeIncrement;
	
	if (sizeInitial > HeapSize())
		GrowHeap(sizeInitial);
	else
		GrowHeap(sizeIncrement);
}

//----------------------------------------------------------------------------------------
// MemoryHeap::DoAllocate
//----------------------------------------------------------------------------------------

void* MemoryHeap::DoAllocate(MMSize size, MMSize& allocatedSize)
{
	MMSize blkSize = size + kBusyOverhead;

	if (blkSize < kMinBlockSize)
		blkSize = kMinBlockSize;

#if BLOCKS_ON_4BYTE
	// Make sure blkSize is a multiple of 4 (to keep all blocks on 4byte boundaries)
	// (Added this fix on 7/28/94 on Mike's advice. --jpa)
	blkSize = (blkSize+3) & ~0x03L;
#else
	// Make sure blkSize is even
	if (blkSize & 0x01)
		blkSize++;
#endif

#if MM_DEBUG
	MM_ASSERT(blkSize <= kMaxBlockSize);
#endif

	FreeBlock* freeBlock = NULL;
	
	// A "Huge" block is always allocated its own segment, so the memory can be freed
	// to the platform memory manager as soon as the huge block is deleted:
	
	if( size >= fHugeBlockSize )
	{
		freeBlock = CreateNewSegment(blkSize + Segment::kSegmentPrefixSize + sizeof(Block) );
		if( freeBlock )
			MM_ASSERT(freeBlock->GetSize() == blkSize);
	}
	else
	{
		freeBlock = SearchFreeBlocks(blkSize);		// Not huge, so search free blocks
		if (freeBlock == NULL && fSizeIncrement > 0)
		{
			GrowHeap(fSizeIncrement);			// Make an attempt to expand the heap
			freeBlock = SearchFreeBlocks(blkSize);
		}
	}

	allocatedSize = 0;
	void* newPtr = NULL;

	if (freeBlock != NULL)
	{
		// We found a block, so mark it busy and remove it from the free list.

		Block* blk = RemoveFromFreeBlocks(freeBlock);
		blk->SetBusy(true);
		blk->SetHeap(this);
		blk->SetIsObject(false);

		MMSize leftOver = blk->GetSize() - blkSize;
		if (leftOver >= kMinBlockSize)
		{
			// The block is big enough to split, so here we do the split.

			FreeBlock* newBlk = new(reinterpret_cast<void*>(reinterpret_cast<MMBytePtr>(blk) + blkSize)) FreeBlock(true, leftOver);
			AddToFreeBlocks(newBlk);
			blk->SetSize(blkSize);
		}
		else
		{
			// We're not doing a split, so we need to find the next block
			// and let it know it's predecessor is busy. 

			BlockHeader* nextBlk = blk->GetNextBlock();
			nextBlk->SetPrevBusy(true);
		}

		newPtr = blk->GetContents();
		allocatedSize = blk->GetAllocatedSize();
	}

	return newPtr;
}

//----------------------------------------------------------------------------------------
// MemoryHeap::DoFree
//----------------------------------------------------------------------------------------

void MemoryHeap::DoFree(void* ptr)
{
	FreeBlock* blk = reinterpret_cast<FreeBlock*>(Block::GetBlock(ptr));
#if MM_DEBUG
	MM_ASSERT(blk->GetBusy());
#endif
	
	blk->SetBusy(false);
	blk->StuffAddressAtEnd();

	BlockHeader* nextBlk = blk->GetNextBlock();
	nextBlk->SetPrevBusy(false);
	if (Coalesce(nextBlk))
		RemoveFromFreeBlocks(reinterpret_cast<FreeBlock*>(nextBlk));

	FreeBlock* prevBlk = Coalesce(blk);
	if (prevBlk)
	{
		RemoveFromFreeBlocks(prevBlk);
		//AddToFreeBlocks(prevBlk);// Nope, now happens down below unless seg is freed --jpa
		blk = prevBlk;
	}
	
	if (blk->GetIsFirst())
	{
		// If the first block of the segment is free, look just before it for the seg hdr:
		Segment* segment = reinterpret_cast<Segment*>( reinterpret_cast<MMBytePtr>(blk) - Segment::kSegmentPrefixSize );
#if MM_DEBUG
		MM_ASSERT(segment->fSegmentSpace == blk);
		MM_ASSERT(blk->GetSize() + sizeof(Block) <= segment->fSegmentSize);
#endif
		if( blk->GetSize() + sizeof(Block) == segment->fSegmentSize )
		{
			DeleteSegment(segment);		// Entire seg is free, so delete it
			return;
		}
	}
	
	// If the segment remains, add the free block to the tree:
	AddToFreeBlocks(blk);
}

//----------------------------------------------------------------------------------------
// MemoryHeap::AddToFreeBlocks
//----------------------------------------------------------------------------------------

void MemoryHeap::AddToFreeBlocks(MemoryHeap::BlockHeader* blk)
{
	fFreeTree.AddBlock(reinterpret_cast<FreeBlock*>(blk));
}

//----------------------------------------------------------------------------------------
// MemoryHeap::Coalesce: Coalesce blk with the previous block if both are free.
//----------------------------------------------------------------------------------------

MemoryHeap::FreeBlock* MemoryHeap::Coalesce(MemoryHeap::BlockHeader* blk)
{
	FreeBlock* prevBlk = NULL;

	if (!blk->GetBusy() && !blk->GetPreviousBusy())
	{
		FreeBlock* freeBlock = reinterpret_cast<FreeBlock*>(blk);
		prevBlk = freeBlock->GetPreviousBlock();
		prevBlk->Append(freeBlock);
	}

	return prevBlk;
}

//----------------------------------------------------------------------------------------
// MemoryHeap::CreateNewSegment
//----------------------------------------------------------------------------------------

MemoryHeap::FreeBlock* MemoryHeap::CreateNewSegment(unsigned long size)
{
	FreeBlock* newBlk = NULL;

#if MM_DEBUG
	MM_ASSERT(size > 0);
#endif
#ifdef BUILD_WIN16
	MM_ASSERT(size < 64L * 1024L);
#endif

#if BLOCKS_ON_4BYTE
	// Make sure size is a multiple of 4 (to keep all blocks on 4byte boundaries)
	// (Added this fix on 7/28/94 on Mike's advice. --jpa)
	size = (size+3) & ~0x03L;
	// For this to work, kSegmentPrefixSize and kSegmentSuffixSize must also be
	// multiples of 4.
#else
	// Make sure segment size is even
	if (size & 0x01)
		size++;
#endif

	Segment* segment = reinterpret_cast<Segment*>(AllocateRawMemory((MMSize) size));
	if (segment != NULL)
	{
		// Create one free block out of this entire segment.
		newBlk = segment->InitSegment(size, fSegments, this);

		// Add the segment to the list of segments in this heap.
		fSegments = segment;
	
		// Aadd it to the free block list.
		AddToFreeBlocks(newBlk);
	}

	return newBlk;
}

//----------------------------------------------------------------------------------------
// MemoryHeap::DeleteSegment
//----------------------------------------------------------------------------------------

void MemoryHeap::DeleteSegment( MemoryHeap::Segment* seg )
{
	// The segment MUST be empty, and its single free block
	// must already have been removed from the free block tree.  --jpa
	
	Segment* previous = NULL;
	Segment* segment = fSegments;
	while (segment != NULL)
	{
		if (segment == seg)
		{
			if (previous)
				previous->fNextSegment = seg->fNextSegment;
			else
				fSegments = seg->fNextSegment;

			FreeRawMemory(seg);
			return;
		}
		else
		{
			previous = segment;
			segment = segment->fNextSegment;
		}
	}

	MM_WARN("Segment not found in list!");
}

//----------------------------------------------------------------------------------------
// MemoryHeap::DeleteSegments
//----------------------------------------------------------------------------------------

void MemoryHeap::DeleteSegments()
{
	while (fSegments != NULL)
	{
		Segment* segment = fSegments;
		fSegments = segment->fNextSegment;
		FreeRawMemory(segment);
	}
}

//----------------------------------------------------------------------------------------
// MemoryHeap::GrowHeap
//----------------------------------------------------------------------------------------

void MemoryHeap::GrowHeap(unsigned long sizeIncrement)
{
#ifdef BUILD_WIN16
	// To avoid crossing 64K boundaries on pointer arithmetic, the size of each segment
	// must be limited to 64K. So a single grow request may result in more than one
	// segment being allocated.
	
	const unsigned long kSegmentSizeLimit = 1024L * 62L;     // Allow for 2K overhead
	
	while (sizeIncrement > 0)
	{
		unsigned long segmentSize = sizeIncrement;
		if (segmentSize > kSegmentSizeLimit)
			segmentSize = kSegmentSizeLimit;
		CreateNewSegment(segmentSize);
		sizeIncrement -= segmentSize;
	}
#else
	// It usually is not okay for GrowHeap to be called with an increment of 0,
	// but it may be in some strange cases. For example, a client may want every
	// allocation to be in its own segment, so they initialize the heap with 
	// fSizeInitial = fSizeIncrement = 0. Actually, the more likely case is the
	// MacApp 'mem!' resources got left out of the build, but that's for InitUMemory
	// to worry about.  All GrowHeap should do is check before calling 
	// CreateNewSegment which can crash if given a new segment size of 0. 
	if (sizeIncrement)
		CreateNewSegment(sizeIncrement);
#endif
}

#if MM_DEBUG
//----------------------------------------------------------------------------------------
// MemoryHeap::CompilerCheck
//----------------------------------------------------------------------------------------

void MemoryHeap::CompilerCheck()
{
	char buffer[sizeof(Block) + sizeof(void*)];
	Block &block = *(reinterpret_cast<Block*>(buffer));
		
	// Check to make sure the bit field setters and getters work.
	
	block.SetBlockType(3);
	block.SetBusy(true);
	block.SetPrevBusy(false);
#ifndef BUILD_WIN16
	block.SetSize(100201);
#endif
	block.SetMagicNumber(3);

	MM_ASSERT(block.GetBlockType() == 3);
	MM_ASSERT(block.GetBusy());
	MM_ASSERT(!block.GetPreviousBusy());
#ifndef BUILD_WIN16
	MM_ASSERT(block.GetSize() == 100201);
#endif
	MM_ASSERT(block.GetMagicNumber() == 3);
	
	block.SetBlockType(2);
	block.SetBusy(false);
	block.SetPrevBusy(true);
	block.SetSize(150);
	block.SetMagicNumber(2);

	MM_ASSERT(block.GetBlockType() == 2);
	MM_ASSERT(!block.GetBusy());
	MM_ASSERT(block.GetPreviousBusy());
	MM_ASSERT(block.GetSize() == 150);
	MM_ASSERT(block.GetMagicNumber() == 2);
}
#endif


//----------------------------------------------------------------------------------------
// End of MemoryHe.cpp
