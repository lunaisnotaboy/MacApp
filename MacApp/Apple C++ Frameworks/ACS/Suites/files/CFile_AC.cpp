//----------------------------------------------------------------------------------------
// CFile_AC.cpp
// Copyright © 1988-2001 by Apple Computer, Inc. All rights reserved.
//----------------------------------------------------------------------------------------

/*
	Change History
		05/07/01	Comment out pragma messages for Carbon. 
		03/19/01	Use template version of BlockZero_AC
		03/19/01	Use BlockZero_AC, instead of BlockSet_AC(,,0)
		01/24/01	[W] Use c_str’s in ExchangeFiles, MoveAndRename and RenameFile.
		01/11/00	Use CString_AC instead of CStr255_AC.  GetPathName, GetName and
					GetVolumeName now
					returns strings rather than setting one.
		01/02/01	Update copyright.
		11/10/00	Cosmetic.
		11/10/00	In CFile_AC::MoveAndRename (non-Windows), check to see if the temp file
					and the "save as" file are aleady in the same directory (could happen
					if the temporary folder isn't created).  If they are already in the same
					folder, don't do the PBCatMoveSync.
		11/07/00	Fix compilation errors in CFile_AC::GetNavFileOrFolder, now that
					qNavigation has been turned on  (in CoreSwitch_AC.h).
					paramBlock.fileInfo >> paramBlock.hFileInfo
					ioDrFndrInfo.frFlags >> ioDrFndrInfo.frXFlags
					folderInfo >> fileAndFolder.folderInfo
					There was were struct declarations infront of some assignments
					GetPhysicalSize requires longs, while NavFileOrFolderInfo requires
					its files sizes to be UInt32; this required a cast of a long &.
		11/01/00	[PB] Include MacErrors instead of Errors. 
		10/23/00	[C] Added GetNavFileOrFolderInfo.
		10/20/00	[C] Do not implement SpecifyWithStandardFileReply and SpecifyWithSFReply.
		09/21/00	[W] GetFinderInfo always returns error.
		09/07/00	Added embedded documentation.
		12/10/99	2246618: CFile_AC::OpenDataFork: 
					According to Tech note 1089, PBHOpenDFSync should be used instead of 
					PBHOpenSync.  This fixes crashes opening files with periods (.Bout)
		07/26/99	Added CreateAndOpen.  Call CloseFile in DeleteCFile.
		03/24/99	Update copyright notice.
		03/19/99	Rename CreateFile to CreateCFile, DeleteFile to DeleteCFile,
					UpdateResource to UpdateResourceFile, since they conflict with a Windows define.
		10/26/98	Constructed some temporary CChar255_AC's.
		10/06/98	Clean up includes. 
*/

#ifndef __CFile_AC__
#include "CFile_AC.h"
#endif

// ACS

#ifndef __Configuration_AC__
#include "Configuration_AC.h"
#endif

#ifndef __CException_AC__
#include "CException_AC.h"
#endif

// for now, Windoze doesn't like this file
#if !qMSWindows
	#ifndef __CProcess_AC__
	#include "CProcess_AC.h"
	#endif
#endif

#ifndef __CReporter_AC__
#include "CReporter_AC.h"
#endif

#ifndef __MemoryUtils_AC__
#include "MemoryUtils_AC.h"
#endif

#ifndef __ResFileUtils_AC__
#include "ResFileUtils_AC.h"
#endif

// Toolbox

#ifndef __AEREGISTRY__
#include <AERegistry.h>
#endif

#ifndef __DEVICES__
#include <Devices.h>
#endif

#ifndef __FINDER__
#include <Finder.h>
#endif

#ifndef __MACERRORS__
#include <MacErrors.h>
#endif

#ifndef __RESOURCES__
#include <Resources.h>
#endif

#ifndef __SCRIPT__
#include <Script.h>
#endif

// ANSI

#if qMSWindows
#include <stdio.h>
#endif

//========================================================================================
// CLASS CFile_AC
//========================================================================================

#undef Inherited

//----------------------------------------------------------------------------------------
// CFile_AC Constructor
//----------------------------------------------------------------------------------------

CFile_AC::CFile_AC(OSType itsFileType,
						 OSType itsCreator,
						 bool usesDataFork,
						 ResourceUsage usesRsrcFork,
						 bool keepsDataOpen,
						 bool keepsRsrcOpen)
	:	fFileType(itsFileType),
		fCreator(itsCreator),
		fModDate(0),
		fDataRefNum(kNoFileRefNum_AC),
		fRsrcRefNum(kNoFileRefNum_AC),
		fScriptTag(smSystemScript),
		fUsesRsrcFork(usesRsrcFork),
		fDataPermission(fsRdPerm),
		fRsrcPermission(fsRdPerm),
		fStationery(false),
		fUsesDataFork(usesDataFork),
		fKeepDataOpen(keepsDataOpen),
		fKeepRsrcOpen(keepsRsrcOpen)
{
#if qDebugMsg
	if (keepsDataOpen &&!usesDataFork)
	{
		ProgramReport_AC("CFile_AC::CFile_AC:  keepsDataOpen && !usesDataFork;\n");
		ProgramReport_AC("CFile_AC::CFile_AC:  usesDataFork = true;\n");
		usesDataFork = true;
	}
	if (keepsRsrcOpen && (usesRsrcFork == noResourceFork))
	{
		ProgramReport_AC("CFile_AC::CFile_AC:  keepsRsrcOpen && (usesRsrcFork == noResourceFork);\n");
		ProgramReport_AC("CFile_AC::CFile_AC:  usesRsrcFork = preferResourceFork;\n");
		usesRsrcFork = preferResourceFork;
	}
#endif
}

//----------------------------------------------------------------------------------------
// CFile_AC Destructor
//----------------------------------------------------------------------------------------

CFile_AC::~CFile_AC()
{
	CloseFile();
}

//----------------------------------------------------------------------------------------
// CFile_AC copy constructor 
//----------------------------------------------------------------------------------------

CFile_AC::CFile_AC(const CFile_AC& inFile)
	:	fFileSpec(inFile.fFileSpec),
		fFileType(inFile.fFileType),
		fCreator(inFile.fCreator),
		fModDate(inFile.fModDate),
		fDataRefNum(inFile.fDataRefNum),
		fRsrcRefNum(inFile.fRsrcRefNum),
		fScriptTag(inFile.fScriptTag),
		fUsesRsrcFork(inFile.fUsesRsrcFork),
		fDataPermission(inFile.fDataPermission),
		fRsrcPermission(inFile.fRsrcPermission),
		fStationery(inFile.fStationery),
		fUsesDataFork(inFile.fUsesDataFork),
		fKeepDataOpen(inFile.fKeepDataOpen),
		fKeepRsrcOpen(inFile.fKeepRsrcOpen)
{
	if (inFile.fAlias)
	{
		AliasHandle newAliasHandle = NULL;
		::ThrowIfError_AC(GetAlias(newAliasHandle));
		fAlias = newAliasHandle;
	}
}

//----------------------------------------------------------------------------------------
// CFile_AC::Specify: 
//----------------------------------------------------------------------------------------

void CFile_AC::Specify(const CFSSpec_AC& theFile)
{
#if qDebugMsg
	// Warn if the file is open.
	if (IsDataForkOpen())
		ProgramReport_AC("CFile_AC::Specify: Called with data fork of file open.\n");
	if (IsRsrcForkOpen())
		ProgramReport_AC("CFile_AC::Specify: Called with resource fork of file open.\n");
#endif

	// If we are re-specifying an open file, close the file 
	CloseFile();
	fFileSpec = theFile;

	fAlias.reset();

	FInfo info;
	OSErr anErr = GetFinderInfo(info);
	if (anErr == noErr)
	{	AliasHandle newAliasHandle = NULL;
		::ThrowIfError_AC(NewAliasMinimal(&theFile, &newAliasHandle));
		fAlias = newAliasHandle;
	}
	else if (anErr != fnfErr && anErr != nsvErr)
		::ThrowIfError_AC(anErr);
}

#if !qCarbon

//----------------------------------------------------------------------------------------
// CFile_AC::SpecifyWithStandardFileReply: 
//----------------------------------------------------------------------------------------

void CFile_AC::SpecifyWithStandardFileReply(const StandardFileReply& itsReply)
{
	Specify(itsReply.sfFile);
	
	fFileType = itsReply.sfType;			// only valid for StandardGetFile & CustomGetFile
	fScriptTag = itsReply.sfScript;
	if (itsReply.sfFlags & kIsStationery)	// only valid for StandardGetFile & CustomGetFile
		fStationery = true;
}

//----------------------------------------------------------------------------------------
// CFile_AC::SpecifyWithSFReply: 
//----------------------------------------------------------------------------------------

OSErr CFile_AC::SpecifyWithSFReply(const SFReply& itsReply)
{
	OSErr theErr = SpecifyWithTrio(itsReply.vRefNum, 0, CString_AC(itsReply.fName));
	
	fFileType = itsReply.fType;

	return theErr;
}

#endif

//----------------------------------------------------------------------------------------
// CFile_AC::SpecifyWithAlias: 
//----------------------------------------------------------------------------------------

OSErr CFile_AC::SpecifyWithAlias(AliasHandle alias)
{
	CFSSpec_AC theFileSpec;
	Boolean dontCare;

	OSErr theErr = ResolveAlias(NULL, alias, &theFileSpec, &dontCare);
	if (theErr == noErr)
	{
		FInfo finderInfo;
		FXInfo xFinderInfo;
		bool isDirectory;
		
		fFileType = kGenericType_AC;		// Since we don't know, set to original values
		fCreator = kGenericCreator_AC;
		fStationery = false;

		Specify(theFileSpec);
		if (GetFinderInfo(finderInfo, xFinderInfo, isDirectory) == noErr)
		{
			if (isDirectory)
			{
				fFileType = kFolderType_AC;
				fCreator = kFolderCreator_AC;
			}
			else
			{
				fFileType = finderInfo.fdType;
				fCreator = finderInfo.fdCreator;
				fStationery = (finderInfo.fdFlags & kIsStationery) != 0;
			}
		}
	}

	return theErr;
}

//----------------------------------------------------------------------------------------
// CFile_AC::SpecifyWithFile: 
//----------------------------------------------------------------------------------------

void CFile_AC::SpecifyWithFile(CFile_AC* aFile)
{
	aFile->UpdateFileSpec();		// Insure its specs are up-to-date.
	CFSSpec_AC theFile = aFile->fFileSpec;
	
	Specify(theFile);
	
	fFileType = aFile->fFileType;
	fCreator = aFile->fCreator;
	fScriptTag = aFile->fScriptTag;
	fStationery = aFile->fStationery;
}

//----------------------------------------------------------------------------------------
// CFile_AC::SpecifyWithTrio: 
//----------------------------------------------------------------------------------------

OSErr CFile_AC::SpecifyWithTrio(short volRefNum,
								   long dirID,
								   const CString_AC& fileName)
{
	CFSSpec_AC theFileSpec;
	OSErr theErr = noErr;

	if ((theErr = FSMakeFSSpec(volRefNum, dirID, CStr255_AC(fileName), &theFileSpec)) == fnfErr)
		theErr = noErr;						// The file may not yet exist

	if (theErr == noErr)
		Specify(theFileSpec);

	return theErr;
}

//----------------------------------------------------------------------------------------
// CFile_AC::CloseFile: 
//----------------------------------------------------------------------------------------

OSErr CFile_AC::CloseFile()
// CloseFile closes the data and resource forks of a file, whether or not 
// you requested them to be left open. The method also returns a result code. If an error
// occurred while closing the data fork, the result code specifies the error number; otherwise
// it specifies the status after closing the resource fork.
//
// Call?		As needed.
// Override?	Seldom.
{
	OSErr dataErr = noErr;
	OSErr rsrcErr = noErr;

	if (fUsesDataFork)
		dataErr = CloseDataFork();
	if (fUsesRsrcFork != noResourceFork)
	{
		rsrcErr = CloseRsrcFork();
		if ((fUsesRsrcFork == preferResourceFork) && (rsrcErr == resFNotFound))
			rsrcErr = noErr;
	}

	return dataErr != noErr ? dataErr : rsrcErr;
}

//----------------------------------------------------------------------------------------
// CFile_AC::CloseFileIfNotKeptOpen: 
//----------------------------------------------------------------------------------------

OSErr CFile_AC::CloseFileIfNotKeptOpen()
// CloseFileIfNotKeptOpen closes the data and resource forks of a file if 
// they are not required to be kept open. The method also returns a result code. If an 
// error occurred while closing the data fork, the result code specifies the error number;
// otherwise it specifies the status after closing the resource fork.
//
// Call?		As needed. Call your file’s CloseFile method instead.
// Override?	Seldom.
{
	OSErr dataErr = noErr;
	OSErr rsrcErr = noErr;

	if (fUsesDataFork && !fKeepDataOpen)
		dataErr = CloseDataFork();
	if ((fUsesRsrcFork != noResourceFork) && !fKeepRsrcOpen)
	{
		rsrcErr = CloseRsrcFork();
		if ((fUsesRsrcFork == preferResourceFork) && (rsrcErr == resFNotFound))
			rsrcErr = noErr;
	}

	return dataErr != noErr ? dataErr : rsrcErr;
}

//----------------------------------------------------------------------------------------
// CFile_AC::CloseDataFork: 
//----------------------------------------------------------------------------------------

OSErr CFile_AC::CloseDataFork()
// CloseDataFork closes the data fork of a file.
//
// Call?		Seldom.
// Override?	Seldom.
{
	OSErr theErr = noErr;

	if (fDataRefNum != kNoFileRefNum_AC)
	{
		theErr = FSClose(fDataRefNum);
		fDataRefNum = kNoFileRefNum_AC;
	}

	return theErr;
}

//----------------------------------------------------------------------------------------
// CFile_AC::CloseRsrcFork: 
//----------------------------------------------------------------------------------------

OSErr CFile_AC::CloseRsrcFork()
// CloseRsrcFork closes the resource fork of a file and returns a result code.
//
// Call?		Seldom.
// Override?	Seldom.
{
	OSErr theErr = noErr;

	if (fRsrcRefNum != kNoFileRefNum_AC)
	{
		CloseResFile(fRsrcRefNum);
		theErr = ResError();
		fRsrcRefNum = kNoFileRefNum_AC;
	}

	return theErr;
}

//----------------------------------------------------------------------------------------
// CFile_AC::CreateCFile: 
//----------------------------------------------------------------------------------------

OSErr CFile_AC::CreateCFile()
{
	OSErr dataErr = noErr;
	OSErr rsrcErr = noErr;

	if (fUsesDataFork)
		dataErr = CreateDataFork();

	if (fUsesRsrcFork != noResourceFork)
		rsrcErr = CreateRsrcFork();

	return dataErr != noErr ? dataErr : rsrcErr;
}

//----------------------------------------------------------------------------------------
// CFile_AC::CreateDataFork: 
//----------------------------------------------------------------------------------------

OSErr CFile_AC::CreateDataFork()
// CreateDataFork creates the data fork of the file and returns a result code. 
// The method uses the appropriate File Manager routines for System 6 and System 7 configurations.
//
// Call?		Seldom.
// Override?	Seldom.
{
	return FSpCreate(&fFileSpec, fCreator, fFileType, fScriptTag);
}

//----------------------------------------------------------------------------------------
// CFile_AC::CreateRsrcFork: 
//----------------------------------------------------------------------------------------

OSErr CFile_AC::CreateRsrcFork()
// CreateRsrcFork creates the resource fork of the file and returns a result 
// code. The method uses the appropriate File Manager routines for System 6 and System 7 configurations.
//
// Call?		Seldom.
// Override?	Seldom.
{
	FSpCreateResFile(&fFileSpec, fCreator, fFileType, fScriptTag);

	return ResError();
}

//----------------------------------------------------------------------------------------
// CFile_AC::CreateAndOpen: 
//----------------------------------------------------------------------------------------

void CFile_AC::CreateAndOpen()
{
	ThrowIfOSErr_AC(CreateCFile());
	SetPermissions(fsRdWrPerm, fsRdWrPerm);	// Assume that we intend to write to it
											// since it's a new file.
	ThrowIfOSErr_AC(OpenFile());
}

//----------------------------------------------------------------------------------------
// CFile_AC::DeleteCFile: 
//----------------------------------------------------------------------------------------

OSErr CFile_AC::DeleteCFile()
{
	CloseFile();		// This should let DeleteFile() succeed if the file was open

	fModDate = 0;
	fAlias.reset();
	
	return FSpDelete(&fFileSpec);
}

//----------------------------------------------------------------------------------------
// CFile_AC::OpenFile: 
//----------------------------------------------------------------------------------------

OSErr CFile_AC::OpenFile()
{
	OSErr dataErr = noErr;
	OSErr rsrcErr = noErr;

	if (fUsesDataFork)
		dataErr = OpenDataFork(fDataPermission);

	if (fUsesRsrcFork != noResourceFork)
	{
		rsrcErr = OpenRsrcFork(fRsrcPermission);
		if ((fUsesRsrcFork == preferResourceFork) && (rsrcErr != noErr))
			rsrcErr = noErr;
	}

	return dataErr != noErr ? dataErr : rsrcErr;
}

//----------------------------------------------------------------------------------------
// CFile_AC::OpenFileIfKeptOpen: 
//----------------------------------------------------------------------------------------

OSErr CFile_AC::OpenFileIfKeptOpen()
{
	OSErr dataErr = noErr;
	OSErr rsrcErr = noErr;

	if (fUsesDataFork && fKeepDataOpen)
		dataErr = OpenDataFork(fDataPermission);

	if ((fUsesRsrcFork != noResourceFork) && fKeepRsrcOpen)
	{
		rsrcErr = OpenRsrcFork(fRsrcPermission);
		if ((fUsesRsrcFork == preferResourceFork) && (rsrcErr != noErr))
			rsrcErr = noErr;
	}

	return dataErr != noErr ? dataErr : rsrcErr;
}

//----------------------------------------------------------------------------------------
// CFile_AC::OpenDataFork: 
//----------------------------------------------------------------------------------------

OSErr CFile_AC::OpenDataFork(SignedByte permission)
{
	// Here's a short explanation of the permission codes (so you don't
	// have to look them up).  Note that they are NOT the same as
	// the 'permission' parameter. The bits (and decimal value) are:
	//	0 (1):    Request read permission.
	//	1 (2):    Request write permission.
	//	2-3:      Reserved; must be 0.
	//	4 (16):   Deny other readers access to this file.
	//	5 (32):   Deny other writers access to this file.
	//	6-15:     Reserved; must be 0.
	// If you do not use one of the standard permissions (fsRdPerm,
	// fsWrPerm, fsRdWrPerm, fsCurPerm or fsRdWrShPerm) then make sure
	// you've set the permission as ioDenyModes is going to expect.
	OSErr theErr = noErr;

	if (fDataRefNum == kNoFileRefNum_AC)			// Don't open if already open 
	{
		HParamBlockRec pb;

		BlockZero_AC(pb);
		pb.accessParam.ioNamePtr = fFileSpec.name;
		pb.accessParam.ioVRefNum = fFileSpec.vRefNum;
		pb.fileParam.ioDirID = fFileSpec.parID;
		
		switch (permission)
		{
			// read/deny write
			case fsRdPerm:
				pb.accessParam.ioDenyModes = fsRdPerm | 32;
				break;

			// read/write/deny read/deny write			
			case fsWrPerm:
			case fsRdWrPerm:
			case fsCurPerm:
				pb.accessParam.ioDenyModes = fsRdWrPerm | 16 | 32;
				break;
			
			// read/write/deny none
			case fsRdWrShPerm:
				pb.accessParam.ioDenyModes = fsRdWrPerm;
				break;
	
			// read/deny write			
			default:
				pb.accessParam.ioDenyModes = permission;
		}

// PBHOpenDeny is not available for Windows.
#if !qMSWindows
		theErr = ::PBHOpenDenySync(&pb);			// Try the shared volume open. 

		if ((theErr == paramErr) || (theErr == wPrErr))	// Not on a shared volume, try HFS open. 
#endif
		{
			pb.ioParam.ioPermssn = permission & 3;
			// According to Tech note 1089, PBHOpenDFSync should be used instead of 
			// PBHOpenSync.  This fixes crashes opening files with periods (.Bout)
			theErr = ::PBHOpenDFSync(&pb);
		}

		if (theErr == noErr)
			fDataRefNum = pb.ioParam.ioRefNum;
	}

	return theErr;
}

//----------------------------------------------------------------------------------------
// CFile_AC::OpenRsrcFork: 
//----------------------------------------------------------------------------------------

OSErr CFile_AC::OpenRsrcFork(SignedByte permission)
{
	OSErr theErr = noErr;

	if (fRsrcRefNum == kNoFileRefNum_AC)			// Don't open if already open 
	{
		fRsrcRefNum = FSpOpenResFile(&fFileSpec, (permission & 7));
		theErr = ResError();
	}
	if (theErr != noErr)
		fRsrcRefNum = kNoFileRefNum_AC;

	return theErr;
}

//----------------------------------------------------------------------------------------
// CFile_AC::ExchangeFiles: 
//----------------------------------------------------------------------------------------

OSErr CFile_AC::ExchangeFiles(CFile_AC* aFile)
{
	// Exchange this's file for aFile.
#if !qMSWindows
	return FSpExchangeFiles(&fFileSpec, &aFile->fFileSpec);
#else
	// FSpExchangeFiles not supported for Windows.  We have to do the old
	// temp <- b <- c <- temp scheme.
	// NOTE: This will fail for very long path names.
	// NOTE: The assumption is that both files involved are currently closed.

	Assertion_AC(!IsDataForkOpen() && !IsRsrcForkOpen(), "Exchanging a file which is open. (1)");
	Assertion_AC(!aFile->IsDataForkOpen() && !aFile->IsRsrcForkOpen(), "Exchanging a file which is open. (2)");

	// Gather the full paths with names for the three files.
	CString_AC	tempFileName(GetName());
	CString_AC	tempFullPathName(GetPathName());
	CString_AC	origFullPathName(aFile->GetPathName() + aFile->GetName());

	CFSSpec_AC	tempSpec(fFileSpec);
	if (!tempSpec.FindUniqueSpec())
		ThrowError_AC(bdNamErr);

	CString_AC	newTempFileName(tempSpec.GetName());
	CString_AC	newTempFullPathName(tempFullPathName + tempSpec.GetName());

	tempFullPathName += tempFileName;

	// Exchange the files
	ThrowIfOSErr_AC(::rename(newTempFullPathName.c_str(), origFullPathName.c_str()));
	ThrowIfOSErr_AC(::rename(origFullPathName.c_str(), tempFullPathName.c_str()));
	ThrowIfOSErr_AC(::rename(tempFullPathName.c_str(), newTempFullPathName.c_str()));

	// Fix the file specs.
	tempSpec = fFileSpec;
	fFileSpec = aFile->fFileSpec;
	aFile->fFileSpec = tempSpec;

	// And cross your fingers!
	return noErr;
#endif
}

//----------------------------------------------------------------------------------------
// CFile_AC::GetAlias: 
//----------------------------------------------------------------------------------------

OSErr CFile_AC::GetAlias(AliasHandle& alias)
{
	return NewAliasMinimal(&fFileSpec, &alias);
}

//----------------------------------------------------------------------------------------
// CFile_AC::GetCatInfo: 
//----------------------------------------------------------------------------------------

OSErr CFile_AC::GetCatInfo(CInfoPBRec& cInfo) const
{
	cInfo.hFileInfo.ioNamePtr = const_cast_AC(StringPtr, fFileSpec.name);
	cInfo.hFileInfo.ioVRefNum = fFileSpec.vRefNum;
	cInfo.hFileInfo.ioFDirIndex = 0;
	cInfo.hFileInfo.ioDirID = fFileSpec.parID;

	OSErr err = PBGetCatInfoSync(&cInfo);

	return err;
}

//----------------------------------------------------------------------------------------
// CFile_AC::GetCreationDate: 
//----------------------------------------------------------------------------------------

long CFile_AC::GetCreationDate() const
{
	long returnVal = 0;

	CInfoPBRec cInfo;

	BlockZero_AC(cInfo);// zero-out our storage 
	if (GetCatInfo(cInfo) == noErr)
		returnVal = cInfo.hFileInfo.ioFlAttrib & ioDirMask ? cInfo.dirInfo.ioDrCrDat : cInfo.hFileInfo.ioFlCrDat;

	return returnVal;
}

//----------------------------------------------------------------------------------------
// CFile_AC::GetDataLength: 
//----------------------------------------------------------------------------------------

OSErr CFile_AC::GetDataLength(long& length) const
{
	return ::GetEOF(fDataRefNum, &length);
}

//----------------------------------------------------------------------------------------
// CFile_AC::GetDataMark: 
//----------------------------------------------------------------------------------------

OSErr CFile_AC::GetDataMark(long& mark) const
{
	return ::GetFPos(fDataRefNum, &mark);
}

//----------------------------------------------------------------------------------------
// CFile_AC::GetDirID: 
//----------------------------------------------------------------------------------------

long CFile_AC::GetDirID() const
{
	return fFileSpec.parID;
}

//----------------------------------------------------------------------------------------
// CFile_AC::GetFileCreator: 
//----------------------------------------------------------------------------------------

OSErr CFile_AC::GetFileCreator(OSType& creator) const
{
	FInfo finderInfo;
	FXInfo xFinderInfo;
	bool isDirectory;
	
	OSErr theErr = GetFinderInfo(finderInfo, xFinderInfo, isDirectory);
	creator = theErr == noErr ? (creator = isDirectory ? kFolderCreator_AC : finderInfo.fdCreator) : kGenericCreator_AC;
	
	return theErr;
}

//----------------------------------------------------------------------------------------
// CFile_AC::GetFileInfo: 
//----------------------------------------------------------------------------------------

OSErr CFile_AC::GetFileInfo(HParamBlockRec& pb)
{
	pb.fileParam.ioNamePtr = fFileSpec.name;
	pb.fileParam.ioVRefNum = fFileSpec.vRefNum;
	pb.fileParam.ioDirID = fFileSpec.parID;
	pb.fileParam.ioFVersNum = 0;
	pb.fileParam.ioFDirIndex = 0;

#if !qMSWindows
	OSErr err = ::PBHGetFInfoSync(&pb);
#else
	// PBHGetFInfoSync is not supported for Windows so we use PBGetCatInfo
	// instead which pretty much works the same way.  The HFileInfo returned
	// by PBGetCatInfo, though, is longer than the HFileParam record returned
	// by PBHGetFInfo, though the records are identical up to the ioFlMdDat.
	CInfoPBRec		aCInfoPBRec;

	// Move the original pb data into our temporary CInfoPBRec.
	BlockMove_AC(&pb, &aCInfoPBRec, sizeof(HFileParam));

	OSErr err = ::PBGetCatInfoSync(&aCInfoPBRec);

	// Now move the results back into the original pb record.
	BlockMove_AC(&aCInfoPBRec, &pb, sizeof(HFileParam));
#endif
	return err;
}

//----------------------------------------------------------------------------------------
// CFile_AC::GetFileType: 
//----------------------------------------------------------------------------------------

OSErr CFile_AC::GetFileType(OSType& fileType) const
{
	FInfo finderInfo;
	FXInfo xFinderInfo;
	bool isDirectory;
	
	OSErr theErr = GetFinderInfo(finderInfo, xFinderInfo, isDirectory);
	fileType = theErr == noErr ? (fileType = isDirectory ? kFolderType_AC : finderInfo.fdType) : kAllQuestionsType_AC;
	
	return theErr;
}

//----------------------------------------------------------------------------------------
// CFile_AC::GetFinderInfo: 
//----------------------------------------------------------------------------------------

OSErr CFile_AC::GetFinderInfo(FInfo& fndrInfo) const
{
	FXInfo itsFXInfo;
	bool isDirectory;

	return GetFinderInfo(fndrInfo, itsFXInfo, isDirectory);
}

//----------------------------------------------------------------------------------------
// CFile_AC::GetFinderInfo: 
//----------------------------------------------------------------------------------------

OSErr CFile_AC::GetFinderInfo(FInfo& fndrInfo, FXInfo& itsFXInfo, bool& isDirectory) const
{
	return fFileSpec.GetFinderInfo(fndrInfo, itsFXInfo, isDirectory);
}

#if qNavigation
//----------------------------------------------------------------------------------------
// CFile_AC::GetNavFileOrFolderInfo: 
//----------------------------------------------------------------------------------------

OSErr CFile_AC::GetNavFileOrFolderInfo(NavFileOrFolderInfo& theNavFileOrFolderInfo)
// GetNavFileOrFolderInfo returns information about the file in NavFileOrFolderInfo format.
//
// theNavFileOrFolderInfo:	A NavFileOrFolderInfo record that received the file info.
//
// Call?		As needed.
// Override?	Never.
{
	//#pragma message ("CFile_AC::GetNavFileOrFolderInfo: Reexamine this implementation.")
	
	// Do a GetCatInfo and the fill in theNavFileOrFolderInfo. 
	OSErr					anErr = noErr;
	CInfoPBRec				paramBlock;

	paramBlock.hFileInfo.ioACUser = 0;		// Must clear first.
	anErr = GetCatInfo(paramBlock);

	if (anErr == noErr)
	{

		// Determine if this is a file or a folder.
		if (paramBlock.dirInfo.ioFlAttrib & kioFlAttribDirMask)
		{
			// It's a folder.
			theNavFileOrFolderInfo.isFolder = true;

			theNavFileOrFolderInfo.visible			= !(paramBlock.dirInfo.ioDrFndrInfo.frXFlags & kIsInvisible);
			theNavFileOrFolderInfo.creationDate		= paramBlock.dirInfo.ioDrCrDat;
			theNavFileOrFolderInfo.modificationDate	= paramBlock.dirInfo.ioDrMdDat;

			theNavFileOrFolderInfo.fileAndFolder.folderInfo.shareable		= paramBlock.dirInfo.ioFlAttrib & kioFlAttribInSharedMask;
			theNavFileOrFolderInfo.fileAndFolder.folderInfo.sharePoint		= paramBlock.dirInfo.ioFlAttrib & kioFlAttribSharePointMask;
			theNavFileOrFolderInfo.fileAndFolder.folderInfo.mounted			= paramBlock.dirInfo.ioFlAttrib & kioFlAttribMountedMask;
			theNavFileOrFolderInfo.fileAndFolder.folderInfo.readable		= !(paramBlock.dirInfo.ioACUser & kioACUserNoSeeFolderMask);
			theNavFileOrFolderInfo.fileAndFolder.folderInfo.writeable		= !(paramBlock.dirInfo.ioACUser & kioACUserNoMakeChangesMask);
			theNavFileOrFolderInfo.fileAndFolder.folderInfo.numberOfFiles	= paramBlock.dirInfo.ioDrNmFls;
			theNavFileOrFolderInfo.fileAndFolder.folderInfo.finderDInfo		= paramBlock.dirInfo.ioDrUsrWds;
			theNavFileOrFolderInfo.fileAndFolder.folderInfo.finderDXInfo	= paramBlock.dirInfo.ioDrFndrInfo;
			theNavFileOrFolderInfo.fileAndFolder.folderInfo.folderType		= '****';		// ••• package type, For struct version >= 1
			theNavFileOrFolderInfo.fileAndFolder.folderInfo.folderCreator	= '****';		// ••• package creator, For struct version >= 1
		}
		else
		{
			// It's a file.
			theNavFileOrFolderInfo.isFolder = false;

			theNavFileOrFolderInfo.visible			= !(paramBlock.hFileInfo.ioFlFndrInfo.fdFlags & kIsInvisible);
			theNavFileOrFolderInfo.creationDate		= paramBlock.hFileInfo.ioFlCrDat;
			theNavFileOrFolderInfo.modificationDate	= paramBlock.hFileInfo.ioFlMdDat;

            theNavFileOrFolderInfo.fileAndFolder.fileInfo.locked			= paramBlock.hFileInfo.ioFlAttrib & kioFlAttribLockedMask; 
            theNavFileOrFolderInfo.fileAndFolder.fileInfo.resourceOpen		= paramBlock.hFileInfo.ioFlAttrib & kioFlAttribResOpenMask;
            theNavFileOrFolderInfo.fileAndFolder.fileInfo.dataOpen			= paramBlock.hFileInfo.ioFlAttrib & kioFlAttribDataOpenMask;

			// Note: there is a difference between the CInfoPBRec and NavFileOrFolderInfo structures--NavFileOrFolderInfo has sizes
			// that are UInt32, while the older CInfoPBRec has file length sizes that are just longs.
			// The cast should be removed if and when the file structure migrates to UInt32.
			GetPhysicalSize((long &)theNavFileOrFolderInfo.fileAndFolder.fileInfo.dataSize, (long &)theNavFileOrFolderInfo.fileAndFolder.fileInfo.resourceSize);
            theNavFileOrFolderInfo.fileAndFolder.fileInfo.finderInfo		= paramBlock.hFileInfo.ioFlFndrInfo;
            theNavFileOrFolderInfo.fileAndFolder.fileInfo.finderXInfo		= paramBlock.hFileInfo.ioFlXFndrInfo;
		}
	}
	
	return anErr;
}

#endif

//----------------------------------------------------------------------------------------
// CFile_AC::GetModificationDate: 
//----------------------------------------------------------------------------------------

long CFile_AC::GetModificationDate() const
{
	long returnVal = 0;

	CInfoPBRec cInfo;

	BlockZero_AC(cInfo);// zero-out our storage 
	if (GetCatInfo(cInfo) == noErr)
		returnVal = cInfo.hFileInfo.ioFlAttrib & ioDirMask ? cInfo.dirInfo.ioDrMdDat : cInfo.hFileInfo.ioFlMdDat;

	return returnVal;
}

//----------------------------------------------------------------------------------------
// CFile_AC::GetName: 
//----------------------------------------------------------------------------------------

CString_AC CFile_AC::GetName() const
{
	return fFileSpec.GetName();
}

//----------------------------------------------------------------------------------------
// CFile_AC::GetPathName: 
//----------------------------------------------------------------------------------------

CString_AC CFile_AC::GetPathName() const
{
	return fFileSpec.GetPathName();
}

//----------------------------------------------------------------------------------------
// CFile_AC::GetPhysicalSize: 
//----------------------------------------------------------------------------------------

OSErr CFile_AC::GetPhysicalSize(long& dataSize, long& rsrcSize)
{
	HParamBlockRec pb;
	OSErr theErr;

	if ((theErr = GetFileInfo(pb)) == noErr)
	{
		dataSize = pb.fileParam.ioFlPyLen;
		rsrcSize = pb.fileParam.ioFlRPyLen;
	}

	return theErr;
}

//----------------------------------------------------------------------------------------
// CFile_AC::GetPosition: 
//----------------------------------------------------------------------------------------

long CFile_AC::GetPosition() const
{
	// Retrieve the current writing position.
	long	position;
	::ThrowIfError_AC(::GetFPos(fDataRefNum, &position));
	return position;
}

//----------------------------------------------------------------------------------------
// CFile_AC::SetPosition: 
//----------------------------------------------------------------------------------------

void CFile_AC::SetPosition(const long positionOrOffset, const short aMode) const
{
	// Set the current writing position according to aMode.  The possible
	// values for aMode are defined in Files.h but are shown here for
	// your convenience:
	//	fsAtMark	= 0		Ignore positionOrOffset.  Do nothing.
	//	fsFromStart	= 1		Set position relative to beginning of file.  Default.
	//	fsFromLEOF	= 2		Set position relative to logical end-of-file.
	//	fsFromMark	= 3		Set position relative to current position.

	::ThrowIfError_AC(::SetFPos(fDataRefNum, aMode, positionOrOffset));
}

//----------------------------------------------------------------------------------------
// CFile_AC::GetScript: 
//----------------------------------------------------------------------------------------

OSErr CFile_AC::GetScript(ScriptCode& theScript)
{
	OSErr theErr;
	CInfoPBRec cInfo;

	BlockZero_AC(cInfo);// zero-out our storage 
	theErr = GetCatInfo(cInfo);
	if (theErr == noErr)
	{
		theScript = cInfo.hFileInfo.ioFlXFndrInfo.fdScript;
		fScriptTag = theScript;
	}

	return theErr;
}

//----------------------------------------------------------------------------------------
// CFile_AC::SetModificationDate: 
//----------------------------------------------------------------------------------------

OSErr CFile_AC::SetModificationDate(long modificationDate)
{
	// Get the current information and just touch the modification date
	CInfoPBRec cInfo;
	OSErr theErr = noErr;

	BlockZero_AC(cInfo);// zero-out our storage 
	if (GetCatInfo(cInfo) == noErr)
	{
		if (cInfo.hFileInfo.ioFlAttrib & ioDirMask)
			cInfo.dirInfo.ioDrMdDat = modificationDate;
		else
			cInfo.hFileInfo.ioFlMdDat = modificationDate;

		SetCatInfo(cInfo);
		fModDate = modificationDate;
	}

	return theErr;
}
		
//----------------------------------------------------------------------------------------
// CFile_AC::SetCreationDate: 
//----------------------------------------------------------------------------------------

OSErr CFile_AC::SetCreationDate(long creationDate)
{
	// Get the current information and just touch the modification date
	CInfoPBRec cInfo;
	OSErr theErr = noErr;

	BlockZero_AC(cInfo);// zero-out our storage 
	if (GetCatInfo(cInfo) == noErr)
	{
		if (cInfo.hFileInfo.ioFlAttrib & ioDirMask)
			cInfo.dirInfo.ioDrCrDat = creationDate;
		else
			cInfo.hFileInfo.ioFlCrDat = creationDate;

		SetCatInfo(cInfo);
	}

	return theErr;
}

//----------------------------------------------------------------------------------------
// CFile_AC::SetFinderInfo: 
//----------------------------------------------------------------------------------------

OSErr CFile_AC::SetFinderInfo(const FInfo& fndrInfo)
{
	HParamBlockRec pb;
	OSErr theErr = noErr;

	// Get the current information and just touch the finder info
	theErr = GetFileInfo(pb);
	if (theErr == noErr)
	{
		pb.fileParam.ioFlFndrInfo = fndrInfo;
		theErr = SetFileInfo(pb);
	}

	return theErr;
}

//----------------------------------------------------------------------------------------
// CFile_AC::FlushVolume: 
//----------------------------------------------------------------------------------------

OSErr CFile_AC::FlushVolume()
{
	return FlushVol(NULL, fFileSpec.vRefNum);
}

//----------------------------------------------------------------------------------------
// CFile_AC::GetBlockSize: 
//----------------------------------------------------------------------------------------

OSErr CFile_AC::GetBlockSize(unsigned long& blockSize) const
{
	HParamBlockRec pb;
	OSErr theErr;

	BlockZero_AC(pb);// zero-out our storage 
	theErr = GetVolumeInfo(pb);
	if (theErr == noErr)
		blockSize = pb.volumeParam.ioVAlBlkSiz;
	else
		blockSize = 0;

	return theErr;
}

//----------------------------------------------------------------------------------------
// CFile_AC::GetFreeBlocks: 
//----------------------------------------------------------------------------------------

OSErr CFile_AC::GetFreeBlocks(unsigned long& freeBlocks) const
{
	HParamBlockRec pb;
	BlockZero_AC(pb);// zero-out our storage 

	OSErr theErr = GetVolumeInfo(pb);
	freeBlocks = theErr == noErr ? pb.volumeParam.ioVFrBlk : 0;

	return theErr;
}

//----------------------------------------------------------------------------------------
// CFile_AC::GetVolumeInfo: 
//----------------------------------------------------------------------------------------

OSErr CFile_AC::GetVolumeInfo(HParamBlockRec& pb) const
{
	pb.volumeParam.ioCompletion = NULL;
	pb.volumeParam.ioNamePtr = NULL;
	pb.volumeParam.ioVRefNum = fFileSpec.vRefNum;
	pb.volumeParam.ioVolIndex = -1;				// Use the vRefNum since it is all we have 

	return PBHGetVInfoSync(&pb);
}

//----------------------------------------------------------------------------------------
// CFile_AC::GetVolumeName: 
//----------------------------------------------------------------------------------------

CString_AC CFile_AC::GetVolumeName() const
{
	HParamBlockRec	pb;
	StrFileName		theVolumeName;

	BlockZero_AC(pb);
	pb.volumeParam.ioNamePtr = reinterpret_cast<unsigned char*>(&theVolumeName);			// Fill in the name 
	pb.volumeParam.ioVRefNum = fFileSpec.vRefNum;
	pb.volumeParam.ioVolIndex = 0;				// Use the vRefNum since it is all we have 

	ThrowIfOSErr_AC(PBHGetVInfoSync(&pb));
	
	return CString_AC(theVolumeName);
}

//----------------------------------------------------------------------------------------
// CFile_AC::GetVolRefNum: 
//----------------------------------------------------------------------------------------

short CFile_AC::GetVolRefNum() const
{
	return fFileSpec.vRefNum;
}

//----------------------------------------------------------------------------------------
// CFile_AC::IsDataForkOpen: 
//----------------------------------------------------------------------------------------

bool CFile_AC::IsDataForkOpen() const
{
	return fDataRefNum != kNoFileRefNum_AC;
}

//----------------------------------------------------------------------------------------
// CFile_AC::IsRsrcForkOpen: 
//----------------------------------------------------------------------------------------

bool CFile_AC::IsRsrcForkOpen() const
{
	return fRsrcRefNum != kNoFileRefNum_AC;
}

//----------------------------------------------------------------------------------------
// CFile_AC::IsSameFile: 
//----------------------------------------------------------------------------------------

bool CFile_AC::IsSameFile(const CFile_AC* aFile)
{
	ThrowIfNonObject_AC(aFile);

	// See if aFile represents the same file as this.
	bool returnVal = false;

	if (aFile == this)
	{
		returnVal = true;		// Short circuit test for identity.
	}
	else
	{
		UpdateFileSpec();		// Make sure we're up-to-date.
	
		if ((fFileSpec.vRefNum == aFile->GetVolRefNum()) && (fFileSpec.parID == aFile->GetDirID()))
			returnVal = EqualString(CStr255_AC(fFileSpec.GetName()), CStr255_AC(aFile->GetName()), false, true);
	}
	return returnVal;
}

//----------------------------------------------------------------------------------------
// CFile_AC::IsStationery: 
//----------------------------------------------------------------------------------------

bool CFile_AC::IsStationery() const
{
	return fStationery;
}

//----------------------------------------------------------------------------------------
// CFile_AC::IsModified: 
//----------------------------------------------------------------------------------------

bool CFile_AC::IsModified() const
{
	return GetModificationDate() != fModDate;
}

//----------------------------------------------------------------------------------------
// CFile_AC::IsVolumeLocked: 
//----------------------------------------------------------------------------------------

OSErr CFile_AC::IsVolumeLocked(bool& locked) const
{
	HParamBlockRec pb;
	OSErr theErr;

	if ((theErr = GetVolumeInfo(pb)) == noErr)
		locked = (pb.volumeParam.ioVAtrb & 0x8080) != 0;

	return theErr;
}

//----------------------------------------------------------------------------------------
// CFile_AC::HasDataFork: 
//----------------------------------------------------------------------------------------

bool CFile_AC::HasDataFork() const
{
	return fUsesDataFork;
}

//----------------------------------------------------------------------------------------
// CFile_AC::HasRsrcFork: 
//----------------------------------------------------------------------------------------

bool CFile_AC::HasRsrcFork() const
{
	return fUsesRsrcFork != noResourceFork;
}

//----------------------------------------------------------------------------------------
// CFile_AC::HasValidFileSpec: 
//----------------------------------------------------------------------------------------

bool CFile_AC::HasValidFileSpec() const
{
	return fFileSpec.vRefNum || fFileSpec.parID;
}

//----------------------------------------------------------------------------------------
// CFile_AC::Modified: 
//----------------------------------------------------------------------------------------

void CFile_AC::Modified()
{
	fModDate = GetModificationDate();
	
#if !qMSWindows
	// I took this out for Windows, I think because it was throwing an error
	FInfo info;
	::ThrowIfError_AC(GetFinderInfo(info));
#endif

	fAlias.reset();

	AliasHandle newAliasHandle = NULL;
	::ThrowIfError_AC(GetAlias(newAliasHandle));
	fAlias = newAliasHandle;
}

//----------------------------------------------------------------------------------------
// CFile_AC::MoveAndRename: 
//----------------------------------------------------------------------------------------

OSErr CFile_AC::MoveAndRename(const CFSSpec_AC& dest)
{
	OSErr returnVal = noErr;

	CInfoPBRec		cInfoPB;
	StrFileName		destName;

	// Get key information about the destination directory.
	cInfoPB.dirInfo.ioVRefNum = dest.vRefNum;
	cInfoPB.dirInfo.ioDrDirID = dest.parID;
	cInfoPB.dirInfo.ioNamePtr = reinterpret_cast<unsigned char*>(&destName);		// Will be filled in 
	cInfoPB.dirInfo.ioFDirIndex = -1;
	if ((returnVal = PBGetCatInfoSync(&cInfoPB)) == noErr)
	{
#if !qMSWindows
		// If the temporary folder can't be created, the "temp" file and "save as" file will already
		// be in the same directory, so dont' move them.
		//
		if (dest.parID != fFileSpec.parID)
		{
			CMovePBRec cMovePB;

			long parentDirID 	= cInfoPB.dirInfo.ioDrParID;

			cMovePB.ioVRefNum 	= fFileSpec.vRefNum;
			cMovePB.ioDirID 	= fFileSpec.parID;
			cMovePB.ioNamePtr	= fFileSpec.name;
			cMovePB.ioNewDirID	= parentDirID;
			cMovePB.ioNewName	= destName;

			returnVal = PBCatMoveSync(&cMovePB);
		}

		if (returnVal == noErr)
			returnVal = ::HRename(dest.vRefNum, dest.parID, fFileSpec.name, dest.name);
#else
		// Windows does not support PBCatMoveSync or HRename but the stdio rename
		// will work just fine.
		Assertion_AC(!IsDataForkOpen() && !IsRsrcForkOpen(), "Renaming a file which is open.");

		// Gather the full paths for the current directory and the destination directory.
		CString_AC	destFullPathName(dest.GetPathName() + dest.GetName());
		CString_AC	origFullPathName(GetPathName() + GetName());
		
		// Rename the file
		returnVal = ::rename(origFullPathName.c_str(), destFullPathName.c_str());
#endif
	}
	
	return returnVal;
}

//----------------------------------------------------------------------------------------
// CFile_AC::ReadData: 
//----------------------------------------------------------------------------------------

OSErr CFile_AC::ReadData(void* buffer, long& count)
{
	return FSRead(fDataRefNum, &count, (Ptr)buffer);
}

//----------------------------------------------------------------------------------------
// CFile_AC::ReadUntil: 
//----------------------------------------------------------------------------------------

OSErr CFile_AC::ReadUntil(void* buffer, long& count, char untilChar)
{
   OSErr theResult = noErr;
 
 	if (fDataRefNum != kNoFileRefNum_AC)
	{
		ParamBlockRec theParamBlock;
		theParamBlock.ioParam.ioCompletion = NULL;
		theParamBlock.ioParam.ioRefNum = fDataRefNum;
		theParamBlock.ioParam.ioBuffer = (Ptr) buffer;
		theParamBlock.ioParam.ioReqCount = count;
		theParamBlock.ioParam.ioPosMode = fsAtMark | 0x0080 | (untilChar * 0x100);
		theResult = ::PBReadSync(&theParamBlock);

		count = theParamBlock.ioParam.ioActCount;
	}

	return theResult;
 }

//----------------------------------------------------------------------------------------
// CFile_AC::RenameFile: 
//----------------------------------------------------------------------------------------

OSErr CFile_AC::RenameFile(const CString_AC& newName)
{
#if	!qMSWindows
	return FSpRename(&fFileSpec, CStr255_AC(newName));
#else
	// Windows does not support FSpRename but the stdio rename
	// will work just fine.
	Assertion_AC(!IsDataForkOpen() && !IsRsrcForkOpen(), "Renaming a file which is open.");

	// Gather the full path for the current directory.
	CString_AC	origFileName(GetName());
	CString_AC	origFullPathName(GetPathName());
	CString_AC	newFullPathName(origFullPathName + newName);
	origFullPathName += origFileName;

	// Rename the file
	return ::rename(origFullPathName.c_str(), newFullPathName.c_str());
#endif
}

//----------------------------------------------------------------------------------------
// CFile_AC::SetCatInfo: 
//----------------------------------------------------------------------------------------

OSErr CFile_AC::SetCatInfo(CInfoPBRec& cInfo)
{
	cInfo.hFileInfo.ioCompletion = NULL;
	cInfo.hFileInfo.ioNamePtr = fFileSpec.name;
	cInfo.hFileInfo.ioVRefNum = fFileSpec.vRefNum;
	cInfo.hFileInfo.ioDirID = fFileSpec.parID;

	OSErr err = noErr;
#if !qMSWindows
	err = ::PBSetCatInfoSync(&cInfo);
#else
//#pragma message ( "NOTE: Need to implement PBSetCatInfoSync in CFile_AC::SetCatInfo." __FILE__)
#endif

	return err;
}

//----------------------------------------------------------------------------------------
// CFile_AC::SetDataLength: 
//----------------------------------------------------------------------------------------

OSErr CFile_AC::SetDataLength(long length)
{
	return ::SetEOF(fDataRefNum, length);
}

//----------------------------------------------------------------------------------------
// CFile_AC::SetDataMark: 
//----------------------------------------------------------------------------------------

OSErr CFile_AC::SetDataMark(long mark, short fromWhere)
{
	return ::SetFPos(fDataRefNum, fromWhere, mark);
}

//----------------------------------------------------------------------------------------
// CFile_AC::SetFileInfo: 
//----------------------------------------------------------------------------------------

OSErr CFile_AC::SetFileInfo(HParamBlockRec& pb)
{
	pb.fileParam.ioNamePtr = fFileSpec.name;
	pb.fileParam.ioVRefNum = fFileSpec.vRefNum;
	pb.fileParam.ioDirID = fFileSpec.parID;

	OSErr err = noErr;
#if !qMSWindows
	err = PBHSetFInfoSync(&pb);
#endif

	return err;
}

//----------------------------------------------------------------------------------------
// CFile_AC::SetName: 
//----------------------------------------------------------------------------------------

void CFile_AC::SetName(const CString_AC& newName)
{
	fFileSpec.SetName(newName);
}

//----------------------------------------------------------------------------------------
// CFile_AC::SetScript: 
//----------------------------------------------------------------------------------------

OSErr CFile_AC::SetScript(ScriptCode theScript)
{
	OSErr theErr;
	CInfoPBRec cInfo;

	// Get the current info so we don't have to set up the entire record 
	if ((theErr = GetCatInfo(cInfo)) == noErr)
	{
		cInfo.hFileInfo.ioFlXFndrInfo.fdScript = theScript;
		theErr = SetCatInfo(cInfo);
	}

	return theErr;
}

//----------------------------------------------------------------------------------------
// CFile_AC::SetPermissions: 
//----------------------------------------------------------------------------------------

void CFile_AC::SetPermissions(SignedByte dataPermission, SignedByte rsrcPermission)
{
	// The values the 'permission' parameters can take are:
	//	fsCurPerm      =  0;    {whatever permission is allowed}
	//	fsRdPerm       =  1;    {read permission}
	//	fsWrPerm       =  2;    {write permission}
	//	fsRdWrPerm     =  3;    {exclusive read/write permission}
	//	fsRdWrShPerm   =  4;    {shared read/write permission}

	fDataPermission = dataPermission;
	fRsrcPermission = rsrcPermission;
}

//----------------------------------------------------------------------------------------
// CFile_AC::UpdateFileSpec: 
//----------------------------------------------------------------------------------------

bool CFile_AC::UpdateFileSpec()
{
	// Before we go using the aFile's information we must make sure it's
	// up-to-date (things might have change in the Finder, for example, such
	// as moving the file to another folder on the same volume or renaming
	// the file.
	
	Boolean		wasChanged = false;
	
	if (fAlias)
	{
		// We can't just fail if no interaction is allowed before resolving the
		// alias because there may be no need for user interaction.  If we
		// are in the background then immediately assume interaction is not
		// allowed.
		OSErr		anErr = errAENoUserInteraction;  // Assumes we're backgrounded.

#if !qMSWindows
		if (CApplication_AC::fgProcess && CApplication_AC::fgProcess->IsFrontProcess())
			anErr = CApplication_AC::DoInteractWithUser();
#endif

		if (anErr == errAENoUserInteraction)
		{
			// No interaction is allowed so just attempt to resolve the alias without UI.
			CFSSpec_AC	theFileSpec;			// Resulting file spec goes here.
			Boolean		updateAlias = false;
			short		myMatchCount = 1;
	
			// First try the absolute search method.
			anErr = ::MatchAlias(NULL,					// fromFile
								kARMMountVol
									+ kARMSearch
									+ kARMNoUI,			// rulesMask
								fAlias,					// alias
								&myMatchCount,			// aliasCount
								&theFileSpec,			// aliasList (FSSpecArrayPtr)
								&updateAlias,			// needsUpdate
								NULL,					// aliasFilter
								NULL);					// yourDataPtr);
			// If we're in the background the following special check must be made.
			if (anErr == noErr && updateAlias)
			{
				wasChanged = updateAlias;
				fFileSpec = theFileSpec;
			}
		}
		else
			anErr = ::ResolveAlias(NULL, fAlias, &fFileSpec, &wasChanged);

		if (anErr != userCanceledErr)
			::ThrowIfError_AC(anErr);
	}

	return wasChanged;
}

//----------------------------------------------------------------------------------------
// CFile_AC::InteractWithUser: 
//----------------------------------------------------------------------------------------

OSErr CFile_AC::InteractWithUser()
{
	return noErr;
}
//----------------------------------------------------------------------------------------
// CFile_AC::UpdateResourceFile: 
//----------------------------------------------------------------------------------------

OSErr CFile_AC::UpdateResourceFile()
{
	UpdateResFile(fRsrcRefNum);

	return ResError();
}

//----------------------------------------------------------------------------------------
// CFile_AC::UseResource: 
//----------------------------------------------------------------------------------------

short CFile_AC::UseResource()
{
	return UseResFile_AC(fRsrcRefNum);
}

//----------------------------------------------------------------------------------------
// CFile_AC::WriteData: 
//----------------------------------------------------------------------------------------

OSErr CFile_AC::WriteData(const void* buffer,
							  long& count)
{
	return FSWrite(fDataRefNum, &count, buffer);
}

//----------------------------------------------------------------------------------------
// End of CFile_AC.cpp


/*
	Historical Change Record:
		----- R13 -----
		07/21/97	SetModificationDate should also updated cached fModDate.
		07/16/97	Change ProgramBreak_AC to ProgramReport_AC in CFile_AC constructor and Specify
		07/15/97	[1615414] Reinstituted user interaction check in CFile_AC::UpdateFileSpec.
		07/11/97	Use ProgramBreak no fprintf.
		07/03/97	[1615544] Changed default case in CFile_AC::OpenDataFork.
		07/01/97	[1349422] Added GetPosition and SetPosition.  Moved
							include of <Files.h> to header.
		06/30/97	[1353169] fprinf(stderr, blah) to ProgramBreak_AC.
		06/22/97	Removed segmentation directives that I missed before.
		04/14/97	Update for real xxx_cast operators.
		03/25/97	AC_ to _AC Name change.
		03/24/97	Enhanced CFSSpec_AC, use its GetFinderInfo instead.
		03/20/97	Remove include of BlockMove_AC.h.
		03/11/97	Update exception support to latest.
		03/05/97	Commented out last change for now as it creates dependency from AC -> MA. fix soon.
		02/21/97	Specify now doesn't throw an error if the volume is not found in addition
							to the file not being found.
		02/11/97	[1615414] UpdateFileSpec now checks to see if we're in the background
							before attempting to present any UI.
		02/15/97	Fleshed out copy constructor.
		02/07/97	Updated includes.
		12/30/96	Spawned from UFile.
*/