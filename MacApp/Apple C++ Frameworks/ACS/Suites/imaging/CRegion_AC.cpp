//----------------------------------------------------------------------------------------
// CRegion_AC.cpp 
// Copyright © 1985-2001 by Apple Computer, Inc. All rights reserved.
//----------------------------------------------------------------------------------------

/*
	Change History
		02/14/01	Include MacMemory instead of Memory_AC. 
		01/02/01	Update copyright.
		02/22/00	[W] Modified IsRegion for Windows.
		03/24/99	Update copyright notice.
		03/23/99	Fixed all region calls that are now static functions to CRegion_AC.
		03/10/99	Don't pass reference to Bounds() in Inset.
  		02/11/99	[C] Cannot get rgnSize in IsRegion.
		10/26/98	Use UnionRgn_AC, CopyRgn_AC and XorRgn_AC instead of UnionRgn,
					CopyRgn and XorRgn.  Include ImagingUtils_AC.h.
		10/06/98	Clean up includes. 
*/

#ifndef __CRegion_AC__
#include "CRegion_AC.h"
#endif

// ACS

#ifndef __CAssertionFailure_AC__
#include "CAssertionFailure_AC.h"
#endif

#ifndef __CHandle_AC__
#include "CHandle_AC.h"
#endif

#ifndef __CReporter_AC__
#include "CReporter_AC.h"
#endif

#ifndef __CTempRegion_AC__
#include "CTempRegion_AC.h"
#endif

#ifndef __ImagingUtils_AC__
#include "ImagingUtils_AC.h"
#endif

// Toolbox

#ifndef __MACMEMORY__
#include <MacMemory.h>
#endif

// ANSI

#ifndef __STDIO__
#include <stdio.h>
#endif

//========================================================================================
// Global Functions
//========================================================================================

//----------------------------------------------------------------------------------------
// AboutToDisposeHandle: !!! Needs to be in ToolboxUtilities or somesuch
//----------------------------------------------------------------------------------------

#if qCoreDebug
static bool AboutToDisposeHandle(const Handle aHandle)
{
	// Test handlehood 
	bool returnVal = IsHandle_AC(aHandle);
	if (!returnVal)
	{
		VerboseIsHandle_AC(aHandle);				// Get the diagnosis printed 
		::ProgramBreak_AC("Trying to dispose an invalid handle.\nBad handle: %p\n", aHandle);
	}

	return returnVal;
}
#else
inline bool AboutToDisposeHandle(const Handle aHandle)
{
	return aHandle != NULL;
}
#endif

//----------------------------------------------------------------------------------------
// IsRegion: !!! Needs to be in ToolboxUtilities or somesuch
//----------------------------------------------------------------------------------------

#if qCoreDebug
static bool IsRegion(const RgnHandle aRegion)
{
	// Test handlehood 
	bool returnVal = AboutToDisposeHandle(reinterpret_cast<Handle>(aRegion));
	if (returnVal)
	{
		Handle		testHandle = reinterpret_cast<Handle>(aRegion);
		if (!IsHandle_AC(testHandle))		// Test handleness 
		{
			::ProgramBreak_AC("IsRegion: Region handle is not a handle: %p\n", aRegion);
			returnVal = false;
		}
#if !qMSWindows
		else if (!*testHandle)				// Test regionhood 
		{
			::ProgramBreak_AC("IsRegion: Region handle has been purged: %p\n", aRegion);
			returnVal = false;
		}
#if !qCarbon
		else
		{
			unsigned short rgnSize = (**aRegion).rgnSize;
			unsigned long rgnHandleSize = GetHandleSize(reinterpret_cast<Handle>(aRegion));
			if (rgnSize != rgnHandleSize)
			{
				::ProgramBreak_AC("IsRegion: Region size != handle size for region: %p\n", aRegion);
				returnVal = false;
			}
		}
#endif
#endif
	}
	return returnVal;
}
#else
inline bool IsRegion(const RgnHandle aRegion)
{
	return AboutToDisposeHandle(reinterpret_cast<Handle>(aRegion));
}
#endif

//========================================================================================
// CRegion_AC
//========================================================================================

//----------------------------------------------------------------------------------------
// static data members
//----------------------------------------------------------------------------------------
RgnHandle CRegion_AC::fCachedRgn;

//----------------------------------------------------------------------------------------
// Constructors
//----------------------------------------------------------------------------------------
CRegion_AC::CRegion_AC(short iLeft,
					   short iTop,
					   short iRight,
					   short iBottom)
{
	MakeRgnHandle();
	Set(iLeft, iTop, iRight, iBottom);
}


CRegion_AC::CRegion_AC(const CPoint_AC& topLeftPt,
					   const CPoint_AC& botRightPt)
{
	MakeRgnHandle();
	Set(topLeftPt, botRightPt);
}


CRegion_AC::CRegion_AC(const CRect_AC& rect)
{
	MakeRgnHandle();
	Set(rect);
}


CRegion_AC::CRegion_AC(const CRegion_AC& rgn)
{
	MakeRgnHandle();
	Set(rgn);
}


//----------------------------------------------------------------------------------------
// CRegion_AC::operator=
//----------------------------------------------------------------------------------------
CRegion_AC& CRegion_AC::operator=(const CRegion_AC& rgn)
{
	if (fData != rgn.fData)
	{
		DisposeIfRgnHandle(fData);
#if qCoreDebug
		if (rgn.fData)
			IsRegion(rgn.fData);
#endif
		fData = rgn.fData;
	}

	return *this;
}

//----------------------------------------------------------------------------------------
// CRegion_AC::operator+=:
//----------------------------------------------------------------------------------------
CRegion_AC& CRegion_AC::operator+=(const CRegion_AC& rt)
{
#if qCoreDebug
	Warning_AC(IsRegion(fData), NULL);
#endif
	::MacUnionRgn(fData, rt, fData);

	return *this;
}

//----------------------------------------------------------------------------------------
// CRegion_AC::operator-=:
//----------------------------------------------------------------------------------------
CRegion_AC& CRegion_AC::operator-=(const CRegion_AC& rt)
{
#if qCoreDebug
	Warning_AC(IsRegion(fData), NULL);
#endif
	::DiffRgn(fData, rt, fData);

	return *this;
}

//----------------------------------------------------------------------------------------
// CRegion_AC::operator^=:
//----------------------------------------------------------------------------------------
CRegion_AC& CRegion_AC::operator^=(const CRegion_AC& rt)
{
#if qCoreDebug
	Warning_AC(IsRegion(fData), NULL);
#endif
	::MacXorRgn(fData, rt, fData);

	return *this;
}

//----------------------------------------------------------------------------------------
// CRegion_AC::operator^:
//----------------------------------------------------------------------------------------
CRegion_AC CRegion_AC::operator^(const CRegion_AC& rt) const
{
	return CRegion_AC(*this) ^= rt;
}

//----------------------------------------------------------------------------------------
// CRegion_AC::operator+:
//----------------------------------------------------------------------------------------
CRegion_AC CRegion_AC::operator+(const CRegion_AC& rt) const
{
	return CRegion_AC(*this) += rt;
}

//----------------------------------------------------------------------------------------
// CRegion_AC::operator-:
//----------------------------------------------------------------------------------------
CRegion_AC CRegion_AC::operator-(const CRegion_AC& rt) const
{
	return CRegion_AC(*this) -= rt;
}

//----------------------------------------------------------------------------------------
// CRegion_AC::operator+=:
//----------------------------------------------------------------------------------------
CRegion_AC& CRegion_AC::operator+=(const CRect_AC& rt)
{
	return (*this) += CTempRegion_AC(rt);
}

//----------------------------------------------------------------------------------------
// CRegion_AC::operator-=:
//----------------------------------------------------------------------------------------
CRegion_AC& CRegion_AC::operator-=(const CRect_AC& rt)
{
	return (*this) -= CTempRegion_AC(rt);
}

//----------------------------------------------------------------------------------------
// CRegion_AC::operator+:
//----------------------------------------------------------------------------------------
CRegion_AC CRegion_AC::operator+(const CRect_AC& rt) const
{
	return CRegion_AC(*this) += CTempRegion_AC(rt);
}

//----------------------------------------------------------------------------------------
// CRegion_AC::operator-:
//----------------------------------------------------------------------------------------
CRegion_AC CRegion_AC::operator-(const CRect_AC& rt) const
{
	return CRegion_AC(*this) -= CTempRegion_AC(rt);
}

//----------------------------------------------------------------------------------------
// CRegion_AC::operator+=:
//----------------------------------------------------------------------------------------
CRegion_AC& CRegion_AC::operator+=(const CPoint_AC& pt)
{
	Offset(pt);

	return *this;
}

//----------------------------------------------------------------------------------------
// CRegion_AC::operator-=:
//----------------------------------------------------------------------------------------
CRegion_AC& CRegion_AC::operator-=(const CPoint_AC& pt)
{
	Offset(-pt);

	return *this;
}
//----------------------------------------------------------------------------------------
// CRegion_AC::operator+:
//----------------------------------------------------------------------------------------
CRegion_AC CRegion_AC::operator+(const CPoint_AC& pt) const
{
	return CRegion_AC(*this) += pt;
}

//----------------------------------------------------------------------------------------
// CRegion_AC::operator-:
//----------------------------------------------------------------------------------------
CRegion_AC CRegion_AC::operator-(const CPoint_AC& pt) const
{
	return CRegion_AC(*this) -= pt;
}

//----------------------------------------------------------------------------------------
// CRegion_AC::operator&=:
//----------------------------------------------------------------------------------------
CRegion_AC& CRegion_AC::operator&=(const CRegion_AC& rt)
{
#if qCoreDebug
	Warning_AC(IsRegion(fData), NULL);
#endif
	::SectRgn(fData, rt, fData);

	return *this;
}

//----------------------------------------------------------------------------------------
// CRegion_AC::operator|=:
//----------------------------------------------------------------------------------------
CRegion_AC& CRegion_AC::operator|=(const CRegion_AC& rt)
{
#if qCoreDebug
	Warning_AC(IsRegion(fData), NULL);
#endif
	::MacUnionRgn(fData, rt, fData);

	return *this;
}

//----------------------------------------------------------------------------------------
// CRegion_AC::operator|=:
//----------------------------------------------------------------------------------------
CRegion_AC& CRegion_AC::operator|=(const CPoint_AC& rt)
{
	*this |= CTempRegion_AC(rt.h, rt.v, rt.h + 1, rt.v + 1);

	return *this;
}

//----------------------------------------------------------------------------------------
// CRegion_AC::operator|=:
//----------------------------------------------------------------------------------------
CRegion_AC& CRegion_AC::operator|=(const CLongRect_AC& rt)
{
	*this |= CTempRegion_AC(rt.ToRect());

	return *this;
}

//----------------------------------------------------------------------------------------
// CRegion_AC::operator&:
//----------------------------------------------------------------------------------------
CRegion_AC CRegion_AC::operator&(const CRegion_AC& rt) const
{
	return CRegion_AC(*this) &= rt;
}

//----------------------------------------------------------------------------------------
// CRegion_AC::operator|:
//----------------------------------------------------------------------------------------
CRegion_AC CRegion_AC::operator|(const CRegion_AC& rt) const
{
	return CRegion_AC(*this) |= rt;
}

//----------------------------------------------------------------------------------------
// CRegion_AC::operator|:
//----------------------------------------------------------------------------------------
CRegion_AC CRegion_AC::operator|(const CPoint_AC& rt) const
{
	return CRegion_AC(*this) |= rt;
}

//----------------------------------------------------------------------------------------
// CRegion_AC::operator|:
//----------------------------------------------------------------------------------------
CRegion_AC CRegion_AC::operator|(const CLongRect_AC& rt) const
{
	return CRegion_AC(*this) |= rt;
}

//----------------------------------------------------------------------------------------
// CRegion_AC::Set
//----------------------------------------------------------------------------------------
void CRegion_AC::Set(const RgnHandle rhs)
{
#if qCoreDebug
	Warning_AC(IsRegion(fData), NULL);
#endif
	::MacCopyRgn(rhs, fData);
	::ThrowIfError_AC(::MemError());
}

//----------------------------------------------------------------------------------------
// CRegion_AC::Inset
//----------------------------------------------------------------------------------------
void CRegion_AC::Inset(short iH, short iV)
{
#if qCoreDebug
	Warning_AC(IsRegion(fData), NULL);
#endif
	::InsetRgn(fData, iH, iV);
	::ThrowIfError_AC(::MemError());
}

//----------------------------------------------------------------------------------------
// CRegion_AC::Inset
//----------------------------------------------------------------------------------------
void CRegion_AC::Inset(const CRect_AC& delta)
{
#if qCoreDebug
	Warning_AC(IsRegion(fData), NULL);
#endif
	::MapRgn(fData, Bounds(), &delta);
	::ThrowIfError_AC(::MemError());
}

//----------------------------------------------------------------------------------------
// CRegion_AC::IsValid
//----------------------------------------------------------------------------------------
bool CRegion_AC::IsValid() const
{
	return Bounds().IsValid();
}

//----------------------------------------------------------------------------------------
// CRegion_AC::Validate.
//----------------------------------------------------------------------------------------
void CRegion_AC::Validate()
{
	// ???
}

//----------------------------------------------------------------------------------------
// CRegion_AC::GetLength
//----------------------------------------------------------------------------------------
short CRegion_AC::GetLength(VHSelect sel) const
{
	return Bounds().GetLength(sel);
}

//----------------------------------------------------------------------------------------
// CRegion_AC::GetSize: Returns the size of a CRegion_AC as a CPoint_AC.
//----------------------------------------------------------------------------------------
CPoint_AC CRegion_AC::GetSize() const
{
	return Bounds().GetSize();
}

//----------------------------------------------------------------------------------------
// CRegion_AC::Contains
//----------------------------------------------------------------------------------------
bool CRegion_AC::Contains(const CPoint_AC& pt) const
{
#if qCoreDebug
	Warning_AC(IsRegion(fData), NULL);
#endif
	return ::PtInRgn(pt, fData);
}

//----------------------------------------------------------------------------------------
// CRegion_AC::Contains
//----------------------------------------------------------------------------------------
bool CRegion_AC::Contains(const CRect_AC& rt) const
{
#if qCoreDebug
	Warning_AC(IsRegion(fData), NULL);
#endif
	return ::RectInRgn(rt, fData);
}

//----------------------------------------------------------------------------------------
// CRegion_AC::Contains
//----------------------------------------------------------------------------------------
bool CRegion_AC::Contains(const CRegion_AC& rt) const
{
	CTempRegion_AC diff;
	diff.Set(fData);	// better be a copy!
	diff &= rt;
	return ::EmptyRgn(diff);
}

//----------------------------------------------------------------------------------------
// CRegion_AC::MakeRgnHandle
//----------------------------------------------------------------------------------------
RgnHandle CRegion_AC::MakeNewRgn()
{
	RgnHandle returnVal = NULL;

#if qCoreDebug
	if (fCachedRgn && !IsRegion(fCachedRgn))
	{
		::ProgramBreak_AC("The cached region has been corrupted: %p\n", fCachedRgn);
		fCachedRgn = NULL;
	}
#endif

	// Simple single level cache.
	// take the cached region if available otherwise make one up to give out
	if (fCachedRgn)
	{
		returnVal = fCachedRgn;
		fCachedRgn = NULL;
	}
	else
	{
		returnVal = ::NewRgn();
		ThrowIfNULL_AC(returnVal);
	}

	return returnVal;
}

//----------------------------------------------------------------------------------------
// DisposeIfRgnHandle: 
//----------------------------------------------------------------------------------------
RgnHandle CRegion_AC::DisposeIfRgnHandle(RgnHandle aRgnHandle)
{
	if ((aRgnHandle != NULL) && IsRegion(aRgnHandle))
	{
		// return to the cache if not already full
		if (fCachedRgn)
		{
			if (aRgnHandle == fCachedRgn)
			{
#if qCoreDebug
				::ProgramBreak_AC("I just saved you from a double-dispose of a region! %p\n", aRgnHandle);
#endif
				fCachedRgn = NULL;
			}

#if 0 // qCoreDebug !!! Need ToolboxUtilities
			// Set the handle contents to a real nice value for any dangling pointerciples 
			BlockSet_AC(*((Handle)aRgnHandle), GetHandleSize((Handle)aRgnHandle), kDisposedInitVal_AC);
#endif
			::DisposeRgn(aRgnHandle);			// already full
		}
		else
		{
			::SetEmptyRgn(aRgnHandle);
			fCachedRgn = aRgnHandle;
		}
	}

	return NULL;
}

//----------------------------------------------------------------------------------------
// End of CRegion_AC.cpp
