//----------------------------------------------------------------------------------------
// CMultiLocal_AC.cpp
// Copyright © 1998-2001 by Apple Computer. All rights reserved. 
//----------------------------------------------------------------------------------------

/*
	Change History
		07/27/01	Fix Call and Override notes.
		07/19/01	Removed invalid assertion at top of GetReverseMappedResInfo.
		06/05/01	Fetch locale name from resource name in CMultiLocale_AC ctor.
		05/07/01	Comment out pragma messages for Carbon. 
		02/16/01	KeyScript is in Events.h. 
		02/15/01	Need to include Fonts.h and CTidyHeap_AC. 
					Don't include Windows_AC. 
		01/02/01	Update copyright.
		10/18/00	MrCpp: variables declared in for loops belong to containing 
					scope (unless -ansifor is specified). 
					Work around lack of support for mutable. 
		09/06/00	Check for proper resource type, not wildCard, in ResolveTheResource.
		09/01/00	Stripped dead code.
		08/17/00	Changed inRegionCode to inScriptCode in SetKeyScriptCode.
		07/31/00	Test index > 0 in GetIndString.[W] Call GetResource instead of
					RGetResource in RGetResource.
        07/25/00	Need to include standard library algorithm. 
		06/28/00	Include ResFileUtils_AC.h.
		06/08/00	Mostly rewritten.
		05/23/00	[2279264] Remove false from ProgramReport_AC. 
		10/07/99	Carbon: Have RGetResource call GetResource.
		09/23/99	Carbon: change #warning to #pragma message
		09/22/99	Carbon: Took out RGetResource, as not in Carbon?
		03/24/99	Update copyright notice.
		03/02/99	[2306534] Added sfUsingMultiLocale which can be used to short-circuit
					MultiLocale calls if there was no LMap resource.  Also added sfMultiLocaleInited.
					Both are set in InitCMultiLocal.  Check both settings in GetResourceID
					in order to short-circuit MultiLocale calls.							
		12/29/98	[W] Add pragma unused.
		11/11/98	[2279201] Replace GetResourceID with GetExistingResourceID in
					GetString and GetIndString.
		10/06/98	Clean up includes. 
*/

#ifndef __CMultiLocal_AC__
#include "CMultiLocal_AC.h"
#endif

// ACS

#ifndef __CAssertionFailure_AC__
#include "CAssertionFailure_AC.h"
#endif

#ifndef __CException_AC__
#include "CException_AC.h"
#endif

#ifndef __CHandle_AC__
#include "CHandle_AC.h"
#endif

#ifndef __CHandleStream_AC__
#include "CHandleStream_AC.h"
#endif

#ifndef __CReporter_AC__
#include "CReporter_AC.h"
#endif

#ifndef __CTidyHeap_AC__
#include "CTidyHeap_AC.h"
#endif

#ifndef __ResourceUtils_AC__
#include "ResourceUtils_AC.h"
#endif

#ifndef __ResFileUtils_AC__
#include "ResFileUtils_AC.h"
#endif

// Toolbox

#ifndef __EVENTS__
#include <Events.h>
#endif

#ifndef __FONTS__
#include <Fonts.h>
#endif

#ifndef __RESOURCES__
#include <Resources.h>
#endif

#ifndef __TEXTUTILS__
#include <TextUtils.h>
#endif

// Standard Library

#include <algorithm>


/*
	CMultiLocale Data Structures
	
		ResourceDirectMap -	A structure which maps a resource type, number and index
							onto a substitute resource number and index.
		ResourceOffsetMap -	A structure which provides an offset against a base resource
							number by resource type and number.
		ResolutionCache -	A structure which contains previously resolved resource
							mappings.
	
	Initialization
	
		Zero or more local mapping resources (LOCL) are read.  CLocale class objects are
		created for each one read and their respective ResourceDirectMap and ResourceOffsetMaps
		are created and populated.
		
		Each localization is enabled or disabled based on the presence of the associated
		script within the system.  These scripts are installed separately.
			
	Setting the Region
		
		While it is possible to set your current resource resolution based on the current
		keyboard menu setting we recommend highly against doing this.  It is far better
		to base the resource resolution technique on the system default region or a
		user preference setting.
		
		All Resource Manager replacement calls have an optional region code parameter.
		Use this parameter only if you really, really want to override your application’s
		current setting as indicated in sfDefaultRegionCode.  The default parameter
		to the resource calls is kDefaultRegionCode, which means to use the current
		region code found in sfDefaultRegionCode.  sfDefaultRegionCode is set by
		default to kSystemRegion, which is a psuedo region code which indicates that
		the installed system’s region code is to be used.
		
		Rather than pass a custom value to the resource calls we recommend that
		the sfDefaultRegionCode value be changed (using SetDefaultRegionCode) instead.
	
	Other Notes
	
		A typical script installation contains all of the fonts, keyboard mappings, and
		resources needed for all of the languages and regions associated with that script.
		For example, when the smRoman script package is installed it contains the
		following languages and regions:
		
			Australian, Brazilian, British, Canadian, Canadian French, Danish,
			Dutch, Finnish, Flemish, French, German, Italian, Norwegian, Spanish,
			Swedish, Swiss French, Swiss German and U.S.
*/

//========================================================================================
// Static Initializations
//========================================================================================

RegionCode	CMultiLocale_AC::sfDefaultRegionCode	= kSystemRegion;	// Current region is whatever the system is using.
RegionCode	CMultiLocale_AC::sfSysRegionCode		= kSystemRegion;	// System region.
RegionCode	CMultiLocale_AC::sfAppRegionCode		= kSystemRegion;	// Application region.
RegionCode	CMultiLocale_AC::sfBaseRegionCode		= kAllRegions;		// Base region - initialization value.
bool		CMultiLocale_AC::sfUsingMultiLocale		= false;			// Set to true if LMap resource was found.
bool		CMultiLocale_AC::sfMultiLocaleInited	= false;			// Set to true once InitCMultiLocal called.
CMultiLocale_AC::ScriptCodeList		CMultiLocale_AC::sfActiveScripts;	// A list of active script codes.
CMultiLocale_AC::CLocaleList		CMultiLocale_AC::sfCLocaleList;		// Our list of locales.
CMultiLocale_AC::RegionLocaleMap	CMultiLocale_AC::sfRegionLocaleMap;	// Maps from region to locale object.

//========================================================================================
// CLASS CMultiLocale_AC
//========================================================================================

//----------------------------------------------------------------------------------------
// CMultiLocale_AC::CMultiLocale_AC
//----------------------------------------------------------------------------------------

CMultiLocale_AC::CMultiLocale_AC(short aResindex)
	:	fScriptCode(0),
		fLangCode(0),
		fRegionCode(0),
		fInheritedRegionCode(0),
		fAvailable(false)
// CLocale is a constructor which takes a resource index and creates the CLocale by reading
// the LOCL resource with that index.
{
	Handle				hLocale = ::GetIndResource(LocaleResType, aResindex);
	::ThrowIfNULLResource_AC(hLocale);
	{
		// This block is here to insure that the CHandleStream_AC gets torn down
		// before the resource gets released.
		CHandleStream_AC	hLocaleStream(hLocale);
		
		// Pull in the region specificiations.
		hLocaleStream	>>	fScriptCode
						>>	fLangCode
						>>	fRegionCode
						>>	fInheritedRegionCode;

		// Build the resource offset map.
		short	offsetCount;
		hLocaleStream	>>	offsetCount;
		for (short index = 0; index < offsetCount; index++)
		{
			ResType		aResType;
			ResNumber	aResOffset;
			hLocaleStream	>>	aResType
							>>	aResOffset;

			fOffsetMap[aResType] = aResOffset;
			
			// While we're at it see if this is the base region (indicated by an offset of 0 and ID of '****'.
			if (GetBaseRegionCode() == kSystemRegion && aResType == wildCard && aResOffset == 0)
				SetBaseRegionCode(fRegionCode);
		}

		// Build the resource direct map.
		short	directCount;
		hLocaleStream	>>	directCount;
		for (short index2 = 0; index2 < directCount; index2++)
		{
			//ResTypeNumIdx	fromDirectItem;
			ResType			fromResType;
			ResNumber		fromResNum;
			short			fromResIndex;
			
			//ResIndexPair	toResNumIndex;
			ResNumber		toResNum;
			short			toResIndex;
			
			hLocaleStream	>>	fromResType
							>>	fromResNum
							>>	fromResIndex
							>>	toResNum
							>>	toResIndex;

			fDirectMap[ResTypeNumIdx(fromResType, fromResNum, fromResIndex)]
					 = ResIndexPair(toResNum, toResIndex);
		}
		
		// Determine if this region (script) is available on this system.
		long	result = ::GetScriptVariable(fScriptCode, smScriptEnabled);
		if (result)
		{
			// •••  I'm not sure why we have to do the following validation?
			// Is this the same localization as specified for our system?
			ResNumber	scriptDate = ::GetScriptVariable(fScriptCode, smScriptDate);	// This gets the resource ID of the script's long-date-format.
			Intl1Hndl	longDateRsrc = reinterpret_cast<Intl1Hndl>(::GetResource('itl1', scriptDate));
			RegionCode	itsRegion = (static_cast<unsigned short>((*longDateRsrc)->intl1Vers)) >> 8; // Region code is in the top byte.
			
			if (fRegionCode == itsRegion)
				fAvailable = true;		// It is the active locale
			
			sfActiveScripts.insert(fScriptCode);
		}
		
		// Fetch the name of the resource and use it for the locale name.
		ResNumber	resNumIgnored;
		ResType		resTypeIgnored;
		Str255		localeName;
		::GetResInfo(hLocale, &resNumIgnored, &resTypeIgnored, localeName);
		fLocaleName = localeName;
	}
	::ReleaseResource(hLocale);
}

//----------------------------------------------------------------------------------------
// CMultiLocale_AC::ResolveResourceID
//----------------------------------------------------------------------------------------

ResIndexPair CMultiLocale_AC::ResolveResourceID(ResType inResType,
												ResNumber inResID,
												short inIndex,
												bool singleLevel,
												bool mustExist) const
// ResolveResourceID performs the hard work of determining which resource ID (and index) to
// actually use for retrieving a resource.  First a check is made to see if there
// is a direct mapping entry for the type and ID for the given region.  If there is
// then the directly mapped ID is returned.  Otherwise a check is made to see if there
// is an offset entry for the type and ID.  If there is then the ID is offset and
// returned.  If not, then a check is made for a wildcard offset.  If there is one
// that the ID is offset and returned.  Otherwise the process starts over again with
// the inherited region code.  If mustExist is true then a check is made to see if
// a resource with the remapped ID actually exists and if not then the process continues
// until a wildcard or offset results in a existing resource.  If a direct mapped resource
// does not exist a warning is raised.
// The actual work is performed in ResolveTheResource.  The ResolveTheResource function
// exists to aid in the caching of the resolved resources.
// NOTE: Resource resolution is cached so that the entire process of resolution is not
// required on subsequent calls for the same resource.
//
// Returns:			A ResIndexPair.
// inResType:		The ResType of the resource to be mapped.
// inResID:			The base ResNumber of the resource.
// index:			A short which represents an optional resource index.  '0' if not indexed.
// singleLevel:		A bool indicating if this should be resolved only to the current resource file
//					or if all resources files in the chain should be searched.  Defaults to false.
// mustExist:		A bool indicating if the remapping is to continue until an actual
//					resource is found.  Defaults to true.
//
// Call?			Rarely.
// Override?		Never.
{
	ResIndexPair	finalResAndIndex(inResID, inIndex);
	
	if (sfUsingMultiLocale)
	{
		bool			resolved = false;

		// Has this resource already been resolved?  (Check the cache.)
		ResTypeNumIdxMust	cacheKey(inResType, inResID, inIndex, mustExist);

		// Check the cache with the actual mustExist setting.
		ResolutionCacheConstIterator		cacheIter = fResourceCache.find(cacheKey);
		if (cacheIter != fResourceCache.end())
		{
			finalResAndIndex = cacheIter->second;
			resolved = true;
		}
		else if (!mustExist)
		{
			// Check the cache with a true for the mustExist setting since that will also work for
			// not mustExist resolution, too, and then cache this one.
			ResTypeNumIdxMust	mustCacheKey(inResType, inResID, inIndex, true);
			cacheIter = fResourceCache.find(mustCacheKey);
			if (cacheIter != fResourceCache.end())
			{
				finalResAndIndex = cacheIter->second;
#ifdef __MRC__
				// Work around MrCpp doesn't support mutable
				const_cast<CMultiLocale_AC*>(this)->
#endif
				fResourceCache[cacheKey] = finalResAndIndex;
				resolved = true;
			}
		}
		
		if (!resolved)
		{
			finalResAndIndex = ResolveTheResource(inResType, inResID, inIndex, singleLevel, mustExist);
#ifdef __MRC__
			// Work around MrCpp doesn't support mutable
			const_cast<CMultiLocale_AC*>(this)->
#endif
			fResourceCache[cacheKey] = finalResAndIndex;	// Cache the results.
		}
	}

	return finalResAndIndex;
}

//----------------------------------------------------------------------------------------
// CMultiLocale_AC::ResolveTheResource
//----------------------------------------------------------------------------------------

ResIndexPair CMultiLocale_AC::ResolveTheResource(ResType inResType, ResNumber inResID, short inIndex,
												 bool singleLevel, bool mustExist) const
// ResolveTheResource does the actual work as described for ResolveResourceID with the
// exception of not doing the caching.  The reason we don't just have the resource manager
// replacement functions call directly into ResolveTheResource is so that we don't end
// up caching resource information at multiple levels in the inheritance hierarchy
// with the subsequent incorrect results.
//
// inResType:		The ResType of the resource to be mapped.
// inResID:			The base ResNumber of the resource.
// index:			A short which represents an optional resource index.  '0' if not indexed.
// singleLevel:		A bool indicating if this should be resolved only to the current resource file
//					or if all resources files in the chain should be searched.
// mustExist:		A bool indicating if the remapping is to continue until an actual
//					resource is found.
{
	ResIndexPair	finalResAndIndex(inResID, inIndex);
	
	if (sfUsingMultiLocale && inResID != kNoResource_AC)
	{
		ResIndexPair	resolvedResAndIndex(inResID, inIndex);
		
		// Check for a direct mapping.
		resolvedResAndIndex = MapDirectly(inResType, inResID, inIndex);
		ResNumber		resolvedResID = resolvedResAndIndex.first;		// Convenience.
		
		// If it didn't directly map then attempt an offset mapping.
		if (resolvedResID == kNoResource_AC)
		{
			// Check for an offset mapping for this type.
			ResNumber	resIDOffset = MapByOffset(inResType);

			if (resIDOffset != kNoResource_AC)
			{
				// Found, but does it have to exist?
				if (mustExist && !DoesResourceExist(inResType, inResID + resIDOffset))
					resIDOffset = kNoResource_AC;	// Doesn't exist so keep trying.
			}
			
			// Specific resource not found so try the wildcard.
			if (resIDOffset == kNoResource_AC)
			{
				// Check for wildcard and then see if the actual resource have to exist?
				resIDOffset = MapByOffset(wildCard);
				if (mustExist && resIDOffset != kNoResource_AC && !DoesResourceExist(inResType, inResID + resIDOffset))
					resIDOffset = kNoResource_AC;	// Doesn't exist so keep trying.
			}
			
			// If we still haven't found the resource check the inherited resource.
			if (resIDOffset == kNoResource_AC)
			{
				RegionLocaleMapIterator		aRegLocIter = sfRegionLocaleMap.find(fInheritedRegionCode);
				if (aRegLocIter != sfRegionLocaleMap.end())
					finalResAndIndex = aRegLocIter->second->ResolveResourceID(inResType, inResID, inIndex, singleLevel, mustExist);
			}
			else
				finalResAndIndex.first = inResID + resIDOffset;	// Otherwise return what we've got, whatever it is.
		}
		else
		{
			// The resource was directly mapped but must it exist?
			if (!mustExist || DoesResourceExist(inResType, resolvedResID))
				finalResAndIndex = resolvedResAndIndex;
#if qDebug
			else
				// The resource doesn't exist but we expected it to.
				::ProgramBreak_AC("CMultiLocale_AC::ResolveResourceID: Resource ‘%4c’ (%d,%d) [mapped from (%d,%d)]"
								  " does not exist but should.",
								  inResType, resolvedResID, resolvedResAndIndex.second, inResID, inIndex);
#endif
		}
	}

	return finalResAndIndex;
}

//----------------------------------------------------------------------------------------
// CMultiLocale_AC::MapDirectly
//----------------------------------------------------------------------------------------

ResIndexPair CMultiLocale_AC::MapDirectly(ResType inResType, ResNumber inResID, short inIndex) const
// MapDirectly checks the fDirectMap to see if there is a direct mapping entry for the
// given resource by type, number and index and returns the mapped results if found.  Otherwise
// it checks for the given resource by type and number and returns those results.  Otherwise
// failure is signaled by returning a result with a resource number of kNoResource_AC.
//
// inResType:		The ResType of the resource to be mapped.
// inResID:			The base ResNumber of the resource.
// index:			A short which represents an optional resource index.  '0' if not indexed.
//
// Call?			Never.
// Override?		Never.
{
	ResTypeNumIdx					aTypeNumIdx(inResType, inResID, inIndex);
	ResIndexPair					indexPair(kNoResource_AC, 0);
	ResourceDirectMapConstIterator	directIter = fDirectMap.find(aTypeNumIdx);

	// Find a mapping with the index (if there is one).
	if (inIndex != 0 && directIter != fDirectMap.end())
		indexPair = directIter->second;
	else
	{
		// Find a mapping with an index of 0 (unindexed).
		aTypeNumIdx.fResIndex = 0;
		directIter = fDirectMap.find(aTypeNumIdx);
		if (directIter != fDirectMap.end())
			indexPair = directIter->second;
	}
	return indexPair;
}

//----------------------------------------------------------------------------------------
// CMultiLocale_AC::MapByOffset
//----------------------------------------------------------------------------------------

ResNumber CMultiLocale_AC::MapByOffset(ResType inResType) const
// MapByOffset checks the fOffsetMap to see if there is an offset mapping entry for the
// given resource by type and returns the offset if found.  Otherwisea  kNoResource_AC
// is returned.
//
// inResType:		The ResType of the resource to be mapped.
//
// Call?			Never.
// Override?		Never.
{
	ResNumber						theOffset = kNoResource_AC;
	ResourceOffsetMapConstIterator	offsetIter = fOffsetMap.find(inResType);

	if (offsetIter != fOffsetMap.end())
		theOffset = offsetIter->second;

	return theOffset;
}

//----------------------------------------------------------------------------------------
// ResIndexMatch 
//----------------------------------------------------------------------------------------

class ResIndexMatch
// ResIndexMatch is a helper class for the ReverseMapIDAndType that compares an
// entry in a ResolutionCache to a target ResIndexPair.
{
public:
	ResIndexMatch(ResType theType, ResNumber inFromID)
		:	fSearchType(theType),
			fSearchID(inFromID)
		{ }
	bool operator()(ResolutionPair& aCandidate)
		{ return (aCandidate.first.fResType == fSearchType && aCandidate.second.first == fSearchID); }

private:
	ResType			fSearchType;
	ResNumber		fSearchID;
};

//----------------------------------------------------------------------------------------
// CMultiLocale_AC::ReverseMapIDAndType
//----------------------------------------------------------------------------------------

ResNumber CMultiLocale_AC::ReverseMapIDAndType(ResNumber inFromID, ResType theType)
{
	ResNumber reversedID = inFromID;
	
	// Reverse map inFromID from the actual resource ID to the base resource ID.
	ResolutionCacheConstIterator	cacheIter = find_if(fResourceCache.begin(),
														fResourceCache.end(),
														ResIndexMatch(theType, inFromID));
	if (cacheIter != fResourceCache.end())
	{
		// We actually find something that matches.  [We could check for other matches
		// when qDebug and raise a ProgramBreak but it's buyer beware at the moment.]
		ResTypeNumIdxMust	anEntry = cacheIter->first;
		reversedID = anEntry.fResNumber;
	}
	
	return reversedID;
}

//========================================================================================
// Global Resource Manager Replacement Functions (in utility class CMultiLocale_AC)
//========================================================================================

//----------------------------------------------------------------------------------------
// CMultiLocale_AC::GetMappedResourceID
//----------------------------------------------------------------------------------------

ResNumber CMultiLocale_AC::GetMappedResourceID(ResType inResType, ResNumber inFromID, RegionCode inDesiredRegion)
// GetMappedResourceID will return the resource ID for a resource with the given type and base ID
// for the specified region.  This requires translating the resource ID according to
// the region code.  The resulting resource does not have to exist.
//
// inResType:		The ResType of a resource.
// inFromID:		The base ResNumber of the desired resource.
// inDesiredRegion:	The RegionCode for which the resource is desired.  This defaults to
//					kDefaultRegionCode, indicating that the current setting of sfDefaultRegionCode
//					be used.
{
	ResNumber returnVal = inFromID;

	if (sfUsingMultiLocale && inFromID != kNoResource_AC)
	{
		RegionCode		toActualRegionCode = RunTimeRegionCode(inDesiredRegion);
		if (toActualRegionCode != GetBaseRegionCode())
		{
			RegionLocaleMapIterator		aRegLocIter = sfRegionLocaleMap.find(toActualRegionCode);
			if (aRegLocIter != sfRegionLocaleMap.end())
			{
				ResIndexPair	mappedResIndex = aRegLocIter->second->ResolveResourceID(inResType, inFromID, false, false);
				if (mappedResIndex.first != kNoResource_AC)
					returnVal = mappedResIndex.first;
			}
		}
	}
	
	return returnVal;
}

//----------------------------------------------------------------------------------------
// CMultiLocale_AC::GetExistingResourceID
//----------------------------------------------------------------------------------------

ResNumber CMultiLocale_AC::GetExistingResourceID(ResType inResType, ResNumber inFromID, RegionCode inDesiredRegion, bool singleLevel)
// GetExistingResourceID will return the resource ID for a resource with the given type and base ID
// for the specified region.  This requires translating the resource ID according to
// the region code.  The resulting resource does have to exist otherwise the inFromID is returned
// under the assumption that the base resource always exists.
//
// inResType:		The ResType of a resource.
// inFromID:		The base ResNumber of the desired resource.
// singleLevel:		A bool indicating if the search is to go only one resource file down (true) or
//					if all resource files in the chain are to be searched.
// inDesiredRegion:	The RegionCode for which the resource is desired.  This defaults to
//					kDefaultRegionCode, indicating that the current setting of sfDefaultRegionCode
//					be used.
{
	ResNumber returnVal = inFromID;

	if (sfUsingMultiLocale && inFromID != kNoResource_AC)
	{
		RegionCode		toActualRegionCode = RunTimeRegionCode(inDesiredRegion);
		if (toActualRegionCode != GetBaseRegionCode())
		{
			RegionLocaleMapIterator		aRegLocIter = sfRegionLocaleMap.find(toActualRegionCode);
			if (aRegLocIter != sfRegionLocaleMap.end())
			{
				CMultiLocale_AC*	aLocale = aRegLocIter->second;
				ResIndexPair		mappedResIndex = aLocale->ResolveResourceID(inResType, inFromID, singleLevel);
				if (mappedResIndex.first != kNoResource_AC)
					returnVal = mappedResIndex.first;
			}
		}
	}
	
	return returnVal;
}

//----------------------------------------------------------------------------------------
// CMultiLocale_AC::GetMappedIndResourceID
//----------------------------------------------------------------------------------------

ResIndexPair CMultiLocale_AC::GetMappedIndResourceID(ResType inResType,
													 ResNumber inFromID,
													 short inIndex,
													 RegionCode inDesiredRegion)
// GetMappedResourceID will return the resource ID for a resource with the given type and base ID
// for the specified region.  This requires translating the resource ID according to
// the region code.  The resulting resource does not have to exist.
//
// inResType:		The ResType of a resource.
// inFromID:		The base ResNumber of the desired resource.
// inIndex:			A short containing the ind resource index number.
// inDesiredRegion:	The RegionCode for which the resource is desired.  This defaults to
//					kDefaultRegionCode, indicating that the current setting of sfDefaultRegionCode
//					be used.
{
	ResIndexPair	resolvedResAndIndex(inFromID, inIndex);

	if (sfUsingMultiLocale && inFromID != kNoResource_AC)
	{
		RegionCode		toActualRegionCode = RunTimeRegionCode(inDesiredRegion);
		if (toActualRegionCode != GetBaseRegionCode())
		{
			RegionLocaleMapIterator		aRegLocIter = sfRegionLocaleMap.find(toActualRegionCode);
			if (aRegLocIter != sfRegionLocaleMap.end())
			{
				ResIndexPair	mappedResIndex = aRegLocIter->second->ResolveResourceID(inResType, inFromID, inIndex, false, false);
				if (mappedResIndex.first != kNoResource_AC)
					resolvedResAndIndex = mappedResIndex;
			}
		}
	}
	
	return resolvedResAndIndex;
}

//----------------------------------------------------------------------------------------
// CMultiLocale_AC::GetExistingIndResourceID
//----------------------------------------------------------------------------------------

ResIndexPair CMultiLocale_AC::GetExistingIndResourceID(ResType inResType,
													   ResNumber inFromID,
													   short inIndex,
													   RegionCode inDesiredRegion,
													   bool singleLevel)
// GetExistingResourceID will return the resource ID for a resource with the given type and base ID
// for the specified region.  This requires translating the resource ID according to
// the region code.  The resulting resource does have to exist otherwise the inFromID is returned
// under the assumption that the base resource always exists.
//
// inResType:		The ResType of a resource.
// inFromID:		The base ResNumber of the desired resource.
// inIndex:			A short containing the ind resource index number.
// singleLevel:		A bool indicating if the search is to go only one resource file down (true) or
//					if all resource files in the chain are to be searched.
// inDesiredRegion:	The RegionCode for which the resource is desired.  This defaults to
//					kDefaultRegionCode, indicating that the current setting of sfDefaultRegionCode
//					be used.
{
	ResIndexPair	resolvedResAndIndex(inFromID, inIndex);

	if (sfUsingMultiLocale && inFromID != kNoResource_AC)
	{
		RegionCode		toActualRegionCode = RunTimeRegionCode(inDesiredRegion);
		if (toActualRegionCode != GetBaseRegionCode())
		{
			RegionLocaleMapIterator		aRegLocIter = sfRegionLocaleMap.find(toActualRegionCode);
			if (aRegLocIter != sfRegionLocaleMap.end())
			{
				CMultiLocale_AC*	aLocale = aRegLocIter->second;
				ResIndexPair		mappedResIndex = aLocale->ResolveResourceID(inResType, inFromID, inIndex, singleLevel);
				if (mappedResIndex.first != kNoResource_AC)
					resolvedResAndIndex = mappedResIndex;
			}
		}
	}
	
	return resolvedResAndIndex;
}

//----------------------------------------------------------------------------------------
// CMultiLocale_AC::DoesResourceExist
//----------------------------------------------------------------------------------------
bool CMultiLocale_AC::DoesResourceExist(ResType inResType, ResNumber inID, bool singleLevel)
{
	Handle h = NULL;
	
	if (inID != kNoResource_AC)
	{
		ACS::CTempResLoad(false);
		if (singleLevel)
			h = ::Get1Resource(inResType, inID);
		else
			h = ::GetResource(inResType, inID);
	}

	return h != NULL;
}

//----------------------------------------------------------------------------------------
// CMultiLocale_AC::DoesMappedResourceExist
//----------------------------------------------------------------------------------------
bool CMultiLocale_AC::DoesMappedResourceExist(ResType inResType, ResNumber inID, RegionCode inDesiredRegion, bool singleLevel)
{
	Handle h = NULL;

	if (sfUsingMultiLocale)
	{
		if (inID != kNoResource_AC)
		{
			ACS::CTempResLoad(false);
			if (singleLevel)
				h = CMultiLocale_AC::Get1Resource(inResType, inID, inDesiredRegion);
			else
				h = CMultiLocale_AC::GetResource(inResType, inID, inDesiredRegion);
		}
	}
	else
		return DoesResourceExist(inResType, inID, singleLevel);

	return h != NULL;
}

//----------------------------------------------------------------------------------------
// CMultiLocale_AC::GetResourceID: 
//----------------------------------------------------------------------------------------

ResNumber CMultiLocale_AC::GetResourceID(Handle inResHandle)
// GetResourceID returns the resource number for the resource contained in the supplied
// resource handle.
//
// inResHandle:		A Handle containing a resource.
{
	ResNumber returnVal = kNoResource_AC;

	ResType		theType;
	Str255		localName;

	if (inResHandle)
		::GetResInfo(inResHandle, &returnVal, &theType, localName);
	
	return returnVal;
}

//----------------------------------------------------------------------------------------
// CMultiLocale_AC::GetScriptFromRegion
//----------------------------------------------------------------------------------------

ScriptCode CMultiLocale_AC::GetScriptFromRegion(RegionCode inRegionCode)
// GetScriptFromRegion determines the script code for a given region code by scanning
// through the list of locales.  smAllScripts is returned if no such locale is found.
//
// inRegionCode:	The RegionCode for which the script code is to be determined.
{
	ScriptCode				foundCode = smAllScripts;
	if (sfUsingMultiLocale)
	{
		RegionLocaleMapIterator	aRegLocIter = sfRegionLocaleMap.find(inRegionCode);
		if (aRegLocIter != sfRegionLocaleMap.end())
			foundCode = aRegLocIter->second->GetScriptCode();
	}
	
	return foundCode;
}

//----------------------------------------------------------------------------------------
// CMultiLocale_AC::GetKeyRegionCode
//----------------------------------------------------------------------------------------

RegionCode CMultiLocale_AC::GetKeyRegionCode()
// GetKeyRegionCode determines the region code for the currently selected keyboard menu.  It
// does this by retrieving the KCHR resource ID which happens to be the region code and then
// possibly remapping that KCHR resource number to a region code (for those KCHRs which are
// not actual region codes.
// NOTE: We do not recommend using the currently selected keyboard script for determining
// what set of resources ought to be used.  Rather, we recommend that there be a user
// preference option made available to the user.
// NOTE: There are some keyboard selections which may surprise you.  Take "Arabic for
// Powerbooks" for example.  It has an ID of 17921.  The regular Arabic keyboard has an
// ID of 17920.  You'll need to decide if you will have to accommodate both regions.  It's
// entirely possible that the hardcoded mappings we've provided below could easily get out
// of synch with a system release -- we're sure it will happen! We could program around this
// (by adding a different LOCL resource specification which allowed mapping onto another LOCL)
// but since we're recommending using the Keyboard menu for switching localizations we've
// decided not to put in the effort.
// NOTE: These remappings are probably incomplete.  You may have to add new entries in the
// map.
// NOTE: This map would be far more useful if it gave ranges rather than specific values
// but it's not worth the effort right now.
// NOTE: For more information please refer to Inside Macintosh: Text, Appendix B - International
// Resources, About the International Resources, Script Codes and Resource ID Ranges.
// NOTE: Did we convince you not to use the keyboard menu for this purpose?
{
	ScriptCode		scriptCode = ::GetScriptManagerVariable(smKeyScript);
	RegionCode		regionCode = ::GetScriptVariable(scriptCode, smScriptKeys);

	if (sfUsingMultiLocale)
	{
		// Now do a possible remapping of the KCHR code to a different region code.
		std::map<RegionCode, RegionCode>	aKCHRToRegionMap;
		aKCHRToRegionMap[1111] = verFrance;
		aKCHRToRegionMap[16384] = verJapan;
		aKCHRToRegionMap[16385] = verJapan;
		aKCHRToRegionMap[16896] = verTaiwan;
		aKCHRToRegionMap[17408] = verKorea;
		aKCHRToRegionMap[17920] = verArabic;
		aKCHRToRegionMap[17921] = verArabic;
		aKCHRToRegionMap[18432] = verIsrael;
		aKCHRToRegionMap[18433] = verIsrael;
		aKCHRToRegionMap[19456] = verRussia;
		aKCHRToRegionMap[19518] = verUkrania;
		aKCHRToRegionMap[19520] = verUkrania;
		aKCHRToRegionMap[19528] = verBulgaria;
		aKCHRToRegionMap[19529] = verBulgaria;
		aKCHRToRegionMap[28672] = verChina;
		aKCHRToRegionMap[30762] = verPoland;
		aKCHRToRegionMap[30763] = verHungary;
		aKCHRToRegionMap[30776] = verCzech;
		aKCHRToRegionMap[30777] = verSlovak;
		std::map<RegionCode, RegionCode>::const_iterator	aKCHRToRegionMapIter = aKCHRToRegionMap.find(regionCode);
		if (aKCHRToRegionMapIter != aKCHRToRegionMap.end())
			regionCode = aKCHRToRegionMapIter->second;
	}
	
	return regionCode;
}

//----------------------------------------------------------------------------------------
// SetKeyRegionCode
//----------------------------------------------------------------------------------------

RegionCode CMultiLocale_AC::SetKeyRegionCode(RegionCode inRegionCode)
// SetKeyRegionCode sets the system keyboard mapping to the script indicated by the 
// given region code.
//
// inRegionCode:	The RegionCode for which the script code is retrieved and set for the
//					current system keyboard mapping.
{
	RegionCode		currentKeyRegionCode = GetKeyRegionCode();
#if qMSWindows
	#pragma unused (inRegionCode)
	#pragma message ("CMultiLocale_AC.cpp:SetKeyRegionCode: Need replacement strategy for KeyScript.")
#else
	if (currentKeyRegionCode != inRegionCode)		// Don't unnecessarily annoy the script mgr
	{
		ScriptCode		scriptCode = GetScriptFromRegion(inRegionCode);
		::SetScriptVariable(scriptCode, smScriptKeys, inRegionCode);
		::KeyScript(scriptCode);
	}
#endif
	return currentKeyRegionCode;
}

//----------------------------------------------------------------------------------------
// SetKeyScriptCode
//----------------------------------------------------------------------------------------

RegionCode CMultiLocale_AC::SetKeyScriptCode(ScriptCode inScriptCode)
// SetKeyScriptCode sets the system keyboard mapping to the script provided while returning
// the old keyboard script.
//
// inScriptCode:	The ScriptCode to set for the current system keyboard mapping.
{
	ScriptCode		currentScriptCode = GetScriptManagerVariable(smKeyScript);
#if qMSWindows
	#pragma unused (inScriptCode)
	#pragma message ("CMultiLocale_AC.cpp:SetKeyScriptCode: Need replacement strategy for KeyScript.")
#else
	if (currentScriptCode != inScriptCode)		// Don't unnecessarily annoy the script mgr 
		::KeyScript(inScriptCode);
#endif
	return currentScriptCode;
}

//----------------------------------------------------------------------------------------
// CMultiLocale_AC::RunTimeRegionCode
//----------------------------------------------------------------------------------------

RegionCode CMultiLocale_AC::RunTimeRegionCode(RegionCode inRegionCode)
// RunTimeRegionCode translates a region code into an actual region code.
//
// inRegionCode:	A RegionCode which can be a a real or a psuedo code.  There are three
//					psuedo codes.  kDefaultRegionCode will cause the sfDefaultRegionCode
//					to be returned.  kSystemRegion will cause the region for the application
//					font to be returned.  kKeyScriptRegion will cause the region for the
//					currently selected keyboard to be returned.  Otherwise, the inRegionCode
//					is returned.
{
	RegionCode returnVal = inRegionCode;

	if (returnVal == kDefaultRegionCode)
		returnVal = sfDefaultRegionCode;

	if (returnVal == kSystemRegion)
		returnVal = GetSystemRegionCode();
	else if (returnVal == kApplicationRegion)
		returnVal = GetApplicationRegionCode();
	else if (returnVal == kKeyScriptRegion)
		returnVal = GetKeyRegionCode();
		
	return returnVal;
}

//----------------------------------------------------------------------------------------
// CMultiLocale_AC::RunTimeFont
//----------------------------------------------------------------------------------------

Style CMultiLocale_AC::RunTimeFont(short& itsFontNumber, short& itsFontSize, RegionCode inDesiredRegion)
{
	ScriptCode itsScriptCode = GetScriptFromRegion(inDesiredRegion);

	if (itsFontNumber == systemFont || itsFontNumber == applFont)
	{
		unsigned long fondAndSize = static_cast<unsigned long>(::GetScriptVariable(itsScriptCode, itsFontNumber == systemFont ? smScriptSysFondSize : smScriptAppFondSize));
		itsFontNumber = static_cast<short>(fondAndSize >> 16);
		if (!itsFontSize)
			itsFontSize = static_cast<short>(fondAndSize & 0xFFFF); // return default info
	}

	return static_cast<Style>(::GetScriptVariable(itsScriptCode, smScriptValidStyles));
}

//----------------------------------------------------------------------------------------
// CMultiLocale_AC::InitCMultiLocal
//----------------------------------------------------------------------------------------

void CMultiLocale_AC::InitCMultiLocal()
// InitCMultiLocal performs the initialization of the MultiLocale environment for this
// application.  During initialization, the country code from the 'vers' 1 resource for
// the application is retrieved.  The various locale mapping resources (LMap) are pulled
// in the the localization table built.  Subsequent calls will return kSystemRegion which
// ultimately gets translated to the base system region.
// Note: You must call this function in order to enable multi-locale support in your
// application.  We suggest you call it prior to calling your application's Run() function.
//
// Call?		Always.  Call prior to calling your application's Run() function.
{
	if (!sfMultiLocaleInited)
	{
		sfMultiLocaleInited = true;

		// Retrieve our own vers 1 resource.
		VersRecHndl		versRec = reinterpret_cast<VersRecHndl>(::GetResource('vers', 1));
		if (versRec)
		{
			sfAppRegionCode = (*versRec)->countryCode;
			sfBaseRegionCode = sfAppRegionCode;			// Initially defaults to the application's region code.
		}
#if qDebugMsg
		else
			ProgramReport_AC("InitCMultiLocal: No vers (1) resource found for this application.\n");
#endif

		// Retrieve the System's vers 1 resource so we can get the default region.
		{
			CTempUseResFile_AC		tempUseResFile(kSystemResFile);
			versRec = reinterpret_cast<VersRecHndl>(::GetResource('vers', 1));
		}
		if (versRec)
			sfSysRegionCode = (*versRec)->countryCode;
#if qDebugMsg
		else
			ProgramReport_AC("InitCMultiLocal: No vers (1) resource found for this system.\n");
#endif

		// Iterate over each LOCL resource contained in the application resources and build
		// the locale mapping tables.
		short	localeCount = ::CountResources(LocaleResType);
		if (localeCount > 0)		// Short-circuit MultiLocale if no LMap resources.
		{
			sfUsingMultiLocale = true;
			
			// Read each LOCL resource and add to the locale list.
			for (short i = 1; i <= localeCount; ++i)
			{
				try
				{
					CMultiLocale_AC*	newLocale = TH_new CMultiLocale_AC(i);
					sfCLocaleList.push_back(newLocale);
					
					// Add locale to the region/locale map.
					sfRegionLocaleMap[newLocale->GetRegionCode()] = newLocale;
				}
				catch (...)
				{
#if qDebug
					// Indicate that an exception was found with the resource
					// but don't take the application down in the process.
					ProgramReport_AC("InitCMultiLocal: An error was encountered reading the 'LOCL'"
									 " resource with index %d.", i);
#endif
				}
			}
#if qDebug
			// Check to see if we found a base region.
			if (sfBaseRegionCode == kSystemRegion)
				ProgramReport_AC("InitCMultiLocal: No base region code was found in the 'LOCL' specifications.");
#endif
		}
	}
}

//----------------------------------------------------------------------------------------
// CMultiLocale_AC::AddResource
//----------------------------------------------------------------------------------------

void CMultiLocale_AC::AddResource(Handle theData, ResType theType, ResNumber inFromID, ConstStr255Param resName,
								  RegionCode inDesiredRegion)
// AddResource adds a new (or replaces an old) resource for the current region.  This means
// that the resource being added may not actually get added with the resource ID (inFromID)
// that has been supplied since it might get remapped.
// NOTE: The behavior of the remapping of the ID differs for adding resources than for
// retrieving resources since we only map to the exact region specified -- no attempt is
// made to work up the resource inheritance tree.
//
// theData:			A Handle containing the resource to be added.
// theType:			The ResType of the resource to be added.
// inFromID:		The base ResNumber of the resource to be added.  The resulting ID may
//					get remapped.
// resName:			The name of the resource as a ConstStr255Param.
// inDesiredRegion:	The RegionCode for which the resource is to be added.
{
	// Checks to see if the resource already exists and if so,
	// removes it and adds the new one.
	ResNumber	theMappedID = sfUsingMultiLocale
								? GetMappedResourceID(theType, inFromID, inDesiredRegion)
								: inFromID;
	Handle		existingResource = NULL;

	{
		ACS::CTempResLoad(false);
		existingResource = Get1Resource(theType, theMappedID, inDesiredRegion);
	}

	if (existingResource)
	{
		::RemoveResource(existingResource);
		existingResource = ::DisposeIfHandle_AC(existingResource);
	}
	
	::AddResource(theData, theType, theMappedID, resName);
}

//----------------------------------------------------------------------------------------
// CMultiLocale_AC::GetResource: 
//----------------------------------------------------------------------------------------

Handle CMultiLocale_AC::GetResource(ResType rType, ResNumber rID, RegionCode inDesiredRegion)
{
	Handle returnVal = NULL;

	if (rID != kNoResource_AC)
	{
		ResNumber	theMappedID = sfUsingMultiLocale
									? GetExistingResourceID(rType, rID, inDesiredRegion)
									: rID;
		returnVal = ::GetResource(rType, theMappedID);
	}
	
	return returnVal;
}

//----------------------------------------------------------------------------------------
// CMultiLocale_AC::Get1Resource: 
//----------------------------------------------------------------------------------------
Handle CMultiLocale_AC::Get1Resource(ResType rType, ResNumber rID, RegionCode inDesiredRegion)
{
	Handle returnVal = NULL;

	if (rID != kNoResource_AC)
	{
		ResNumber	theMappedID = sfUsingMultiLocale
									? GetExistingResourceID(rType, rID, inDesiredRegion, true)
									: rID;
		Handle h = ::Get1Resource(rType, theMappedID);
		
		returnVal = h ? h : ::Get1Resource(rType, rID);
	}
	
	return returnVal;
}

//----------------------------------------------------------------------------------------
// CMultiLocale_AC::GetReverseMappedResInfo: 
//----------------------------------------------------------------------------------------

void CMultiLocale_AC::GetReverseMappedResInfo(	Handle			theResource,
												ResNumber*		inFromID,
												ResType*		theType,
												Str255			resName,
												RegionCode		inDesiredRegion)
// GetReverseMappedResInfo retrieves the resource information for the resource contained in
// theResource by reverse mapping the resource ID.  This is done by scanning the resource
// mapping cache of the CMultiLocale_AC instance of the indicated region for a resource
// with the given ID and type.
// NOTE: The results of this operation may not be what you expect.  This is particularly true
// if you have mapped multiple resources to the same resource in your LOCL resources.  In this
// case the resource information returned will be for the _first_ cached resource matching the
// criteria.
// NOTE: The scanning for a match does not take a resource index into account.
//
// theResource:		The Handle pointing to the resource for which the resource information
//					is to be retrieved.
// inFromID:		A pointer to a ResNumber that will receive the actual reverse mapped
//					resource numer.
// theType:			A pointer to a ResType that will receive the resource type.
// resName:			A Str255 which will receive the name of the resource, if any.
// inDesiredRegion:	A RegionCode indicating for which region the resource was originally mapped.
{
	// Fetch the basic information about the resource which will be the mapped ID, type and
	// name.  We will keep the type, of course, but then we'll check the cache for the original
	// ID.
	::GetResInfo(theResource, inFromID, theType, resName);

	if (sfUsingMultiLocale)
	{	
		// Determine the CMultiLocale_AC for the given region.
		RegionCode		toActualRegionCode = RunTimeRegionCode(inDesiredRegion);
		if (toActualRegionCode != GetBaseRegionCode())
		{
			RegionLocaleMapIterator		aRegLocIter = sfRegionLocaleMap.find(toActualRegionCode);
			if (aRegLocIter != sfRegionLocaleMap.end())
			{
				CMultiLocale_AC*	aLocale(aRegLocIter->second);
				ResNumber			mappedResourceID = aLocale->ReverseMapIDAndType(*inFromID, *theType);
				if (mappedResourceID != kNoResource_AC)
					*inFromID = mappedResourceID;
			}
		}
	}
}

//----------------------------------------------------------------------------------------
// CMultiLocale_AC::SetResInfo: 
//----------------------------------------------------------------------------------------

void CMultiLocale_AC::SetResInfo(Handle theResource, ResNumber inFromID, ConstStr255Param resName,
							RegionCode inDesiredRegion)
{

	// retrieve the resource handle's type info for use in the GetExistingResourceID call
	ResType		theType;
	Str255		localName;
	ResNumber	localID;

	::GetResInfo(theResource, &localID, &theType, localName);
	ResNumber	theMappedID = sfUsingMultiLocale
								? GetExistingResourceID(theType, inFromID, inDesiredRegion)
								: inFromID;
	
	::SetResInfo(theResource, theMappedID, resName);
}

//----------------------------------------------------------------------------------------
// CMultiLocale_AC::RGetResource: 
//----------------------------------------------------------------------------------------

Handle CMultiLocale_AC::RGetResource(ResType theType, ResNumber inFromID, RegionCode inDesiredRegion)
{
	Handle returnVal = NULL;

	if (inFromID != kNoResource_AC)
	{
		ResNumber	theMappedID = sfUsingMultiLocale
									? GetExistingResourceID(theType, inFromID, inDesiredRegion)
									: inFromID;
#if qCarbon || qMSWindows
		// RGetResource is not in Carbon. GetResource should be good enough.
		returnVal = ::GetResource(theType, theMappedID);
#else
		returnVal = ::RGetResource(theType, theMappedID);
#endif
	}
	
	return returnVal;
}

//----------------------------------------------------------------------------------------
// CMultiLocale_AC::GetString: 
//----------------------------------------------------------------------------------------
StringHandle CMultiLocale_AC::GetString(ResNumber stringID, RegionCode inDesiredRegion)
{
	StringHandle	theStringHandle = NULL;
	if (stringID != kNoResource_AC)
	{
		ResNumber	theMappedID = sfUsingMultiLocale
									? GetExistingResourceID('STR ', stringID, inDesiredRegion)
									: stringID;
		theStringHandle = ::GetString(theMappedID);
	}
	return theStringHandle;
}

//----------------------------------------------------------------------------------------
// CMultiLocale_AC::GetIndString: 
//----------------------------------------------------------------------------------------
void CMultiLocale_AC::GetIndString(Str255 theString, ResNumber strListID, short index, RegionCode inDesiredRegion)
{
	theString[0] = 0;

	if (strListID != kNoResource_AC && index > 0)
	{
		ResIndexPair	resAndIndex(strListID, index);
		if (sfUsingMultiLocale)
			resAndIndex = GetExistingIndResourceID('STR#', strListID, index, inDesiredRegion);

		::GetIndString(theString, resAndIndex.first, resAndIndex.second);
	}
}

//----------------------------------------------------------------------------------------
// End of CMultiLocal_AC.cpp