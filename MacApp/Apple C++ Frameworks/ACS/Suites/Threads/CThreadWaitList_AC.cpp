//----------------------------------------------------------------------------------------
// CThreadWaitList_AC.cpp
// Copyright © 1996-2001 by Apple Computer, Inc. All rights reserved. 
//----------------------------------------------------------------------------------------

/*
	Change History
		04/07/01	[PB] Converting NULL to non-pointer type. 
		02/14/01	Eliminate dependencies on CDynamicArray_AC. 
		01/02/01	Update copyright.
		01/28/00	Initial version. 
*/

#ifndef __CThreadWaitList_AC__
#include "CThreadWaitList_AC.h"
#endif

// ACS

#ifndef __CThreadTimeout_AC__
#include "CThreadTimeout_AC.h"
#endif


//========================================================================================
// CThreadWaitList_AC
//========================================================================================

//----------------------------------------------------------------------------------------
// Constructor
//----------------------------------------------------------------------------------------

CThreadWaitList_AC::CThreadWaitList_AC(ArrayIndex initialSize)
	:	CThreadList_AC(initialSize),
		fHolder(kNoThreadID),
		fDeleted(false)
{
}

//----------------------------------------------------------------------------------------
// Destructor
//----------------------------------------------------------------------------------------

CThreadWaitList_AC::~CThreadWaitList_AC()
{
	ThreadBeginCritical();

	fHolder = kNoThreadID;
	fDeleted = true;
	while (GetSize() > 0)
	{
		ThreadID top = Pop();
		SetThreadStateEndCritical(top, kReadyThreadState, kCurrentThreadID);
		ThreadBeginCritical();
	}

	ThreadEndCritical();
}

//----------------------------------------------------------------------------------------
// Wait
//----------------------------------------------------------------------------------------

OSStatus CThreadWaitList_AC::Wait(Duration timeout)
{
	OSStatus err = noErr;
	
	ThreadBeginCritical();

	if (timeout > 0)
	{
		// Add our thread to the queue
		ThreadID current = kNoThreadID;
		MacGetCurrentThread(&current);

		InsertLast(current);

		// Start a watchdog timer
		CThreadTimeout_AC timer(timeout);

		// Wait until it's our turn, or we run out of time,
		// or the queue is deleted. 
		do
		{
			// Put ourselves to sleep
			SetThreadStateEndCritical(kCurrentThreadID, kStoppedThreadState, fHolder);

			// We're back, make sure we won't be interrupted
			ThreadBeginCritical();

			// If we woke up because the timer went off, give up
			if (timer.Fired())
			{
				err = kMPTimeoutErr;
				break;
			}
			
			// If the semaphore is gone, give up
			if (fDeleted)
			{
				err = kMPDeletedErr;
				break;
			}
		}
		while (fHolder != current);

		// Make really sure we're no longer in the queue. 
		if (fHolder != current)
			Delete(current);
	}
	
	ThreadEndCritical();

	return err;
}


//----------------------------------------------------------------------------------------
// End of CThreadWaitList_AC.cpp