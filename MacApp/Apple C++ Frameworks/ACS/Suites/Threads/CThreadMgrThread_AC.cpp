//----------------------------------------------------------------------------------------
// CThreadMgrThread_AC.cpp
// Copyright © 1996-2001 by Apple Computer, Inc. All rights reserved. 
//----------------------------------------------------------------------------------------

/*
	Change History:
		08/14/01	Scope stdio definitions because cstdio is getting included first. 
		02/28/01	[W] Use DEFINE_API instead of pascal for thread entry. 
		01/02/01	Update copyright.
		05/23/00	[2279264] Rename buffer-oriented calls to ProgramBreakText
					and ProgramReportText so as to eliminate all possible ambiguity. 
		05/17/00	Changed Suspend and Resume to skip over dead threads. 
					Don't yield to a dead thread. 
					Warn if an active thread is destroyed. 
					Change IsAlive to detect errors besides threadNotFoundErr. 
		05/15/00	CW Pro 6: ambiguous ProgramBreak and ProgramReport overloads. 
					Switch the order of the arguments for the buffer-oriented calls. 
		04/14/00	Use a thread handle in the thread proc so the thread will be
					deleted if nothing else references it when it finishes. 
					Don't post an exception if the thread already has one. 
					Fill in code in GetResult to wait for the thread to finish. 
		03/23/00	Use reinterpret_cast instead of static_cast in GetResult.
					DebugThrowError_AC only available for qDebugExceptions in DebugFailIf.
		02/15/00	Add ProgramBreak and FailIf functions. 
		02/08/00	Add CurrentTaskRef and YieldTo. 
					Initialize fTaskRef (oops). 
					Change Resume to use SetThreadStateEndCritical instead of
					SetThreadReadyGivenTaskRef. This means Resume can't be called
					from interrupt level code without setting up the A5 world,
					but that probably wasn't possible anyway. The new version
					is more efficient and doesn't depend on fTaskRef. 
					Post any exceptions that we can catch from the thread. 
					Set the thread's done flag even if it had an exception. 
		02/07/00	Merge context completely into thread. 
		02/03/00	Carbon: Fix includes. 
		02/03/00	Carbon: Need UPP for thread entry. 
		02/01/00	New implementation. 
		05/19/99	Remove StartRoutine and parameter from Start. 
					Add Run method. 
					Make IsAlive, GetRefCount and GetThread const. 
					Move fDone flag to here from the subclasses. 
		03/24/99	Update copyright notice.
		12/07/98	Fix up ProgramBreak_AC.
		10/06/98	Clean up includes. 
*/

#ifndef __CThreadMgrThread_AC__
#include "CThreadMgrThread_AC.h"
#endif

// ACS

#ifndef __CTimerTask_AC__
#include "CTimerTask_AC.h"
#endif

#ifndef __CReporter_AC__
#include "CReporter_AC.h"
#endif

#ifndef __CThreadRunner_AC__
#include "CThreadRunner_AC.h"
#endif

// Toolbox

// ANSI

#ifndef _STDARG_H
#include <stdarg.h>
#endif

#ifndef _STDIO_H
#include <stdio.h>
#endif


using std::vsprintf;

//========================================================================================
// CThreadMgrThread_AC
//========================================================================================

//----------------------------------------------------------------------------------------
// Constructor
//----------------------------------------------------------------------------------------

CThreadMgrThread_AC::CThreadMgrThread_AC()
	:	CThread_AC(),
		fTaskRef(CurrentTaskRef()),
		fThreadID(kNoThreadID),
		fResume(false),
		fResult(0)
{
}

//----------------------------------------------------------------------------------------
// Copy constructor
//----------------------------------------------------------------------------------------

CThreadMgrThread_AC::CThreadMgrThread_AC(const CThreadMgrThread_AC& source)
	:	CThread_AC(source),
		fTaskRef(CurrentTaskRef()),
		fThreadID(kNoThreadID),
		fResume(false),
		fResult(0)
{
}

//----------------------------------------------------------------------------------------
// Destructor
//----------------------------------------------------------------------------------------

CThreadMgrThread_AC::~CThreadMgrThread_AC()
{
	Warning_AC(fThreadID == kNoThreadID, "Destroying an active thread");
}

//----------------------------------------------------------------------------------------
// Start
//----------------------------------------------------------------------------------------

CThread_AC* CThreadMgrThread_AC::Start()
{
	return Start(kCooperativeThread);
}

//----------------------------------------------------------------------------------------
// Start
//----------------------------------------------------------------------------------------

CThread_AC* CThreadMgrThread_AC::Start(ThreadStyle threadStyle)
{
	if (fThreadID == kNoThreadID)
	{
#if qCarbon
		static ThreadEntryTPP threadEntry;
		if (!threadEntry)
			threadEntry = NewThreadEntryUPP(EntryPoint);

		ThrowIfOSErr_AC(NewThread(threadStyle, threadEntry, this, GetStackSize(),
								  GetThreadOptions(), &fResult, &fThreadID));
#else
		ThrowIfOSErr_AC(NewThread(threadStyle, EntryPoint, this, GetStackSize(),
								  GetThreadOptions(), &fResult, &fThreadID));
#endif
	}

	return this;
}

//----------------------------------------------------------------------------------------
// CThreadMgrThread_AC::GetThreadOptions
//----------------------------------------------------------------------------------------

ThreadOptions CThreadMgrThread_AC::GetThreadOptions() const
{
	ThreadOptions options = 0;
	if (CreateSuspended())
		options |= kNewSuspend;

	return options;
}

//----------------------------------------------------------------------------------------
// IsAlive
//----------------------------------------------------------------------------------------

bool CThreadMgrThread_AC::IsAlive() const
{
	bool isAlive = false;

	ThreadBeginCritical();

	if ((!fDone) && (fThreadID != kNoThreadID))
	{
		ThreadState state;
		OSErr err = GetThreadState(fThreadID, &state);
		if (err == noErr)
			isAlive = true;
	}

	ThreadEndCritical();

	return isAlive;
}

//----------------------------------------------------------------------------------------
// IsCurrent
//----------------------------------------------------------------------------------------

bool CThreadMgrThread_AC::IsCurrent() const
{
	return (fThreadID != kNoThreadID) && (fThreadID == Current());
}

//----------------------------------------------------------------------------------------
// Current
//----------------------------------------------------------------------------------------

ThreadID CThreadMgrThread_AC::Current()
{
	ThreadID current = kNoThreadID;
	ThrowIfOSErr_AC(MacGetCurrentThread(&current));
	return current;
}

//----------------------------------------------------------------------------------------
// CurrentTaskRef
//----------------------------------------------------------------------------------------

ThreadTaskRef CThreadMgrThread_AC::CurrentTaskRef()
{
	ThreadTaskRef current = NULL;
	ThrowIfOSErr_AC(GetThreadCurrentTaskRef(&current));
	return current;
}

//----------------------------------------------------------------------------------------
// Yield
//----------------------------------------------------------------------------------------

void CThreadMgrThread_AC::Yield()
{
	ThrowIfOSErr_AC(YieldToAnyThread());
}

//----------------------------------------------------------------------------------------
// YieldTo
//----------------------------------------------------------------------------------------

void CThreadMgrThread_AC::YieldTo(ThreadID suggestedThread)
{
	if (suggestedThread == kNoThreadID)
		suggestedThread = fThreadID;

	if (suggestedThread != kNoThreadID)
		ThrowIfOSErr_AC(YieldToThread(suggestedThread));
	else
		Yield();
}

//----------------------------------------------------------------------------------------
// Suspend
//----------------------------------------------------------------------------------------

void CThreadMgrThread_AC::Suspend()
{
	if (fThreadID != kNoThreadID)
	{
		OSErr err = ::ThreadBeginCritical();
		fResume = false;
		do
		{
			err = SetThreadStateEndCritical(fThreadID, kStoppedThreadState, kNoThreadID);
			err = ThreadBeginCritical();
		}
		while (!fResume);
		err = ThreadEndCritical();
	}
}

//----------------------------------------------------------------------------------------
// Resume
//----------------------------------------------------------------------------------------

void CThreadMgrThread_AC::Resume()
{
	if (fThreadID != kNoThreadID)
	{
		OSErr err = ThreadBeginCritical();
		fResume = true;
		err = SetThreadStateEndCritical(fThreadID, kReadyThreadState, fThreadID);
	}
}

//----------------------------------------------------------------------------------------
// Join
//----------------------------------------------------------------------------------------

void CThreadMgrThread_AC::Join()
{
	RequestShutdown();
	if (!IsCurrent())
	{
		while (IsAlive())
			YieldTo();
	}
}

//----------------------------------------------------------------------------------------
// GetResult
//----------------------------------------------------------------------------------------

OSStatus CThreadMgrThread_AC::GetResult(Duration timeout)
{
	OSStatus result = kMPTimeoutErr;

	if ((timeout > 0) && IsAlive() && !IsCurrent())
	{
		CSimpleTimer_AC timer(timeout);
		do
		{
			YieldToAnyThread();
		}
		while (IsAlive() && !timer.Fired());
	}

	if (!IsAlive())
		result = reinterpret_cast<OSStatus>(fResult);

	return result;
}

#if qDebug

//----------------------------------------------------------------------------------------
// DebugFailIf
//----------------------------------------------------------------------------------------

void CThreadMgrThread_AC::DebugFailIf(OSStatus status, const char* inFile, short inLine)
{
	if (status != noErr)
#if qDebugExceptions
		DebugThrowError_AC(status, inFile, inLine);
#else
		ThrowError_AC(status);
#endif
}

#else

//----------------------------------------------------------------------------------------
// FailIf
//----------------------------------------------------------------------------------------

void CThreadMgrThread_AC::FailIf(OSStatus status)
{
	if (status != noErr)
		ThrowError_AC(static_cast<OSErr>(status));
}

#endif // qDebug

//----------------------------------------------------------------------------------------
// ProgramBreak
//----------------------------------------------------------------------------------------

void CThreadMgrThread_AC::ProgramBreak(ConstStr255Param msg)
{
	ProgramBreak_AC(msg);
}

//----------------------------------------------------------------------------------------
// ProgramBreak
//----------------------------------------------------------------------------------------

void CThreadMgrThread_AC::ProgramBreak(const char* format, ...)
{
	va_list args;
	va_start(args, format);
	ProgramBreak(format, args);
}

//----------------------------------------------------------------------------------------
// ProgramBreak
//----------------------------------------------------------------------------------------

void CThreadMgrThread_AC::ProgramBreak(const char* format, va_list args)
{
	char buffer[256];
	int len = vsprintf(buffer, format, args);
	ProgramBreakText_AC(len, buffer);
}

//----------------------------------------------------------------------------------------
// EntryPoint
//----------------------------------------------------------------------------------------

DEFINE_API(void*) CThreadMgrThread_AC::EntryPoint(void* parameter)
{
	CThreadMgrThread_AC* thread = static_cast<CThreadMgrThread_AC*>(parameter);
	CThreadHandle_AC threadHandle(thread);

	try
	{
		thread->Run();
	}
	catch (CException_AC& fi)
	{
		thread->PostException(fi.GetError(), fi.GetExceptionMessage());
		// Do not allow any exceptions to propagate into the Thread Manager
	}
	catch (...)
	{
		if (!thread->fHasException)
			thread->PostException(minErr, 0);
		// Do not allow any exceptions to propagate into the Thread Manager
	}

	thread->fDone = true;
	thread->fThreadID = kNoThreadID;

	return NULL;
}


//----------------------------------------------------------------------------------------
// End of CThreadMgrThread_AC.cpp
