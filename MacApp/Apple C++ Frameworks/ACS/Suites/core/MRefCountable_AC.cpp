//----------------------------------------------------------------------------------------
// MRefCountable_AC.cpp
// Copyright © 1985-2001 by Apple Computer, Inc. All rights reserved.
//----------------------------------------------------------------------------------------

/*
	Change History
		03/01/01	Cosmetic. 
		01/02/01	Update copyright.
		05/21/99	Make some MRefCountable_AC functions non-inline. 
*/

#ifndef __MRefCountable_AC__
#include "MRefCountable_AC.h"
#endif

#ifndef __CAssertionFailure_AC__
#include "CAssertionFailure_AC.h"
#endif


//========================================================================================
// class MRefCountable_AC
//========================================================================================

//----------------------------------------------------------------------------------------
// implementation
//----------------------------------------------------------------------------------------

#if qCoreDebug
MRefCountable_AC::~MRefCountable_AC()
{
	if(fRefCountable)
		Assertion_AC((fDeleting && fRefCount == 0), "Deleting Object with Valid RefCount.");
	else
		Warning_AC(fRefCount == 0, "Deleting unrefcountable object with refcounts.");
}
#endif // qCoreDebug

void MRefCountable_AC::AcquireObject(MRefCountable_AC* inCountable)
{
	if(inCountable)
	{
		inCountable->fDeleting = false;
		inCountable->IncrementRefCount();
	}
}

void MRefCountable_AC::ReleaseObject(MRefCountable_AC* inCountable)
{
	if(	inCountable &&
		(inCountable->fDeleting == false) &&
		inCountable->DecrementRefCount() &&
		inCountable->IsRefCountable() )
	{
		inCountable->fDeleting = true;
		delete inCountable;
	}	
}

#if qCoreDebug
void MRefCountable_AC::IncrementRefCount()
{ 	
	if(!fDeleting)
		++fRefCount;

	BreakIfTrackedObject(this, "MRefCountable_AC::IncrementRefCount. RefCount = %ld", fRefCount);
}

bool MRefCountable_AC::DecrementRefCount()
{ 	
	if(!fDeleting)
		--fRefCount;

	BreakIfTrackedObject(this, "MRefCountable_AC::DecrementRefCount. RefCount = %ld", fRefCount);

	return fRefCount == 0;
}

bool MRefCountable_AC::PerformConditionalTest()
{
	return GetUserValue() == 0 ? true : GetUserValue() == fRefCount;
}
#endif // qCoreDebug


//----------------------------------------------------------------------------------------
// End of MRefCountable_AC.cpp