//----------------------------------------------------------------------------------------
// dout_AC.cpp
// Copyright © 1985-2001 by Apple Computer, Inc. All rights reserved.
//----------------------------------------------------------------------------------------

/*
	Change History
		02/28/01	[W] Include Windows header. 
		01/02/01	Update copyright.
		11/09/00	[PB] Change initialization order to match declaration. 
		09/20/00	Allow function-try-block in CDebugStrStream_AC ctor.  Removed
					conditional on ';g'.  Initialize QTML when debugging and
					include QTML.h.
		02/22/00	Implement only if qCodeDebug to match header.
		07/22/99	[C] Minor debug string output modifications.
		03/24/99	Update copyright notice.
		12/26/98	[W] Don't include MissingDefinitions.h, test qDebug.
		10/27/98	Still need to suppress ;g as of CW Pro 4. 
		10/06/98	Clean up includes. 
*/

#ifndef __dout_AC__
#include "dout_AC.h"
#endif

#if qCoreDebug

// ACS

#ifndef __CBuffer_AC__
#include "CBuffer_AC.h"
#endif

#ifndef __CBufferedStreamRep_AC__
#include "CBufferedStreamRep_AC.h"
#endif

#ifndef __Debug_AC__
#include "Debug_AC.h"
#endif

// QTML

#if qMSWindows
	#ifndef __QTML__
	#include <QTML.h>
	#endif
#endif

// Toolbox

#ifndef __TEXTUTILS__
#include <TextUtils.h>
#endif

// Windows

#if qMSWindows
	#ifndef _WINDOWS_
	#include <Windows.h>
	#endif
#endif

// ANSI

#ifndef _STRING
#include <string.h>
#endif

#define kLineSize_AC 		85
#define kBufferSize_AC 		kLineSize_AC * 3


//----------------------------------------------------------------------------------------
// class CDebugStrStreamRep_AC
//----------------------------------------------------------------------------------------

class CDebugStrStreamRep_AC : public CBufferedStreamRep_AC
{
public:
	CDebugStrStreamRep_AC()
		:CBufferedStreamRep_AC(kBufferSize_AC)
	{	fWorkBuffer = TH_new CBuffer_AC(kBufferSize_AC+3); }
	virtual ~CDebugStrStreamRep_AC()
	{}
	
protected:
	virtual void WriteBufferedBytes(const void*, long amt);
	virtual void ReadBufferedBytes(void*, long) {}
	
protected:
	CBufferPtr_AC		fWorkBuffer;

};

CDebugStrStream_AC dout;


//----------------------------------------------------------------------------------------
// IsReturnChar
//----------------------------------------------------------------------------------------

inline bool IsReturnChar(char inChar)
{
	return inChar == '\n' || inChar == '\r';
}


//----------------------------------------------------------------------------------------
// CDebugStrStreamRep_AC
//----------------------------------------------------------------------------------------

void CDebugStrStreamRep_AC::WriteBufferedBytes(const void* bytes, long inAmt)
{	
	char* str = fWorkBuffer->GetBuffer();
	
#if qCoreDebug
	Erase_AC(str, kLineSize_AC*2);
#endif
	
	const char* buffer = static_cast<const char*>(bytes);
		// the string to send to DebugStr
		
	short bufferIndex = 0;
		// for copying into our work string
	
	short strIndex = -1;
		// the index into our tempStr
	short linePos = -1;
	
	long tally = 0;
	
	while(tally < inAmt)
	{
		bool insertedReturn = false;
	
		if( (++linePos == kLineSize_AC) && (bufferIndex != inAmt-1))
		{
			str[++strIndex] = '\r';
			linePos = -1;
			insertedReturn = true;
		}
	
		if( IsReturnChar(buffer[bufferIndex]) || bufferIndex == (fWorkBuffer->GetSize() - 1))
		{
			// We've found a '\n' in the buffer or our workbuffer is full.
			
			if(bufferIndex != inAmt-1) 
			{
				// if not the last char and didn't already insert one above
				if(!insertedReturn) str[++strIndex] = '\r';
				linePos = -1;
			}
			else
			{
				str[++strIndex] = ';';
				str[++strIndex] = 'g';
				str[++strIndex] = '\0'; 
				
#if qCarbon
				Str255 pString;
				CopyCStringToPascal(str, pString);
				::DebugStr(pString); 
#else
				::c2pstr(str);


#if qTheDebugger
			if (gExtDbgr_Info.isBeingDebugged || TheDbgr_IsInstalled())
				::SysBreakFunc(reinterpret_cast<StringPtr>(str));
			else		
#endif
				::DebugStr(reinterpret_cast<StringPtr>(str)); 
#endif
		
				strIndex = -1;
				// reset the strIndex to the start
				linePos = -1;
				
				bufferIndex = 0;
			
			}

		}
		else
		{
			str[++strIndex] = buffer[bufferIndex];
				// copy char into or work buffer.
		}
		
		++bufferIndex;
			// increment index into buffer.
		++tally;
			// keep track of how much we've snagged.
	}

	if(strIndex > -1)
	{
		// if we have chars in string ready to output, then
		// we need to do a DebugStr.
	
		str[++strIndex] = '\0'; 

#if qCarbon
		Str255 pString;
		CopyCStringToPascal(str, pString);
		::DebugStr(pString); 
#else
		::c2pstr(str);

#if qTheDebugger
	if (gExtDbgr_Info.isBeingDebugged || TheDbgr_IsInstalled())
		::SysBreakStr(reinterpret_cast<StringPtr>(str));
	else		
#endif
		::DebugStr(reinterpret_cast<StringPtr>(str)); 
#endif
	}
}


//----------------------------------------------------------------------------------------
// CDebugStrStream_AC::CDebugStrStream_AC
//----------------------------------------------------------------------------------------

CDebugStrStream_AC::CDebugStrStream_AC()
try
	:	CCharOutputSink_AC(TH_new CDebugStrStreamRep_AC),
		fUsable(false)
{
#if qMSWindows && qCoreDebug
	// Initialize QTML for qCoreDebug otherwise, this
	// will be done in InitToolBox.
	OSErr err = InitializeQTML(0);
	if (err != noErr)
		::MessageBox(HWND_DESKTOP, "QuickTime could not be initialized.  Be sure QuickTime for Windows 4.0 or later is installed on this computer.", "Error", MB_OK+MB_ICONINFORMATION);
	else
#endif
		fUsable = true;
}
catch(...)
{
	#if qDebugMsg
		DebugStr("\pCDebugStrStream_AC::CDebugStrStream_AC: Constructor failed.");
	#endif
}


//----------------------------------------------------------------------------------------
// CDebugStrStream_AC::~CDebugStrStream_AC
//----------------------------------------------------------------------------------------

CDebugStrStream_AC::~CDebugStrStream_AC()
{
	fUsable = false;
}

#endif	// qCoreDebug

//----------------------------------------------------------------------------------------
// End of dout_AC.cpp