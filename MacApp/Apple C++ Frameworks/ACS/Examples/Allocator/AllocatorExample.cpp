/*
	Simple CFAllocator example program, demonstrating creation and use of custom CFAllocators.
	Author: Ali Ozer
	7/7/99

	Copyright (c) 1999-2001 by Apple Computer, Inc., all rights reserved.

	You may incorporate this sample code into your applications without
	restriction, though the sample code has been provided "AS IS" and the
	responsibility for its operation is 100% yours. However, what you are
	not permitted to do is to redistribute the source as "DSC Sample Code"
	after having made changes. If you're going to re-distribute the source,
	we require that you make it clear in the source that the code was
	descended from Apple Sample Code, but that you've made changes.
*/

/*
	Change History:
		02/27/01	Redesign so CF references point to CF objects. 
		01/18/01	Moved into ACS. 
		07/13/00	Convenience constructors for auto-pointers. 
		07/12/00	Use Carbon++ classes. 
*/

// CarbonPlus

#include "CCFAllocator_AC.h"
#include "CCFData_AC.h"
#include "CCFString_AC.h"

// ANSI

#include <stddef.h>
#include <stdio.h>
#include <stdlib.h>
#include <string.h>


// This function will print the provided arguments (printf style varargs) out to the console.
// Note that the CFString formatting function accepts "%@" as a way to display CF types.
// For types other than CFString and CFNumber, the result of %@ is mostly for debugging
// and can differ between releases and different platforms.

static void show(CFStringRef formatString, ...)
{
	va_list argList;
	va_start(argList, formatString);
	CAutoCFString_AC resultString(__CFString::CreateWithFormatAndArguments(NULL, NULL, formatString, argList));
	va_end(argList);

	CAutoCFData_AC data(resultString->CreateExternalRepresentation(NULL, '?'));
	if (data != NULL)
	{
		printf ("%.*s\n\n", (int)data->GetLength(), data->GetBytePtr());
	}
}


// "Counting" Allocator
// A simple custom allocator that will count memory allocations and place guards to check memory corruption.

static void verifyMemory(int *ptr)
{
	int size = ptr[0];
	if (ptr[1] != 0x42424242) abort();
	if (ptr[2 + size / sizeof(int)] != 0x42424242) abort();
	if (ptr[2 + size / sizeof(int) + 1] != 0x42424242) abort();
	if (ptr[2 + size / sizeof(int) + 2] != 0x42424242) abort();
	if (ptr[2 + size / sizeof(int) + 3] != 0x42424242) abort();
}

static void *countingRealloc(void *oPtr, CFIndex size, CFOptionFlags hint, void *info)
{
#pragma unused (hint, info)

	int *ptr = (int *) oPtr;

	// Round it up to int alignment.
	size = ((size + sizeof(int) - 1) / sizeof(int)) * sizeof(int);

	if (ptr)
	{
		ptr = ptr - 2;	// Get back to the the originally allocated piece
		verifyMemory(ptr);
		ptr = (int *) realloc(ptr, size + sizeof(int) * 6);
	}
	else
	{
		ptr = (int *) malloc(size + sizeof(int) * 6);
	}
	ptr[0] = size;	// Doesn't include the guards
	ptr[1] = 0x42424242;
	ptr[2 + size / sizeof(int)] = 0x42424242;
	ptr[2 + size / sizeof(int) + 1] = 0x42424242;
	ptr[2 + size / sizeof(int) + 2] = 0x42424242;
	ptr[2 + size / sizeof(int) + 3] = 0x42424242;

	return (void *)(ptr + 2);
}

static void *countingAlloc(CFIndex size, CFOptionFlags hint, void *info)
{
	(*(int *)info)++;		// Increment count
	return countingRealloc(NULL, size, hint, info);
}

static void countingDealloc(void *ptr, void *info)
{
	(*(int *)info)--;		// Decrement count
	ptr = (int *)ptr - 2;	// Restore pointer to the actual malloc block
	verifyMemory((int *) ptr);
	free(ptr);
}

// Returns info about the number of outstanding allocations

static CFIndex NumOutstandingAllocations(CFAllocatorRef alloc)
{
	CFAllocatorContext context;
	context.version = 0;
	CFAllocatorGetContext(alloc, &context);
	return (*(int *)(context.info));
}

// Creates a "counting allocator" --- keeps track of number of
// outstanding allocations and also uses guards to catch out of bound writes

static CFAllocatorRef CreateCountingAllocator(CFAllocatorRef alloc)
{
	CFAllocatorContext context = {0, NULL, NULL, (void (*)(const void *))free, NULL, countingAlloc, countingRealloc, countingDealloc, NULL};
	context.info = malloc(sizeof(int));
	// The info field points to an int which keeps number of allocations/deallocations
	// The "free" in slot 3 of the context assures the info field is properly freed when the allocator is
	*(int *)(context.info) = 0;
	// Create and return the allocator
	return CFAllocatorCreate(alloc, &context);
}



// "Reduced Malloc" Allocator
// A simple custom allocator that tries to avoid allocations.
// This allocator will allocate one chunk of memory containing n blocks of a certain size each,
// and manage these as the memory pool. If larger requests or more requests come in, this
// allocator will fall back on allocating actual memory.
// Note: This allocator isn't that great; it's provided as sample code only.

// This struct holds the actual blocks for the memory plus the necessary info
// (The allocated size of this struct will depend on the desired number of blocks)

struct rmInfo
{
	CFAllocatorRef allocator;
	CFIndex size;
	CFIndex numBlocks;
	CFIndex firstAvailable;
	CFIndex numAdditionalAllocations;	// Stats for finding out how much addt'l memory was allocated
	void *mem[0];
};

// This function is used to free the above structure when the allocator is deallocated

static void rmInfoFree(const void *actualInfo)
{
	rmInfo *info = (rmInfo *)actualInfo;
	CFAllocatorRef allocator = info->allocator;
	CFAllocatorDeallocate(allocator, info);
	CFRelease(allocator);
}

#define rmNextBlockNum(info, blockNum) *(int *)(((unsigned char *)&(info->mem)) + (blockNum * info->size))
// #define rmBlock(info, blockNum) ((&(info->mem)) + (blockNum * info->size))
#define rmBlock(info, blockNum) (((unsigned char *)&(info->mem)) + (blockNum * info->size))
#define rmBlockNumber(info, ptr) (((unsigned char *)ptr - (unsigned char *)rmBlock(info, 0)) / info->size)
#define isRMBlock(info, ptr) (ptr >= (void *)rmBlock(info, 0) && ptr <= (void *)rmBlock(info, info->numBlocks))

static void rmMarkBlockAsAvailable(rmInfo *info, CFIndex blockNum)
{
	// Put this block at the head of the available list
	rmNextBlockNum(info, blockNum) = info->firstAvailable;
	info->firstAvailable = blockNum;
}

static void rmMarkFirstAvailableAsUnavailable(rmInfo *info)
{
	// This will only happen for the first block, so take it off the free list and return
	info->firstAvailable = rmNextBlockNum(info, info->firstAvailable);
}

// The function pointers for the allocator context

static void *rmRealloc(void *oPtr, CFIndex size, CFOptionFlags hint, void *actualInfo)
{
	rmInfo *info = (rmInfo *)actualInfo;
	if (isRMBlock(info, oPtr))
	{
		void *ptr;
		if (size <= info->size) return oPtr;	// Easy case...
		ptr = CFAllocatorAllocate(info->allocator, size, hint);
		memmove(ptr, oPtr, info->size);
		rmMarkBlockAsAvailable(info, rmBlockNumber(info, oPtr));
		info->numAdditionalAllocations++;
		return ptr;
	}
	else
	{
		return CFAllocatorReallocate(info->allocator, oPtr, size, hint);
	}
}

static void *rmAlloc(CFIndex size, CFOptionFlags hint, void *actualInfo)
{
	rmInfo *info = (rmInfo *)actualInfo;
	if ((info->firstAvailable == -1) || (size > info->size))
	{
		// No more available; allocate addt'l memory
		info->numAdditionalAllocations++;
		return CFAllocatorAllocate(info->allocator, size, hint);
	}
	else
	{
	void *ptr = rmBlock(info, info->firstAvailable);
	rmMarkFirstAvailableAsUnavailable(info);
		return ptr;
	}
}

static void rmDealloc(void *ptr, void *actualInfo)
{
	rmInfo *info = (rmInfo *)actualInfo;
	if (isRMBlock(info, ptr))
	{
		// It is one of ours, so mark it as available
		rmMarkBlockAsAvailable(info, rmBlockNumber(info, ptr));
	}
	else
	{
		// It is not, so directly deallocate
		info->numAdditionalAllocations--;
		CFAllocatorDeallocate(info->allocator, ptr);
	}
}

static CFIndex NumAdditionalAllocations(CFAllocatorRef alloc)
{
	CFAllocatorContext context;
	context.version = 0;
	CFAllocatorGetContext(alloc, &context);
	return ((rmInfo *)(context.info))->numAdditionalAllocations;
}

// Creates a "reduced malloc allocator".

static CFAllocatorRef CreateReducedMallocAllocator(CFAllocatorRef alloc, CFIndex size, CFIndex numBlocks)
{
	CFIndex cnt;
	rmInfo *info;
	CFAllocatorContext context = {0, NULL, NULL, rmInfoFree, NULL, rmAlloc, rmRealloc, rmDealloc, NULL};

	// Create and initialize the info block and the memory
	info = (rmInfo *) CFAllocatorAllocate(alloc, (sizeof(rmInfo) + size * numBlocks), 0);
	info->size = size;
	info->numBlocks = numBlocks;
	info->firstAvailable = -1;
	info->numAdditionalAllocations = 0;
	for (cnt = 0; cnt < numBlocks; cnt++) rmMarkBlockAsAvailable(info, cnt);
	// Retain the allocator used to allocate the memory
	info->allocator = (CFAllocatorRef) (alloc ? CFRetain(alloc) : CFRetain(CFAllocatorGetDefault()));
	// And hang on to the info block
	context.info = info;
	// Finally, create and return the allocator
	return CFAllocatorCreate(alloc, &context);
}



// Now some example code which uses these allocators

static void countingAllocatorExample()
{
	show(CFSTR("Counting Allocator Test"));

	CFAllocatorRef countingAllocator = CreateCountingAllocator(NULL);

	show(CFSTR("At start, number of allocations: %d"), NumOutstandingAllocations(countingAllocator));

	CFStringRef str1(__CFString::CreateWithCString(countingAllocator, "Hello World", kCFStringEncodingASCII));
	CFStringRef str2(__CFString::CreateWithPascalString(countingAllocator, "\pHello World", kCFStringEncodingASCII));
	CFMutableStringRef mStr(__CFString::CreateMutableCopy(countingAllocator, 0, str1));
	CFStringRef str3(__CFString::CreateCopy(countingAllocator, mStr));

	show(CFSTR("After creation, number of allocations: %d"), NumOutstandingAllocations(countingAllocator));

	mStr->Append(str1);
	mStr->Append(str1);
	mStr->Append(str1);

	show(CFSTR("After mutations, number of allocations: %d"), NumOutstandingAllocations(countingAllocator));

	str1->Release();
	str2->Release();
	mStr->Release();
	str3->Release();

	show(CFSTR("After releasing, number of allocations: %d"), NumOutstandingAllocations(countingAllocator));

	CFRelease(countingAllocator);
}


static void reducedMallocAllocatorExample()
{
	show(CFSTR("Reduced Malloc Allocator Test"));

	// Create a reduced memory allocator; have it start with 3 blocks of 40 bytes each.

	CFAllocatorRef reducedMallocAllocator = CreateReducedMallocAllocator(NULL, 40, 3);

	show(CFSTR("At start, number of addt'l allocations: %d"), NumAdditionalAllocations(reducedMallocAllocator));

	CFStringRef str1(__CFString::CreateWithCString(reducedMallocAllocator, "Hello World", kCFStringEncodingASCII));
	CFStringRef str2(__CFString::CreateWithPascalString(reducedMallocAllocator, "\pHello World", kCFStringEncodingASCII));
	CFMutableStringRef mStr(__CFString::CreateMutableCopy(reducedMallocAllocator, 0, str1));
	CFStringRef str3(__CFString::CreateCopy(reducedMallocAllocator, mStr));

	show(CFSTR("After creation, number of addt'l allocations: %d"), NumAdditionalAllocations(reducedMallocAllocator));

	mStr->Append(str1);
	mStr->Append(str1);
	mStr->Append(str1);

	show(CFSTR("After mutations, number of addt'l allocations: %d"), NumAdditionalAllocations(reducedMallocAllocator));

	str1->Release();
	str2->Release();
	mStr->Release();
	str3->Release();

	show(CFSTR("After releasing, number of addt'l allocations: %d"), NumAdditionalAllocations(reducedMallocAllocator));

	CFRelease(reducedMallocAllocator);
}


int main (int argc, const char *argv[])
{
#pragma unused (argc, argv)

	countingAllocatorExample();
	reducedMallocAllocatorExample();

	return 0;
}


